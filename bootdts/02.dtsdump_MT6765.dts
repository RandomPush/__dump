/dts-v1/;

/ {
	model = "MT6765";
	compatible = "mediatek,MT6765";
	interrupt-parent = <0x01>;
	#address-cells = <0x02>;
	#size-cells = <0x02>;

	chosen {
		bootargs = "console=tty0 console=ttyS0,921600n1 vmalloc=400M slub_debug=OFZPU page_owner=on swiotlb=noforce androidboot.hardware=mt6765 maxcpus=8 loop.max_part=7 firmware_class.path=/vendor/firmware";
		kaslr-seed = <0x00 0x00>;
		linux,phandle = <0x58>;
		phandle = <0x58>;
	};

	cpus {
		#address-cells = <0x01>;
		#size-cells = <0x00>;

		cpu@000 {
			device_type = "cpu";
			compatible = "arm,cortex-a53";
			reg = <0x00>;
			enable-method = "psci";
			clock-frequency = <0x89267940>;
			cpu-idle-states = <0x02 0x03 0x04 0x05 0x06 0x07 0x08>;
			linux,phandle = <0x09>;
			phandle = <0x09>;
		};

		cpu@001 {
			device_type = "cpu";
			compatible = "arm,cortex-a53";
			reg = <0x01>;
			enable-method = "psci";
			clock-frequency = <0x89267940>;
			cpu-idle-states = <0x02 0x03 0x04 0x05 0x06 0x07 0x08>;
			linux,phandle = <0x0a>;
			phandle = <0x0a>;
		};

		cpu@002 {
			device_type = "cpu";
			compatible = "arm,cortex-a53";
			reg = <0x02>;
			enable-method = "psci";
			clock-frequency = <0x89267940>;
			cpu-idle-states = <0x02 0x03 0x04 0x05 0x06 0x07 0x08>;
			linux,phandle = <0x0b>;
			phandle = <0x0b>;
		};

		cpu@003 {
			device_type = "cpu";
			compatible = "arm,cortex-a53";
			reg = <0x03>;
			enable-method = "psci";
			clock-frequency = <0x89267940>;
			cpu-idle-states = <0x02 0x03 0x04 0x05 0x06 0x07 0x08>;
			linux,phandle = <0x0c>;
			phandle = <0x0c>;
		};

		cpu@100 {
			device_type = "cpu";
			compatible = "arm,cortex-a53";
			reg = <0x100>;
			enable-method = "psci";
			clock-frequency = <0x6b49d200>;
			cpu-idle-states = <0x02 0x03 0x04 0x05 0x06 0x07 0x08>;
			linux,phandle = <0x0d>;
			phandle = <0x0d>;
		};

		cpu@101 {
			device_type = "cpu";
			compatible = "arm,cortex-a53";
			reg = <0x101>;
			enable-method = "psci";
			clock-frequency = <0x6b49d200>;
			cpu-idle-states = <0x02 0x03 0x04 0x05 0x06 0x07 0x08>;
			linux,phandle = <0x0e>;
			phandle = <0x0e>;
		};

		cpu@102 {
			device_type = "cpu";
			compatible = "arm,cortex-a53";
			reg = <0x102>;
			enable-method = "psci";
			clock-frequency = <0x6b49d200>;
			cpu-idle-states = <0x02 0x03 0x04 0x05 0x06 0x07 0x08>;
			linux,phandle = <0x0f>;
			phandle = <0x0f>;
		};

		cpu@103 {
			device_type = "cpu";
			compatible = "arm,cortex-a53";
			reg = <0x103>;
			enable-method = "psci";
			clock-frequency = <0x6b49d200>;
			cpu-idle-states = <0x02 0x03 0x04 0x05 0x06 0x07 0x08>;
			linux,phandle = <0x10>;
			phandle = <0x10>;
		};

		cpu-map {

			cluster0 {

				core0 {
					cpu = <0x09>;
				};

				core1 {
					cpu = <0x0a>;
				};

				core2 {
					cpu = <0x0b>;
				};

				core3 {
					cpu = <0x0c>;
				};
			};

			cluster1 {

				core0 {
					cpu = <0x0d>;
				};

				core1 {
					cpu = <0x0e>;
				};

				core2 {
					cpu = <0x0f>;
				};

				core3 {
					cpu = <0x10>;
				};
			};
		};

		idle-states {
			entry-method = "arm,psci";

			standby {
				compatible = "arm,idle-state";
				arm,psci-suspend-param = <0x01>;
				entry-latency-us = <0x258>;
				exit-latency-us = <0x258>;
				min-residency-us = <0x4b0>;
				linux,phandle = <0x02>;
				phandle = <0x02>;
			};

			mcdi-cpu {
				compatible = "arm,idle-state";
				arm,psci-suspend-param = <0x10001>;
				entry-latency-us = <0x258>;
				exit-latency-us = <0x258>;
				min-residency-us = <0x4b0>;
				linux,phandle = <0x03>;
				phandle = <0x03>;
			};

			mcdi-cluster {
				compatible = "arm,idle-state";
				arm,psci-suspend-param = <0x1010001>;
				entry-latency-us = <0x258>;
				exit-latency-us = <0x258>;
				min-residency-us = <0x4b0>;
				linux,phandle = <0x04>;
				phandle = <0x04>;
			};

			sodi {
				compatible = "arm,idle-state";
				arm,psci-suspend-param = <0x1010002>;
				entry-latency-us = <0x320>;
				exit-latency-us = <0x3e8>;
				min-residency-us = <0x7d0>;
				linux,phandle = <0x05>;
				phandle = <0x05>;
			};

			sodi3 {
				compatible = "arm,idle-state";
				arm,psci-suspend-param = <0x1010003>;
				entry-latency-us = <0x320>;
				exit-latency-us = <0x3e8>;
				min-residency-us = <0x7d0>;
				linux,phandle = <0x06>;
				phandle = <0x06>;
			};

			dpidle {
				compatible = "arm,idle-state";
				arm,psci-suspend-param = <0x1010004>;
				entry-latency-us = <0x320>;
				exit-latency-us = <0x3e8>;
				min-residency-us = <0x7d0>;
				linux,phandle = <0x07>;
				phandle = <0x07>;
			};

			suspend {
				compatible = "arm,idle-state";
				arm,psci-suspend-param = <0x1010005>;
				entry-latency-us = <0x320>;
				exit-latency-us = <0x3e8>;
				min-residency-us = <0x7d0>;
				linux,phandle = <0x08>;
				phandle = <0x08>;
			};
		};
	};

	psci {
		compatible = "arm,psci-1.0";
		method = "smc";
	};

	pmu {
		compatible = "arm,armv8-pmuv3";
		interrupt-parent = <0x11>;
		interrupts = <0x01 0x07 0x08>;
	};

	l2c_parity {
		compatible = "mediatek,l2c_parity-v1";
		interrupts = <0x00 0x18 0x04 0x00 0x19 0x04>;
	};

	memory {
		device_type = "memory";
		reg = <0x00 0x40000000 0x00 0x20000000>;
	};

	reserved-memory {
		#address-cells = <0x02>;
		#size-cells = <0x02>;
		ranges;
		linux,phandle = <0x59>;
		phandle = <0x59>;

		zmc-default {
			compatible = "mediatek,zone_movable_cma";
			size = <0x00 0xffc00000>;
			alignment = <0x00 0x10000000>;
			alloc-ranges = <0x00 0xc0000000 0x01 0x80000000>;
		};

		reserve-memory-sspm_share {
			compatible = "mediatek,reserve-memory-sspm_share";
			no-map;
			status = "okay";
			size = <0x00 0x110000>;
			alignment = <0x00 0x10000>;
			alloc-ranges = <0x00 0x40000000 0x00 0x60000000>;
		};

		reserve-memory-scp_share {
			compatible = "mediatek,reserve-memory-scp_share";
			no-map;
			size = <0x00 0x300000>;
			alignment = <0x00 0x1000000>;
			alloc-ranges = <0x00 0x40000000 0x00 0x50000000>;
		};

		consys-reserve-memory {
			compatible = "mediatek,consys-reserve-memory";
			no-map;
			size = <0x00 0x400000>;
			alignment = <0x00 0x1000000>;
			alloc-ranges = <0x00 0x40000000 0x00 0x80000000>;
		};

		wifi-reserve-memory {
			compatible = "mediatek,wifi-reserve-memory";
			no-map;
			size = <0x00 0x300000>;
			alignment = <0x00 0x1000000>;
			alloc-ranges = <0x00 0x40000000 0x00 0x80000000>;
		};
	};

	cpu_dbgapb@0d410000 {
		compatible = "mediatek,hw_dbg";
		num = <0x08>;
		reg = <0x00 0xd410000 0x00 0x1000 0x00 0xd510000 0x00 0x1000 0x00 0xd610000 0x00 0x1000 0x00 0xd710000 0x00 0x1000 0x00 0xd810000 0x00 0x1000 0x00 0xd910000 0x00 0x1000 0x00 0xda10000 0x00 0x1000 0x00 0xdb10000 0x00 0x1000>;
		linux,phandle = <0x5a>;
		phandle = <0x5a>;
	};

	atf_logger {
		compatible = "mediatek,atf_logger";
		interrupts = <0x00 0xf7 0x01>;
	};

	amms_control {
		compatible = "mediatek,amms";
		interrupts = <0x00 0x86 0x01>;
	};

	utos {
		compatible = "microtrust,utos";
		interrupts = <0x00 0xf9 0x01 0x00 0xfa 0x01>;
	};

	utos_tester {
		compatible = "microtrust,tester-v1";
	};

	tkcore {
		compatible = "trustkernel,tkcore";
		interrupts = <0x00 0xf8 0x01>;
	};

	plat_sram_flag@0011db00 {
		compatible = "mediatek,plat_sram_flag";
		reg = <0x00 0x10e5f0 0x00 0x10>;
	};

	interrupt-controller@0c000000 {
		compatible = "arm,gic-v3";
		#interrupt-cells = <0x03>;
		#address-cells = <0x02>;
		#size-cells = <0x02>;
		#redistributor-regions = <0x01>;
		interrupt-parent = <0x11>;
		interrupt-controller;
		reg = <0x00 0xc000000 0x00 0x40000 0x00 0xc100000 0x00 0x200000 0x00 0x10200a80 0x00 0x50>;
		interrupts = <0x01 0x09 0x04>;
		linux,phandle = <0x11>;
		phandle = <0x11>;
	};

	intpol-controller@10200a80 {
		compatible = "mediatek,mt6577-sysirq";
		interrupt-controller;
		#interrupt-cells = <0x03>;
		interrupt-parent = <0x11>;
		reg = <0x00 0x10200a80 0x00 0x50>;
		linux,phandle = <0x01>;
		phandle = <0x01>;
	};

	infracfg_ao@10001000 {
		compatible = "mediatek,infracfg_ao\0syscon";
		reg = <0x00 0x10001000 0x00 0x1000>;
		interrupts = <0x00 0x93 0x01>;
		#clock-cells = <0x01>;
		linux,phandle = <0x26>;
		phandle = <0x26>;
	};

	mcdi@0010fc00 {
		compatible = "mediatek,mt6765-mcdi";
		reg = <0x00 0x10fc00 0x00 0x800>;
	};

	scpsys@10001000 {
		compatible = "mediatek,scpsys\0syscon";
		reg = <0x00 0x10001000 0x00 0x1000 0x00 0x10006000 0x00 0x1000 0x00 0x14002000 0x00 0x1000 0x00 0x1020e000 0x00 0x1000 0x00 0x18004000 0x00 0x1000 0x00 0x18002000 0x00 0x1000>;
		#clock-cells = <0x01>;
		linux,phandle = <0x27>;
		phandle = <0x27>;
	};

	topckgen@10000000 {
		compatible = "mediatek,topckgen\0syscon";
		reg = <0x00 0x10000000 0x00 0x1000>;
		#clock-cells = <0x01>;
		linux,phandle = <0x1e>;
		phandle = <0x1e>;
	};

	io_cfg_lt@10002000 {
		compatible = "mediatek,io_cfg_lt";
		reg = <0x00 0x10002000 0x00 0x200>;
	};

	syscfg_pctl_1@0x10002000 {
		compatible = "mediatek,mt6765-pctl-1-syscfg\0syscon";
		reg = <0x00 0x10002000 0x00 0x1000>;
		linux,phandle = <0x13>;
		phandle = <0x13>;
	};

	io_cfg_lm@10002200 {
		compatible = "mediatek,io_cfg_lm";
		reg = <0x00 0x10002200 0x00 0x200>;
	};

	syscfg_pctl_2@0x10002200 {
		compatible = "mediatek,mt6765-pctl-2-syscfg\0syscon";
		reg = <0x00 0x10002200 0x00 0x1000>;
		linux,phandle = <0x14>;
		phandle = <0x14>;
	};

	io_cfg_lb@10002400 {
		compatible = "mediatek,io_cfg_lb";
		reg = <0x00 0x10002400 0x00 0x200>;
	};

	syscfg_pctl_3@0x10002400 {
		compatible = "mediatek,mt6765-pctl-3-syscfg\0syscon";
		reg = <0x00 0x10002400 0x00 0x1000>;
		linux,phandle = <0x15>;
		phandle = <0x15>;
	};

	io_cfg_bl@10002600 {
		compatible = "mediatek,io_cfg_bl";
		reg = <0x00 0x10002600 0x00 0x200>;
	};

	syscfg_pctl_4@0x10002600 {
		compatible = "mediatek,mt6765-pctl-4-syscfg\0syscon";
		reg = <0x00 0x10002600 0x00 0x1000>;
		linux,phandle = <0x16>;
		phandle = <0x16>;
	};

	io_cfg_rr@10002800 {
		compatible = "mediatek,io_cfg_rr";
		reg = <0x00 0x10002800 0x00 0x200>;
	};

	syscfg_pctl_5@0x10002800 {
		compatible = "mediatek,mt6765-pctl-5-syscfg\0syscon";
		reg = <0x00 0x10002800 0x00 0x1000>;
		linux,phandle = <0x17>;
		phandle = <0x17>;
	};

	io_cfg_rb@10002a00 {
		compatible = "mediatek,io_cfg_rb";
		reg = <0x00 0x10002a00 0x00 0x200>;
	};

	syscfg_pctl_6@0x10002a00 {
		compatible = "mediatek,mt6765-pctl-6-syscfg\0syscon";
		reg = <0x00 0x10002a00 0x00 0x1000>;
		linux,phandle = <0x18>;
		phandle = <0x18>;
	};

	io_cfg_rt@10002c00 {
		compatible = "mediatek,io_cfg_rt";
		reg = <0x00 0x10002c00 0x00 0x200>;
	};

	syscfg_pctl_7@0x10002c00 {
		compatible = "mediatek,mt6765-pctl-7-syscfg\0syscon";
		reg = <0x00 0x10002c00 0x00 0x1000>;
		linux,phandle = <0x19>;
		phandle = <0x19>;
	};

	pericfg@10003000 {
		compatible = "mediatek,pericfg\0syscon";
		reg = <0x00 0x10003000 0x00 0x1000>;
		#clock-cells = <0x01>;
		linux,phandle = <0x5b>;
		phandle = <0x5b>;
	};

	efuse_dbg@10004000 {
		compatible = "mediatek,efuse_dbg";
		reg = <0x00 0x10004000 0x00 0x1000>;
	};

	gpio {
		compatible = "mediatek,gpio_usage_mapping";
		linux,phandle = <0x5c>;
		phandle = <0x5c>;
	};

	gpio@10005000 {
		compatible = "mediatek,gpio";
		reg = <0x00 0x10005000 0x00 0x1000>;
		linux,phandle = <0x5d>;
		phandle = <0x5d>;
	};

	syscfg_pctl_0@10005000 {
		compatible = "mediatek,mt6765-pctl-0-syscfg\0syscon";
		reg = <0x00 0x10005000 0x00 0x1000>;
		linux,phandle = <0x12>;
		phandle = <0x12>;
	};

	pinctrl@1000b000 {
		compatible = "mediatek,mt6765-pinctrl";
		reg = <0x00 0x1000b000 0x00 0x1000>;
		mediatek,pctl-regmap = <0x12 0x13 0x14 0x15 0x16 0x17 0x18 0x19>;
		pins-are-numbered;
		gpio-controller;
		#gpio-cells = <0x02>;
		interrupt-controller;
		#interrupt-cells = <0x04>;
		interrupts = <0x00 0xab 0x04>;
		linux,phandle = <0x3f>;
		phandle = <0x3f>;

		iddig_high {
			linux,phandle = <0x20>;
			phandle = <0x20>;

			pins_cmd_dat {
				pinmux = <0x2901>;
				slew-rate = <0x00>;
				bias-pull-up;
			};
		};

		iddig_low {
			linux,phandle = <0x21>;
			phandle = <0x21>;

			pins_cmd_dat {
				pinmux = <0x2900>;
				slew-rate = <0x01>;
				output-low;
			};
		};

		msdc0@default {
			linux,phandle = <0x35>;
			phandle = <0x35>;

			pins_cmd {
				drive-strength = [03];
			};

			pins_dat {
				drive-strength = [03];
			};

			pins_clk {
				drive-strength = [03];
			};

			pins_rst {
				drive-strength = [03];
			};

			pins_ds {
				drive-strength = [03];
			};
		};

		msdc0@hs400 {
			linux,phandle = <0x36>;
			phandle = <0x36>;

			pins_cmd {
				drive-strength = [03];
			};

			pins_dat {
				drive-strength = [04];
			};

			pins_clk {
				drive-strength = [04];
			};

			pins_rst {
				drive-strength = [03];
			};

			pins_ds {
				drive-strength = [04];
			};
		};

		msdc0@hs200 {
			linux,phandle = <0x37>;
			phandle = <0x37>;

			pins_cmd {
				drive-strength = [03];
			};

			pins_dat {
				drive-strength = [04];
			};

			pins_clk {
				drive-strength = [04];
			};

			pins_rst {
				drive-strength = [03];
			};

			pins_ds {
				drive-strength = [04];
			};
		};

		msdc0@register_default {
			cmd_edge = [00];
			rdata_edge = [00];
			wdata_edge = [00];
			linux,phandle = <0x38>;
			phandle = <0x38>;
		};

		msdc1@default {
			linux,phandle = <0x3a>;
			phandle = <0x3a>;

			pins_cmd {
				drive-strength = [03];
			};

			pins_dat {
				drive-strength = [03];
			};

			pins_clk {
				drive-strength = [03];
			};
		};

		msdc1@sdr104 {
			linux,phandle = <0x3b>;
			phandle = <0x3b>;

			pins_cmd {
				drive-strength = [03];
			};

			pins_dat {
				drive-strength = [03];
			};

			pins_clk {
				drive-strength = [03];
			};
		};

		msdc1@sdr50 {
			linux,phandle = <0x3c>;
			phandle = <0x3c>;

			pins_cmd {
				drive-strength = [03];
			};

			pins_dat {
				drive-strength = [03];
			};

			pins_clk {
				drive-strength = [03];
			};
		};

		msdc1@ddr50 {
			linux,phandle = <0x3d>;
			phandle = <0x3d>;

			pins_cmd {
				drive-strength = [03];
			};

			pins_dat {
				drive-strength = [03];
			};

			pins_clk {
				drive-strength = [03];
			};
		};

		msdc1@register_default {
			cmd_edge = [00];
			rdata_edge = [00];
			wdata_edge = [00];
			linux,phandle = <0x3e>;
			phandle = <0x3e>;
		};

		msdc3@default {
			linux,phandle = <0x5e>;
			phandle = <0x5e>;

			pins_cmd {
				drive-strength = [04];
			};

			pins_dat {
				drive-strength = [04];
			};

			pins_clk {
				drive-strength = [04];
			};
		};

		msdc3@register_default {
			cmd_edge = [01];
			rdata_edge = [01];
			wdata_edge = [01];
			linux,phandle = <0x5f>;
			phandle = <0x5f>;
		};

		nfc_ven_high {
			linux,phandle = <0x47>;
			phandle = <0x47>;

			pins_cmd_dat {
				pinmux = <0x6200>;
				slew-rate = <0x01>;
				output-high;
			};
		};

		nfc_ven_low {
			linux,phandle = <0x48>;
			phandle = <0x48>;

			pins_cmd_dat {
				pinmux = <0x6200>;
				slew-rate = <0x01>;
				output-low;
			};
		};

		nfc_dwn_high {
			linux,phandle = <0x49>;
			phandle = <0x49>;

			pins_cmd_dat {
				pinmux = <0xaa00>;
				slew-rate = <0x01>;
				output-high;
			};
		};

		nfc_dwn_low {
			linux,phandle = <0x4a>;
			phandle = <0x4a>;

			pins_cmd_dat {
				pinmux = <0xaa00>;
				slew-rate = <0x01>;
				output-low;
			};
		};

		nfc_eint_as_int {
			linux,phandle = <0x4b>;
			phandle = <0x4b>;

			pins_cmd_dat {
				pinmux = <0x6100>;
				slew-rate = <0x00>;
				bias-disable;
			};
		};

		nfc_clk_req {
			linux,phandle = <0x4c>;
			phandle = <0x4c>;

			pins_cmd_dat {
				pinmux = <0x5900>;
				slew-rate = <0x00>;
				bias-disable;
			};
		};

		nfc_default {
			linux,phandle = <0x46>;
			phandle = <0x46>;
		};

		sia81xx_gpio_L {
			linux,phandle = <0x57>;
			phandle = <0x57>;

			pins_cmd_dat {
				pinmux = <0x9f00>;
				slew-rate = <0x01>;
				bias-disable;
			};
		};
	};

	sleep@10006000 {
		compatible = "mediatek,sleep\0syscon";
		reg = <0x00 0x10006000 0x00 0x1000>;
		interrupts = <0x00 0xb5 0x08>;
		wakeup-source = <0x1a 0x00 0x04 0x1b 0x01 0x20 0x1c 0x03 0x2000000>;
		linux,phandle = <0x45>;
		phandle = <0x45>;
	};

	toprgu@10007000 {
		compatible = "mediatek,mt6765-toprgu";
		reg = <0x00 0x10007000 0x00 0x1000>;
		interrupts = <0x00 0x8b 0x00>;
	};

	chipid@08000000 {
		compatible = "mediatek,chipid";
		reg = <0x00 0x8000000 0x00 0x04 0x00 0x8000004 0x00 0x04 0x00 0x8000008 0x00 0x04 0x00 0x800000c 0x00 0x04>;
	};

	mobicore {
		compatible = "trustonic,mobicore";
		interrupts = <0x00 0x10f 0x01>;
	};

	timer {
		compatible = "arm,armv8-timer";
		interrupt-parent = <0x11>;
		interrupts = <0x01 0x0d 0x08 0x01 0x0e 0x08 0x01 0x0b 0x08 0x01 0x0a 0x08>;
		clock-frequency = <0xc65d40>;
	};

	clocks {

		clk26m {
			compatible = "fixed-clock";
			#clock-cells = <0x00>;
			clock-frequency = <0x18cba80>;
			linux,phandle = <0x1f>;
			phandle = <0x1f>;
		};

		clk32k {
			compatible = "fixed-clock";
			#clock-cells = <0x00>;
			clock-frequency = <0x7d00>;
			linux,phandle = <0x1d>;
			phandle = <0x1d>;
		};
	};

	apxgpt@10008000 {
		compatible = "mediatek,apxgpt";
		reg = <0x00 0x10008000 0x00 0x1000>;
		interrupts = <0x00 0xaa 0x08>;
		clocks = <0x1d>;
	};

	hacc@1000a000 {
		compatible = "mediatek,hacc";
		reg = <0x00 0x1000a000 0x00 0x1000>;
		interrupts = <0x00 0xbd 0x08>;
	};

	apmixed@1000c000 {
		compatible = "mediatek,apmixed\0syscon";
		reg = <0x00 0x1000c000 0x00 0x1000>;
		#clock-cells = <0x01>;
		linux,phandle = <0x44>;
		phandle = <0x44>;
	};

	fhctl@1000ce00 {
		compatible = "mediatek,fhctl";
		reg = <0x00 0x1000ce00 0x00 0x200>;
	};

	pwrap@1000d000 {
		compatible = "mediatek,pwrap";
		reg = <0x00 0x1000d000 0x00 0x1000>;
		interrupts = <0x00 0xb3 0x04>;
	};

	mt-pmic {
		compatible = "mediatek,mt_pmic";
		interrupt-controller;
		linux,phandle = <0x60>;
		phandle = <0x60>;

		mt635x-auxadc {
			compatible = "mediatek,mt635x-auxadc";
			#io-channel-cells = <0x01>;
			linux,phandle = <0x61>;
			phandle = <0x61>;

			batadc {
				channel = <0x00>;
				resistance-ratio = <0x03 0x01>;
				avg-num = <0x80>;
			};

			isense {
				channel = <0x01>;
				resistance-ratio = <0x03 0x01>;
				avg-num = <0x80>;
			};

			vcdt {
				channel = <0x02>;
			};

			bat_temp {
				channel = <0x03>;
				resistance-ratio = <0x01 0x01>;
			};

			chip_temp {
				channel = <0x05>;
			};

			vcore_temp {
				channel = <0x06>;
			};

			vproc_temp {
				channel = <0x07>;
			};

			accdet {
				channel = <0x09>;
			};

			tsx_temp {
				channel = <0x0b>;
				avg-num = <0x80>;
			};

			hpofs_cal {
				channel = <0x0c>;
				avg-num = <0x100>;
			};

			dcxo_temp {
				channel = <0x0d>;
				avg-num = <0x10>;
			};

			vbif {
				channel = <0x0e>;
				resistance-ratio = <0x01 0x01>;
			};
		};

		buck_regulators {

			buck_vs1 {
				regulator-name = "vs1";
				regulator-min-microvolt = <0x124f80>;
				regulator-max-microvolt = <0x2191c0>;
				regulator-ramp-delay = <0x30d4>;
				regulator-enable-ramp-delay = <0xdc>;
				linux,phandle = <0x62>;
				phandle = <0x62>;
			};

			buck_vmodem {
				regulator-name = "vmodem";
				regulator-min-microvolt = <0x7a120>;
				regulator-max-microvolt = <0x123716>;
				regulator-ramp-delay = <0x186a>;
				regulator-enable-ramp-delay = <0xdc>;
				linux,phandle = <0x63>;
				phandle = <0x63>;
			};

			buck_vcore {
				regulator-name = "vcore";
				regulator-min-microvolt = <0x7ea5e>;
				regulator-max-microvolt = <0x1406f4>;
				regulator-ramp-delay = <0x186a>;
				regulator-enable-ramp-delay = <0xdc>;
				linux,phandle = <0x64>;
				phandle = <0x64>;
			};

			buck_vproc {
				regulator-name = "vproc";
				regulator-min-microvolt = <0x7ea5e>;
				regulator-max-microvolt = <0x1406f4>;
				regulator-ramp-delay = <0x186a>;
				regulator-enable-ramp-delay = <0xdc>;
				linux,phandle = <0x65>;
				phandle = <0x65>;
			};

			buck_vpa {
				regulator-name = "vpa";
				regulator-min-microvolt = <0x7a120>;
				regulator-max-microvolt = <0x37b1d0>;
				regulator-ramp-delay = <0xc350>;
				regulator-enable-ramp-delay = <0xdc>;
				linux,phandle = <0x66>;
				phandle = <0x66>;
			};
		};

		ldo_regulators {

			ldo_vfe28 {
				compatible = "regulator-fixed";
				regulator-name = "vfe28";
				regulator-min-microvolt = <0x2ab980>;
				regulator-max-microvolt = <0x2ab980>;
				regulator-enable-ramp-delay = <0x108>;
				linux,phandle = <0x67>;
				phandle = <0x67>;
			};

			ldo_vxo22 {
				regulator-name = "vxo22";
				regulator-min-microvolt = <0x2191c0>;
				regulator-max-microvolt = <0x249f00>;
				regulator-enable-ramp-delay = <0x6e>;
				linux,phandle = <0x68>;
				phandle = <0x68>;
			};

			ldo_vrf18 {
				compatible = "regulator-fixed";
				regulator-name = "vrf18";
				regulator-min-microvolt = <0x1b7740>;
				regulator-max-microvolt = <0x1b7740>;
				regulator-enable-ramp-delay = <0x6e>;
				linux,phandle = <0x69>;
				phandle = <0x69>;
			};

			ldo_vrf12 {
				compatible = "regulator-fixed";
				regulator-name = "vrf12";
				regulator-min-microvolt = <0x124f80>;
				regulator-max-microvolt = <0x124f80>;
				regulator-enable-ramp-delay = <0x6e>;
				linux,phandle = <0x6a>;
				phandle = <0x6a>;
			};

			ldo_vefuse {
				regulator-name = "vefuse";
				regulator-min-microvolt = <0x124f80>;
				regulator-max-microvolt = <0x325aa0>;
				regulator-enable-ramp-delay = <0x108>;
				linux,phandle = <0x6b>;
				phandle = <0x6b>;
			};

			ldo_vcn33_bt {
				regulator-name = "vcn33_bt";
				regulator-min-microvolt = <0x325aa0>;
				regulator-max-microvolt = <0x3567e0>;
				regulator-enable-ramp-delay = <0x108>;
				linux,phandle = <0x6c>;
				phandle = <0x6c>;
			};

			ldo_vcn33_wifi {
				regulator-name = "vcn33_wifi";
				regulator-min-microvolt = <0x325aa0>;
				regulator-max-microvolt = <0x3567e0>;
				regulator-enable-ramp-delay = <0x108>;
				linux,phandle = <0x6d>;
				phandle = <0x6d>;
			};

			ldo_vcn28 {
				compatible = "regulator-fixed";
				regulator-name = "vcn28";
				regulator-min-microvolt = <0x2ab980>;
				regulator-max-microvolt = <0x2ab980>;
				regulator-enable-ramp-delay = <0x108>;
				linux,phandle = <0x6e>;
				phandle = <0x6e>;
			};

			ldo_vcn18 {
				compatible = "regulator-fixed";
				regulator-name = "vcn18";
				regulator-min-microvolt = <0x1b7740>;
				regulator-max-microvolt = <0x1b7740>;
				regulator-enable-ramp-delay = <0x108>;
				linux,phandle = <0x6f>;
				phandle = <0x6f>;
			};

			ldo_vcama {
				regulator-name = "vcama";
				regulator-min-microvolt = <0x2625a0>;
				regulator-max-microvolt = <0x2ab980>;
				regulator-enable-ramp-delay = <0x108>;
				linux,phandle = <0x70>;
				phandle = <0x70>;
			};

			ldo_vcamd {
				regulator-name = "vcamd";
				regulator-min-microvolt = <0xf4240>;
				regulator-max-microvolt = <0x1b7740>;
				regulator-enable-ramp-delay = <0x108>;
				linux,phandle = <0x71>;
				phandle = <0x71>;
			};

			ldo_vcamio {
				compatible = "regulator-fixed";
				regulator-name = "vcamio";
				regulator-min-microvolt = <0x1b7740>;
				regulator-max-microvolt = <0x1b7740>;
				regulator-enable-ramp-delay = <0x108>;
				linux,phandle = <0x72>;
				phandle = <0x72>;
			};

			ldo_vldo28 {
				regulator-name = "vldo28";
				regulator-min-microvolt = <0x2ab980>;
				regulator-max-microvolt = <0x2dc6c0>;
				regulator-enable-ramp-delay = <0x108>;
				linux,phandle = <0x73>;
				phandle = <0x73>;
			};

			ldo_vsram_others {
				regulator-name = "vsram_others";
				regulator-min-microvolt = <0x7ea5e>;
				regulator-max-microvolt = <0x1406f4>;
				regulator-ramp-delay = <0x186a>;
				regulator-enable-ramp-delay = <0x6e>;
				linux,phandle = <0x74>;
				phandle = <0x74>;
			};

			ldo_vsram_proc {
				regulator-name = "vsram_proc";
				regulator-min-microvolt = <0x7ea5e>;
				regulator-max-microvolt = <0x1406f4>;
				regulator-ramp-delay = <0x186a>;
				regulator-enable-ramp-delay = <0x6e>;
				linux,phandle = <0x75>;
				phandle = <0x75>;
			};

			ldo_vaux18 {
				compatible = "regulator-fixed";
				regulator-name = "vaux18";
				regulator-min-microvolt = <0x1b7740>;
				regulator-max-microvolt = <0x1b7740>;
				regulator-enable-ramp-delay = <0x108>;
				linux,phandle = <0x76>;
				phandle = <0x76>;
			};

			ldo_vaud28 {
				compatible = "regulator-fixed";
				regulator-name = "vaud28";
				regulator-min-microvolt = <0x2ab980>;
				regulator-max-microvolt = <0x2ab980>;
				regulator-enable-ramp-delay = <0x108>;
				linux,phandle = <0x77>;
				phandle = <0x77>;
			};

			ldo_vio28 {
				compatible = "regulator-fixed";
				regulator-name = "vio28";
				regulator-min-microvolt = <0x2ab980>;
				regulator-max-microvolt = <0x2ab980>;
				regulator-enable-ramp-delay = <0x108>;
				linux,phandle = <0x78>;
				phandle = <0x78>;
			};

			ldo_vio18 {
				compatible = "regulator-fixed";
				regulator-name = "vio18";
				regulator-min-microvolt = <0x1b7740>;
				regulator-max-microvolt = <0x1b7740>;
				regulator-enable-ramp-delay = <0x108>;
				linux,phandle = <0x79>;
				phandle = <0x79>;
			};

			ldo_vdram {
				regulator-name = "vdram";
				regulator-min-microvolt = <0x10c8e0>;
				regulator-max-microvolt = <0x124f80>;
				regulator-enable-ramp-delay = <0xce4>;
				linux,phandle = <0x7a>;
				phandle = <0x7a>;
			};

			ldo_vmc {
				regulator-name = "vmc";
				regulator-min-microvolt = <0x1b7740>;
				regulator-max-microvolt = <0x325aa0>;
				regulator-enable-ramp-delay = <0x2c>;
				linux,phandle = <0x41>;
				phandle = <0x41>;
			};

			ldo_vmch {
				regulator-name = "vmch";
				regulator-min-microvolt = <0x2c4020>;
				regulator-max-microvolt = <0x325aa0>;
				regulator-enable-ramp-delay = <0x2c>;
				linux,phandle = <0x40>;
				phandle = <0x40>;
			};

			ldo_vemc {
				regulator-name = "vemc";
				regulator-min-microvolt = <0x2c4020>;
				regulator-max-microvolt = <0x325aa0>;
				regulator-enable-ramp-delay = <0x2c>;
				linux,phandle = <0x39>;
				phandle = <0x39>;
			};

			ldo_vsim1 {
				regulator-name = "vsim1";
				regulator-min-microvolt = <0x19f0a0>;
				regulator-max-microvolt = <0x2f4d60>;
				regulator-enable-ramp-delay = <0x108>;
				linux,phandle = <0x7b>;
				phandle = <0x7b>;
			};

			ldo_vsim2 {
				regulator-name = "vsim2";
				regulator-min-microvolt = <0x19f0a0>;
				regulator-max-microvolt = <0x2f4d60>;
				regulator-enable-ramp-delay = <0x108>;
				linux,phandle = <0x7c>;
				phandle = <0x7c>;
			};

			ldo_vibr {
				regulator-name = "vibr";
				regulator-min-microvolt = <0x124f80>;
				regulator-max-microvolt = <0x325aa0>;
				regulator-enable-ramp-delay = <0x2c>;
				linux,phandle = <0x7d>;
				phandle = <0x7d>;
			};

			ldo_vusb33 {
				regulator-name = "vusb33";
				regulator-min-microvolt = <0x2dc6c0>;
				regulator-max-microvolt = <0x2f4d60>;
				regulator-enable-ramp-delay = <0x108>;
				linux,phandle = <0x7e>;
				phandle = <0x7e>;
			};
		};
	};

	scp@10500000 {
		compatible = "mediatek,scp";
		status = "okay";
		reg = <0x00 0x10500000 0x00 0x40000 0x00 0x105c0000 0x00 0x3000 0x00 0x105c4000 0x00 0x1000 0x00 0x105d4000 0x00 0x6000>;
		interrupts = <0x00 0xc0 0x04>;
		core_1 = "enable";
		scp_sramSize = <0x40000>;
	};

	scp_dvfs {
		compatible = "mediatek,scp_dvfs";
		clocks = <0x1e 0x63 0x1f 0x1e 0x0e 0x1e 0x1a 0x1e 0x02 0x1e 0x17 0x1e 0x06 0x1e 0x19>;
		clock-names = "clk_mux\0clk_pll_0\0clk_pll_1\0clk_pll_2\0clk_pll_3\0clk_pll_4\0clk_pll_5\0clk_pll_6";
	};

	sleep_reg_md@1000f000 {
		compatible = "mediatek,sleep_reg_md";
		reg = <0x00 0x1000f000 0x00 0x1000>;
	};

	kp@10010000 {
		compatible = "mediatek,kp";
		reg = <0x00 0x10010000 0x00 0x1000>;
		interrupts = <0x00 0xb4 0x02>;
		linux,phandle = <0x1a>;
		phandle = <0x1a>;
	};

	otg_iddig {
		compatible = "mediatek,usb_iddig_bi_eint";
		pinctrl-names = "iddig_high\0iddig_low";
		pinctrl-0 = <0x20>;
		pinctrl-1 = <0x21>;
		linux,phandle = <0x7f>;
		phandle = <0x7f>;
	};

	mrdump_ext_rst {
		compatible = "mediatek, mrdump_ext_rst-eint";
		force_mode = "EINT";
		mode = "IRQ";
		status = "okay";
		linux,phandle = <0x80>;
		phandle = <0x80>;
	};

	touch {
		compatible = "mediatek,touch";
		linux,phandle = <0x81>;
		phandle = <0x81>;
	};

	accdet {
		compatible = "mediatek,pmic-accdet";
		linux,phandle = <0x82>;
		phandle = <0x82>;
	};

	silead_fp {
		compatible = "mediatek,finger-fp";
		linux,phandle = <0x83>;
		phandle = <0x83>;
	};

	fpsensor_finger {
		compatible = "mediatek,fingerprint";
		linux,phandle = <0x84>;
		phandle = <0x84>;
	};

	fpc_interrupt {
		compatible = "fpc,fpc_irq";
		linux,phandle = <0x85>;
		phandle = <0x85>;
	};

	oppo_fp_common {
		compatible = "oppo,fp_common";
		linux,phandle = <0x86>;
		phandle = <0x86>;
	};

	oppo_secure_common {
		compatible = "oppo,secure_common";
		linux,phandle = <0x87>;
		phandle = <0x87>;
	};

	mt6357_gauge {
		compatible = "mediatek,mt6357_gauge";
		gauge_name = "gauge";
		alias_name = "mt6357";
	};

	gauge_timer {
		compatible = "mediatek,gauge_timer_service";
	};

	battery {
		compatible = "mediatek,bat_gm30";
		DIFFERENCE_FULLOCV_ITH = <0xc8>;
		SHUTDOWN_1_TIME = <0x1e>;
		KEEP_100_PERCENT = <0x05>;
		R_FG_VALUE = <0x0a>;
		EMBEDDED_SEL = <0x01>;
		PMIC_SHUTDOWN_CURRENT = <0x14>;
		FG_METER_RESISTANCE = <0x4b>;
		CAR_TUNE_VALUE = <0x64>;
		PMIC_MIN_VOL = <0x82dc>;
		POWERON_SYSTEM_IBOOT = <0x1f4>;
		SHUTDOWN_GAUGE0_VOLTAGE = <0x84d0>;
		TEMPERATURE_T0 = <0x32>;
		TEMPERATURE_T1 = <0x19>;
		TEMPERATURE_T2 = <0x0a>;
		TEMPERATURE_T3 = <0x00>;
		TEMPERATURE_T4 = <0xfffffff6>;
		g_FG_PSEUDO100_T0 = <0x64>;
		g_FG_PSEUDO100_T1 = <0x5f>;
		g_FG_PSEUDO100_T2 = <0x5c>;
		g_FG_PSEUDO100_T3 = <0x5c>;
		g_FG_PSEUDO100_T4 = <0x5a>;
		Q_MAX_SYS_VOLTAGE_BAT0 = <0xd16>;
		Q_MAX_SYS_VOLTAGE_BAT1 = <0xd16>;
		Q_MAX_SYS_VOLTAGE_BAT2 = <0xd16>;
		Q_MAX_SYS_VOLTAGE_BAT3 = <0xd16>;
		battery1_profile_t0_num = <0x64>;
		battery1_profile_t0_col = <0x03>;
		battery1_profile_t0 = <0x00 0xaa3c 0x352 0x1a8 0xa9c5 0x352 0x351 0xa94e 0x363 0x4f9 0xa8d7 0x36b 0x6a2 0xa861 0x36b 0x84a 0xa7ea 0x36b 0x9f3 0xa773 0x36d 0xb9b 0xa6fc 0x383 0xd44 0xa685 0x384 0xeec 0xa608 0x374 0x1094 0xa592 0x377 0x123d 0xa521 0x384 0x13e5 0xa4aa 0x384 0x158e 0xa436 0x384 0x1736 0xa3bf 0x384 0x18df 0xa348 0x372 0x1a87 0xa2d7 0x379 0x1c30 0xa269 0x384 0x1dd8 0xa1f8 0x384 0x1f80 0xa182 0x384 0x2129 0xa113 0x384 0x22d1 0xa0a5 0x384 0x247a 0xa03d 0x394 0x2622 0x9fd2 0x390 0x27cb 0x9f68 0x38d 0x2973 0x9f02 0x39d 0x2b1c 0x9e9c 0x39d 0x2cc4 0x9e36 0x39d 0x2e6c 0x9dd0 0x39d 0x3015 0x9d70 0x3ac 0x31bd 0x9d13 0x3b6 0x3366 0x9cb5 0x3b6 0x350e 0x9c5a 0x3ba 0x36b7 0x9c05 0x3cf 0x385f 0x9bb0 0x3e4 0x3a08 0x9b5b 0x3e8 0x3bb0 0x9b07 0x402 0x3d58 0x9ab3 0x41a 0x3f01 0x9a5e 0x425 0x40a9 0x9a07 0x44a 0x4252 0x9999 0x435 0x43fa 0x990c 0x40d 0x45a3 0x987c 0x3c4 0x474b 0x9803 0x391 0x48f4 0x97a6 0x384 0x4a9c 0x975b 0x384 0x4c44 0x9717 0x384 0x4ded 0x96dc 0x384 0x4f95 0x96a1 0x384 0x513e 0x9665 0x376 0x52e6 0x962e 0x375 0x548f 0x95fb 0x384 0x5637 0x95c8 0x381 0x57e0 0x9595 0x36c 0x5988 0x956a 0x37f 0x5b30 0x9539 0x374 0x5cd9 0x9510 0x377 0x5e81 0x94eb 0x384 0x602a 0x94c2 0x384 0x61d2 0x94a0 0x385 0x637b 0x947e 0x39a 0x6523 0x945d 0x39d 0x66cc 0x943b 0x39d 0x6874 0x941d 0x3a8 0x6a1c 0x9401 0x3b6 0x6bc5 0x93e0 0x3b9 0x6d6d 0x93c7 0x3ce 0x6f16 0x93a5 0x3cf 0x70be 0x937d 0x3be 0x7267 0x9339 0x390 0x740f 0x92e7 0x36b 0x75b8 0x92a3 0x36b 0x7760 0x927a 0x36d 0x7908 0x9258 0x382 0x7ab1 0x922e 0x384 0x7c59 0x91fe 0x375 0x7e02 0x91cf 0x36b 0x7faa 0x91ab 0x373 0x8153 0x918e 0x384 0x82fb 0x9164 0x384 0x84a4 0x9131 0x384 0x864c 0x90f7 0x384 0x87f4 0x90b6 0x376 0x899d 0x9076 0x375 0x8b45 0x9034 0x37e 0x8cee 0x8fe3 0x369 0x8e96 0x8fb1 0x354 0x903f 0x8fa4 0x365 0x91e7 0x8f9c 0x37b 0x9390 0x8f93 0x390 0x9538 0x8f88 0x3b5 0x96e0 0x8f70 0x3f0 0x9889 0x8f38 0x418 0x9a31 0x8e31 0x3ae 0x9bda 0x8c86 0x3c1 0x9d82 0x8a4a 0x3f9 0x9f2b 0x8741 0x443 0xa0d3 0x8283 0x556 0xa27c 0x79df 0xc0e 0xa424 0x70da 0x979>;
		battery1_profile_t1_num = <0x64>;
		battery1_profile_t1_col = <0x03>;
		battery1_profile_t1 = <0x00 0xaa82 0x47e 0x1a8 0xaa14 0x47e 0x351 0xa9a5 0x47e 0x4f9 0xa931 0x47e 0x6a2 0xa8bb 0x47e 0x84a 0xa844 0x484 0x9f3 0xa7cd 0x497 0xb9b 0xa756 0x497 0xd44 0xa6d7 0x483 0xeec 0xa665 0x48e 0x1094 0xa5f2 0x497 0x123d 0xa57b 0x497 0x13e5 0xa504 0x492 0x158e 0xa490 0x47e 0x1736 0xa422 0x494 0x18df 0xa3ac 0x497 0x1a87 0xa33b 0x497 0x1c30 0xa2cd 0x4a1 0x1dd8 0xa25e 0x4b0 0x1f80 0xa1f0 0x4b3 0x2129 0xa181 0x4c8 0x22d1 0xa10b 0x4b5 0x247a 0xa09b 0x4b0 0x2622 0xa031 0x4bd 0x27cb 0x9fcc 0x4d2 0x2973 0x9f6a 0x4e7 0x2b1c 0x9f17 0x4ff 0x2cc4 0x9ee4 0x53f 0x2e6c 0x9e84 0x533 0x3015 0x9dfa 0x51e 0x31bd 0x9d59 0x514 0x3366 0x9cbb 0x50d 0x350e 0x9c3a 0x502 0x36b7 0x9bdd 0x52d 0x385f 0x9b99 0x542 0x3a08 0x9b70 0x57a 0x3bb0 0x9b3f 0x59e 0x3d58 0x9af9 0x5aa 0x3f01 0x9aa2 0x5af 0x40a9 0x9a43 0x5c1 0x4252 0x99d5 0x5ac 0x43fa 0x9950 0x55e 0x45a3 0x98c2 0x4f9 0x474b 0x9844 0x4a6 0x48f4 0x97df 0x476 0x4a9c 0x978c 0x461 0x4c44 0x973f 0x44c 0x4ded 0x9704 0x461 0x4f95 0x96c9 0x453 0x513e 0x968d 0x44c 0x52e6 0x9656 0x44c 0x548f 0x9623 0x44c 0x5637 0x95f0 0x44c 0x57e0 0x95bd 0x44c 0x5988 0x9592 0x44c 0x5b30 0x9568 0x44c 0x5cd9 0x953d 0x44c 0x5e81 0x9516 0x455 0x602a 0x94f2 0x465 0x61d2 0x94c8 0x465 0x637b 0x94a6 0x465 0x6523 0x9485 0x465 0x66cc 0x9469 0x473 0x6874 0x944b 0x47e 0x6a1c 0x942c 0x47e 0x6bc5 0x9412 0x481 0x6d6d 0x93f9 0x496 0x6f16 0x93d7 0x483 0x70be 0x93bc 0x48f 0x7267 0x939d 0x48a 0x740f 0x9378 0x475 0x75b8 0x934d 0x45a 0x7760 0x9324 0x433 0x7908 0x9302 0x433 0x7ab1 0x92e0 0x433 0x7c59 0x92b8 0x433 0x7e02 0x928d 0x428 0x7faa 0x9269 0x422 0x8153 0x924e 0x437 0x82fb 0x922c 0x44c 0x84a4 0x91f9 0x437 0x864c 0x91bf 0x433 0x87f4 0x917e 0x433 0x899d 0x913e 0x433 0x8b45 0x9101 0x439 0x8cee 0x90bc 0x44a 0x8e96 0x905e 0x435 0x903f 0x903f 0x433 0x91e7 0x9032 0x443 0x9390 0x9029 0x44c 0x9538 0x9021 0x464 0x96e0 0x9015 0x49b 0x9889 0x8ffa 0x4b1 0x9a31 0x8fa5 0x4db 0x9bda 0x8e6b 0x4be 0x9d82 0x8c8b 0x4cc 0x9f2b 0x89fc 0x50b 0xa0d3 0x8662 0x59b 0xa27c 0x809c 0x99c 0xa424 0x7814 0x1b58>;
		battery1_profile_t2_num = <0x64>;
		battery1_profile_t2_col = <0x03>;
		battery1_profile_t2 = <0x00 0xaaaa 0x73a 0x1a8 0xaa3c 0x73a 0x351 0xa9c6 0x73a 0x4f9 0xa94a 0x72c 0x6a2 0xa8cb 0x721 0x84a 0xa84e 0x721 0x9f3 0xa7d7 0x71f 0xb9b 0xa760 0x709 0xd44 0xa6e9 0x708 0xeec 0xa672 0x6f8 0x1094 0xa5fc 0x6e3 0x123d 0xa588 0x6de 0x13e5 0xa518 0x6ef 0x158e 0xa4a4 0x6ef 0x1736 0xa42d 0x6d9 0x18df 0xa3bd 0x6d6 0x1a87 0xa34f 0x6d6 0x1c30 0xa2e1 0x6d6 0x1dd8 0xa272 0x6dc 0x1f80 0xa204 0x6f2 0x2129 0xa195 0x707 0x22d1 0xa11f 0x6f4 0x247a 0xa0b5 0x710 0x2622 0xa04a 0x714 0x27cb 0x9fe3 0x711 0x2973 0x9f8c 0x72b 0x2b1c 0x9f49 0x758 0x2cc4 0x9f16 0x7ad 0x2e6c 0x9eaf 0x7b7 0x3015 0x9e0a 0x78a 0x31bd 0x9d54 0x76c 0x3366 0x9cab 0x76c 0x350e 0x9c1b 0x770 0x36b7 0x9bb5 0x785 0x385f 0x9b68 0x7af 0x3a08 0x9b2a 0x7da 0x3bb0 0x9afa 0x803 0x3d58 0x9ac8 0x824 0x3f01 0x9a86 0x829 0x40a9 0x9a2f 0x7ff 0x4252 0x99c1 0x7d4 0x43fa 0x9943 0x770 0x45a3 0x98be 0x6f7 0x474b 0x9844 0x6a6 0x48f4 0x97df 0x67b 0x4a9c 0x978c 0x655 0x4c44 0x973f 0x640 0x4ded 0x96fb 0x640 0x4f95 0x96bf 0x62e 0x513e 0x9683 0x627 0x52e6 0x964c 0x627 0x548f 0x9619 0x627 0x5637 0x95e7 0x62a 0x57e0 0x95bc 0x63f 0x5988 0x958a 0x62c 0x5b30 0x9564 0x637 0x5cd9 0x953d 0x640 0x5e81 0x9513 0x640 0x602a 0x94ea 0x645 0x61d2 0x94c8 0x659 0x637b 0x94a6 0x659 0x6523 0x9485 0x659 0x66cc 0x9469 0x667 0x6874 0x944b 0x672 0x6a1c 0x942c 0x672 0x6bc5 0x9412 0x672 0x6d6d 0x93f9 0x672 0x6f16 0x93e0 0x686 0x70be 0x93cd 0x68b 0x7267 0x93b7 0x68b 0x740f 0x93a1 0x68b 0x75b8 0x938e 0x686 0x7760 0x9374 0x672 0x7908 0x935b 0x672 0x7ab1 0x9341 0x672 0x7c59 0x931c 0x663 0x7e02 0x92f1 0x659 0x7faa 0x92ca 0x661 0x8153 0x92a8 0x672 0x82fb 0x9286 0x672 0x84a4 0x9253 0x687 0x864c 0x9219 0x68b 0x87f4 0x91d8 0x699 0x899d 0x9198 0x6a4 0x8b45 0x915a 0x6b0 0x8cee 0x9113 0x6d6 0x8e96 0x90b6 0x6d6 0x903f 0x9088 0x6ea 0x91e7 0x9071 0x6ff 0x9390 0x9060 0x721 0x9538 0x904f 0x754 0x96e0 0x903e 0x798 0x9889 0x902d 0x7ec 0x9a31 0x8ff1 0x86b 0x9bda 0x8f03 0x8a3 0x9d82 0x8d50 0x8f8 0x9f2b 0x8ae3 0x995 0xa0d3 0x8785 0xabf 0xa27c 0x8210 0xe9a 0xa424 0x730a 0xe29>;
		battery1_profile_t3_num = <0x64>;
		battery1_profile_t3_col = <0x03>;
		battery1_profile_t3 = <0x00 0xaaaa 0xb0e 0x1a8 0xaa3c 0xb0a 0x351 0xa9bf 0xbb7 0x4f9 0xa940 0xbf5 0x6a2 0xa8c1 0xbd6 0x84a 0xa841 0xbac 0x9f3 0xa7c3 0xb88 0xb9b 0xa74c 0xb9e 0xd44 0xa6dd 0xb8b 0xeec 0xa668 0xb86 0x1094 0xa5f2 0xb86 0x123d 0xa57b 0xb75 0x13e5 0xa506 0xb54 0x158e 0xa49a 0xb54 0x1736 0xa42c 0xb54 0x18df 0xa3bd 0xb42 0x1a87 0xa34f 0xb3b 0x1c30 0xa2e1 0xb3b 0x1dd8 0xa272 0xb3b 0x1f80 0xa204 0xb3b 0x2129 0xa195 0xb3b 0x22d1 0xa127 0xb4f 0x247a 0xa0b9 0xb54 0x2622 0xa04f 0xb47 0x27cb 0x9ff1 0xb44 0x2973 0x9fa2 0xb68 0x2b1c 0x9f66 0xbbd 0x2cc4 0x9f22 0xc12 0x2e6c 0x9eb1 0xc1c 0x3015 0x9e05 0xbe0 0x31bd 0x9d41 0xb96 0x3366 0x9c8d 0xb66 0x350e 0x9bfb 0xb54 0x36b7 0x9b8d 0xb54 0x385f 0x9b2f 0xb54 0x3a08 0x9ae7 0xb65 0x3bb0 0x9aa9 0xb7a 0x3d58 0x9a6a 0xb86 0x3f01 0x9a22 0xb76 0x40a9 0x99cb 0xb33 0x4252 0x995d 0xac9 0x43fa 0x98ef 0xa72 0x45a3 0x9886 0xa2c 0x474b 0x9825 0x9ec 0x48f4 0x97cb 0x9b4 0x4a9c 0x9778 0x98e 0x4c44 0x972b 0x979 0x4ded 0x96f0 0x979 0x4f95 0x96ad 0x956 0x513e 0x9675 0x947 0x52e6 0x9642 0x951 0x548f 0x960f 0x960 0x5637 0x95dc 0x95d 0x57e0 0x95a9 0x948 0x5988 0x957e 0x95b 0x5b30 0x9554 0x970 0x5cd9 0x9529 0x979 0x5e81 0x9502 0x982 0x602a 0x94e0 0x997 0x61d2 0x94be 0x9ac 0x637b 0x949c 0x9c1 0x6523 0x947b 0x9c4 0x66cc 0x945f 0x9d2 0x6874 0x9441 0x9dd 0x6a1c 0x9425 0x9e4 0x6bc5 0x9411 0x9f6 0x6d6d 0x93ef 0x9f6 0x6f16 0x93de 0xa1f 0x70be 0x93cd 0xa39 0x7267 0x93c1 0xa4e 0x740f 0x93b5 0xa63 0x75b8 0x93a4 0xa73 0x7760 0x9393 0xa74 0x7908 0x9382 0xa8a 0x7ab1 0x9369 0xa9f 0x7c59 0x934a 0xab4 0x7e02 0x9328 0xac9 0x7faa 0x9303 0xadf 0x8153 0x92d8 0xaf4 0x82fb 0x92ae 0xb09 0x84a4 0x927b 0xb49 0x864c 0x9241 0xb77 0x87f4 0x9200 0xbaf 0x899d 0x91c0 0xbf9 0x8b45 0x9180 0xc47 0x8cee 0x9134 0xc88 0x8e96 0x90e0 0xcdc 0x903f 0x90aa 0xd58 0x91e7 0x9089 0xdd7 0x9390 0x9075 0xe7a 0x9538 0x9060 0xf49 0x96e0 0x9047 0x103f 0x9889 0x902d 0x116a 0x9a31 0x8fe9 0x12e8 0x9bda 0x8f00 0x1430 0x9d82 0x8d4a 0x158b 0x9f2b 0x8ad0 0x17a3 0xa0d3 0x8755 0x1af1 0xa27c 0x81f2 0x1feb 0xa424 0x75f8 0x168f>;
		battery1_profile_t4_num = <0x64>;
		battery1_profile_t4_col = <0x03>;
		battery1_profile_t4 = <0x00 0xaa96 0x154a 0x1a8 0xaa52 0x154a 0x351 0xa9ba 0x16ed 0x4f9 0xa91c 0x17b0 0x6a2 0xa88b 0x17cf 0x84a 0xa803 0x17e7 0x9f3 0xa77d 0x17cb 0xb9b 0xa706 0x1776 0xd44 0xa68f 0x170d 0xeec 0xa61f 0x16c3 0x1094 0xa5ac 0x1683 0x123d 0xa535 0x1644 0x13e5 0xa4c0 0x1609 0x158e 0xa451 0x15de 0x1736 0xa3e3 0x15b4 0x18df 0xa37c 0x15c0 0x1a87 0xa310 0x15c7 0x1c30 0xa2a3 0x15c7 0x1dd8 0xa236 0x15c7 0x1f80 0xa1c8 0x15c4 0x2129 0xa159 0x15af 0x22d1 0xa0f3 0x15ae 0x247a 0xa087 0x159e 0x2622 0xa028 0x15a2 0x27cb 0x9fd6 0x15c9 0x2973 0x9f8a 0x1603 0x2b1c 0x9f3c 0x162a 0x2cc4 0x9ed6 0x1615 0x2e6c 0x9e3c 0x15a2 0x3015 0x9d7d 0x14f6 0x31bd 0x9cbe 0x146e 0x3366 0x9c18 0x1421 0x350e 0x9b8c 0x13e5 0x36b7 0x9b15 0x13ba 0x385f 0x9aa7 0x13ba 0x3a08 0x9a4d 0x13a9 0x3bb0 0x99f8 0x13a1 0x3d58 0x99a7 0x1397 0x3f01 0x995b 0x1388 0x40a9 0x990d 0x1384 0x4252 0x98b8 0x1359 0x43fa 0x9864 0x1342 0x45a3 0x9810 0x131e 0x474b 0x97c0 0x12ff 0x48f4 0x9774 0x12ea 0x4a9c 0x972b 0x12d9 0x4c44 0x96ef 0x12d9 0x4ded 0x96ab 0x12d9 0x4f95 0x966f 0x12d9 0x513e 0x9639 0x12d9 0x52e6 0x9606 0x12e3 0x548f 0x95d3 0x12f8 0x5637 0x95a0 0x130b 0x57e0 0x956d 0x130b 0x5988 0x954a 0x1333 0x5b30 0x9522 0x134d 0x5cd9 0x94f7 0x1362 0x5e81 0x94d0 0x1378 0x602a 0x94ae 0x1392 0x61d2 0x948c 0x13ba 0x637b 0x946a 0x13ba 0x6523 0x9450 0x13cd 0x66cc 0x9436 0x13f1 0x6874 0x9421 0x141b 0x6a1c 0x9410 0x143e 0x6bc5 0x93ff 0x1457 0x6d6d 0x93ef 0x1480 0x6f16 0x93e6 0x14bf 0x70be 0x93d7 0x14ff 0x7267 0x93cb 0x154b 0x740f 0x93bf 0x15a0 0x75b8 0x93ae 0x15f5 0x7760 0x939c 0x164a 0x7908 0x9383 0x169f 0x7ab1 0x9369 0x1707 0x7c59 0x9350 0x1780 0x7e02 0x9332 0x17ff 0x7faa 0x930d 0x1877 0x8153 0x92e2 0x18ed 0x82fb 0x92b8 0x1996 0x84a4 0x927c 0x1a2b 0x864c 0x9248 0x1af4 0x87f4 0x920a 0x1bad 0x899d 0x91c6 0x1c74 0x8b45 0x9180 0x1d5e 0x8cee 0x9134 0x1e4e 0x8e96 0x90f0 0x1f78 0x903f 0x90bc 0x20b5 0x91e7 0x9090 0x2213 0x9390 0x906f 0x23b9 0x9538 0x9056 0x25a1 0x96e0 0x903a 0x27c9 0x9889 0x900e 0x2a72 0x9a31 0x8f9f 0x2d6e 0x9bda 0x8eb7 0x30b2 0x9d82 0x8d20 0x3473 0x9f2b 0x8ac5 0x3951 0xa0d3 0x878b 0x3d3f 0xa27c 0x827c 0x3501 0xa424 0x7b84 0x2373>;
		battery0_profile_t0_num = <0x64>;
		battery0_profile_t0 = <0x00 0xaa28 0x3b6 0x1a8 0xa9a0 0x3b6 0x34f 0xa920 0x3b6 0x4f7 0xa8a6 0x3b6 0x69e 0xa830 0x3b6 0x846 0xa7b9 0x3bc 0x9ed 0xa742 0x3cd 0xb95 0xa6c3 0x3b8 0xd3c 0xa64b 0x3b6 0xee4 0xa5d5 0x3b6 0x108b 0xa55e 0x3b6 0x1233 0xa4eb 0x3be 0x13da 0xa47b 0x3cf 0x1582 0xa407 0x3cf 0x1729 0xa391 0x3ba 0x18d1 0xa321 0x3c7 0x1a79 0xa2b3 0x3cf 0x1c20 0xa241 0x3cf 0x1dc8 0xa1cc 0x3cf 0x1f6f 0xa15e 0x3cf 0x2117 0xa0f0 0x3cf 0x22be 0xa08a 0x3e2 0x2466 0xa01e 0x3e8 0x260d 0x9fb4 0x3e8 0x27b5 0x9f4f 0x3f0 0x295c 0x9ee9 0x401 0x2b04 0x9e84 0x401 0x2cab 0x9e1e 0x401 0x2e53 0x9dbf 0x412 0x2ffb 0x9d5d 0x40c 0x31a2 0x9cfb 0x401 0x334a 0x9ca0 0x40d 0x34f1 0x9c4b 0x433 0x3699 0x9bf7 0x433 0x3840 0x9ba2 0x447 0x39e8 0x9b4d 0x44c 0x3b8f 0x9af9 0x458 0x3d37 0x9aa9 0x474 0x3ede 0x9a5b 0x49b 0x4086 0x9a06 0x4b0 0x422d 0x99a1 0x49b 0x43d5 0x9920 0x463 0x457c 0x9898 0x424 0x4724 0x9820 0x3ee 0x48cc 0x97bf 0x3cf 0x4a73 0x976c 0x3cd 0x4c1b 0x9728 0x3b8 0x4dc2 0x96ec 0x3c9 0x4f6a 0x96b1 0x3c0 0x5111 0x9675 0x3b6 0x52b9 0x963d 0x3b6 0x5460 0x960a 0x3b6 0x5608 0x95d8 0x3b6 0x57af 0x95a5 0x3b6 0x5957 0x9579 0x3b6 0x5afe 0x954f 0x3c4 0x5ca6 0x9524 0x3cf 0x5e4e 0x94fc 0x3d5 0x5ff5 0x94d9 0x3e8 0x619d 0x94af 0x3e8 0x6344 0x948d 0x3e8 0x64ec 0x946b 0x3f7 0x6693 0x944a 0x401 0x683b 0x942b 0x409 0x69e2 0x9411 0x41a 0x6b8a 0x93f8 0x41a 0x6d31 0x93d6 0x41a 0x6ed9 0x93b4 0x41a 0x7080 0x9392 0x428 0x7228 0x935d 0x40c 0x73cf 0x9311 0x3cf 0x7577 0x92c7 0x3cf 0x771f 0x9294 0x3cf 0x78c6 0x9269 0x3cf 0x7a6e 0x923f 0x3df 0x7c15 0x9210 0x3dc 0x7dbd 0x91e0 0x3cf 0x7f64 0x91b7 0x3cf 0x810c 0x9196 0x3cf 0x82b3 0x9174 0x3e4 0x845b 0x914b 0x3d6 0x8602 0x911b 0x3dd 0x87aa 0x90e0 0x3de 0x8951 0x90a1 0x3d5 0x8af9 0x906d 0x3e8 0x8ca1 0x902a 0x3e8 0x8e48 0x8fd6 0x3c1 0x8ff0 0x8fad 0x3c6 0x9197 0x8f9d 0x3db 0x933f 0x8f95 0x3f0 0x94e6 0x8f8b 0x405 0x968e 0x8f7a 0x41a 0x9835 0x8f58 0x45a 0x99dd 0x8ecd 0x442 0x9b84 0x8d94 0x433 0x9d2c 0x8bbb 0x447 0x9ed3 0x894a 0x47d 0xa07b 0x85f5 0x4f0 0xa222 0x80a9 0x66d 0xa3ca 0x722e 0xcfd>;
		battery0_profile_t1_num = <0x64>;
		battery0_profile_t1 = <0x00 0xaa14 0x596 0x1a8 0xa995 0x592 0x34f 0xa91d 0x5a2 0x4f7 0xa8a6 0x5aa 0x69e 0xa830 0x5b4 0x846 0xa7b9 0x5c3 0x9ed 0xa742 0x5c1 0xb95 0xa6c3 0x5ac 0xd3c 0xa64b 0x597 0xee4 0xa5db 0x5a1 0x108b 0xa568 0x5aa 0x1233 0xa4f2 0x5aa 0x13da 0xa47d 0x5aa 0x1582 0xa40e 0x5aa 0x1729 0xa3a0 0x5bf 0x18d1 0xa32b 0x5b1 0x1a79 0xa2ba 0x5b8 0x1c20 0xa24c 0x5c3 0x1dc8 0xa1de 0x5c3 0x1f6f 0xa170 0x5c3 0x2117 0xa102 0x5c3 0x22be 0xa09b 0x5d7 0x2466 0xa02f 0x5dc 0x260d 0x9fc6 0x5e8 0x27b5 0x9f60 0x5f5 0x295c 0x9efd 0x5f9 0x2b04 0x9ea0 0x60f 0x2cab 0x9e4b 0x63a 0x2e53 0x9de1 0x640 0x2ffb 0x9d6d 0x640 0x31a2 0x9cfa 0x640 0x334a 0x9c91 0x646 0x34f1 0x9c36 0x65c 0x3699 0x9bea 0x671 0x3840 0x9b9e 0x686 0x39e8 0x9b58 0x6ab 0x3b8f 0x9b0f 0x6c9 0x3d37 0x9abc 0x6cd 0x3ede 0x9a5d 0x6bd 0x4086 0x99f7 0x6b9 0x422d 0x9978 0x665 0x43d5 0x98ea 0x5fe 0x457c 0x986b 0x5a2 0x4724 0x9801 0x56d 0x48cc 0x97aa 0x558 0x4a73 0x975f 0x543 0x4c1b 0x971b 0x52e 0x4dc2 0x96df 0x52d 0x4f6a 0x96a4 0x52d 0x5111 0x966e 0x53a 0x52b9 0x963b 0x546 0x5460 0x9608 0x546 0x5608 0x95d6 0x546 0x57af 0x95ab 0x546 0x5957 0x9581 0x559 0x5afe 0x9557 0x55f 0x5ca6 0x952c 0x55f 0x5e4e 0x9505 0x566 0x5ff5 0x94e3 0x578 0x619d 0x94c1 0x578 0x6344 0x949f 0x58d 0x64ec 0x947d 0x591 0x6693 0x9460 0x59e 0x683b 0x9443 0x5aa 0x69e2 0x9423 0x5aa 0x6b8a 0x9409 0x5aa 0x6d31 0x93e7 0x5aa 0x6ed9 0x93cd 0x5aa 0x7080 0x93ad 0x5aa 0x7228 0x938b 0x59e 0x73cf 0x9366 0x589 0x7577 0x933e 0x578 0x771f 0x931c 0x578 0x78c6 0x92f1 0x563 0x7a6e 0x92c7 0x55f 0x7c15 0x929c 0x551 0x7dbd 0x9276 0x546 0x7f64 0x9254 0x54c 0x810c 0x9232 0x55f 0x82b3 0x9210 0x55f 0x845b 0x91df 0x55f 0x8602 0x91ac 0x56f 0x87aa 0x9170 0x56c 0x8951 0x9132 0x567 0x8af9 0x90fc 0x57c 0x8ca1 0x90b8 0x590 0x8e48 0x9063 0x57b 0x8ff0 0x9041 0x58a 0x9197 0x902d 0x59f 0x933f 0x9020 0x5be 0x94e6 0x9015 0x5e9 0x968e 0x9001 0x616 0x9835 0x8fd6 0x655 0x99dd 0x8f2d 0x645 0x9b84 0x8db9 0x650 0x9d2c 0x8bac 0x6a3 0x9ed3 0x88e4 0x744 0xa07b 0x84ad 0x8d6 0xa222 0x7d8d 0xf37 0xa3ca 0x772e 0x197d>;
		battery0_profile_t2_num = <0x64>;
		battery0_profile_t2_col = <0x04>;
		battery0_profile_t2 = <0x00 0xaa3c 0xa8c 0x4d8 0x1a8 0xa9ac 0xa8c 0xca0 0x34f 0xa92a 0xa9d 0xca0 0x4f7 0xa8ab 0xaa5 0xca0 0x69e 0xa830 0xaa5 0xca0 0x846 0xa7b9 0xa9f 0xca0 0x9ed 0xa742 0xa86 0xc61 0xb95 0xa6c3 0xa46 0xb8e 0xd3c 0xa64b 0xa41 0xade 0xee4 0xa5db 0xa41 0xa35 0x108b 0xa568 0xa29 0x9c9 0x1233 0xa4f2 0xa07 0x960 0x13da 0xa47b 0x9f2 0x928 0x1582 0xa404 0x9dd 0x906 0x1729 0xa396 0x9c8 0x8e8 0x18d1 0xa328 0x9c4 0x8d6 0x1a79 0xa2ba 0x9c4 0x8ea 0x1c20 0xa24c 0x9ba 0x908 0x1dc8 0xa1de 0x9b1 0x7c2 0x1f6f 0xa170 0x9c4 0x796 0x2117 0xa102 0x9c4 0x768 0x22be 0xa09b 0x9d8 0x742 0x2466 0xa02f 0x9dd 0x722 0x260d 0x9fc6 0x9dd 0x70d 0x27b5 0x9f64 0x9e5 0x6f3 0x295c 0x9f0a 0xa03 0x6de 0x2b04 0x9ebd 0xa42 0x6d0 0x2cab 0x9e60 0xa57 0x6bb 0x2e53 0x9ddf 0xa36 0x6b7 0x2ffb 0x9d52 0xa1a 0x6af 0x31a2 0x9cca 0xa0f 0x6a8 0x334a 0x9c55 0xa1c 0x69c 0x34f1 0x9bf9 0xa44 0x69e 0x3699 0x9ba5 0xa59 0x69d 0x3840 0x9b60 0xa6e 0x69d 0x39e8 0x9b1c 0xa83 0x69c 0x3b8f 0x9acf 0xa73 0x696 0x3d37 0x9a7a 0xa5a 0x6a0 0x3ede 0x9a21 0xa51 0x6be 0x4086 0x99bb 0xa24 0x6a0 0x422d 0x9944 0x9ba 0x6a8 0x43d5 0x98ce 0x962 0x6a9 0x457c 0x9863 0x91c 0x6b5 0x4724 0x9802 0x8e7 0x6c7 0x48cc 0x97ab 0x8ca 0x6db 0x4a73 0x975e 0x8c4 0x6ff 0x4c1b 0x9713 0x89b 0x71a 0x4dc2 0x96d7 0x898 0x72e 0x4f6a 0x969b 0x898 0x736 0x5111 0x9660 0x898 0x73c 0x52b9 0x9628 0x898 0x735 0x5460 0x95f7 0x89d 0x744 0x5608 0x95cd 0x8b2 0x740 0x57af 0x95a2 0x8c7 0x74a 0x5957 0x9570 0x8b8 0x743 0x5afe 0x9543 0x8b1 0x743 0x5ca6 0x951d 0x8c7 0x740 0x5e4e 0x94fb 0x8ea 0x740 0x5ff5 0x94d7 0x8f9 0x73b 0x619d 0x94ad 0x8e4 0x73b 0x6344 0x948b 0x8f8 0x738 0x64ec 0x9470 0x90d 0x735 0x6693 0x9451 0x915 0x736 0x683b 0x9433 0x91e 0x734 0x69e2 0x941a 0x933 0x734 0x6b8a 0x9400 0x947 0x733 0x6d31 0x93e7 0x947 0x766 0x6ed9 0x93cd 0x95a 0x740 0x7080 0x93b4 0x960 0x787 0x7228 0x939b 0x960 0x75b 0x73cf 0x9384 0x967 0x7fc 0x7577 0x9372 0x979 0x812 0x771f 0x9358 0x979 0x80e 0x78c6 0x9337 0x979 0x814 0x7a6e 0x9315 0x98a 0x815 0x7c15 0x92f3 0x992 0x818 0x7dbd 0x92cd 0x99b 0x81c 0x7f64 0x92a5 0x9b1 0x81b 0x810c 0x9283 0x9c8 0x829 0x82b3 0x9261 0x9f2 0x828 0x845b 0x9230 0xa09 0x828 0x8602 0x91f7 0xa2e 0x81c 0x87aa 0x91bc 0xa63 0x809 0x8951 0x9181 0xa9b 0x7f3 0x8af9 0x9144 0xaca 0x7e1 0x8ca1 0x9100 0xb09 0x7ca 0x8e48 0x90ab 0xb49 0x7c6 0x8ff0 0x9072 0xb88 0x7b7 0x9197 0x9055 0xbe3 0x7a6 0x933f 0x9040 0xc56 0x79b 0x94e6 0x9029 0xce7 0x79b 0x968e 0x9017 0xdac 0x78d 0x9835 0x8ff5 0xeaa 0x76f 0x99dd 0x8f8d 0xfbc 0x75a 0x9b84 0x8e63 0x10bf 0x74d 0x9d2c 0x8c86 0x123f 0x74a 0x9ed3 0x89e8 0x149e 0x74f 0xa07b 0x8620 0x1896 0x732 0xa222 0x802f 0x1ff6 0x6c3 0xa3ca 0x75bc 0x15e0 0x69b>;
		battery0_profile_t3_num = <0x64>;
		battery0_profile_t3_col = <0x04>;
		battery0_profile_t3 = <0x00 0xaa5a 0x1536 0x4d8 0x1a8 0xa9b1 0x1532 0xb32 0x34f 0xa91c 0x1520 0xb32 0x4f7 0xa897 0x150a 0xb32 0x69e 0xa814 0x14d8 0xb32 0x846 0xa791 0x1495 0xb32 0x9ed 0xa71a 0x1480 0xb32 0xb95 0xa6a4 0x146b 0xb32 0xd3c 0xa626 0x142f 0xc14 0xee4 0xa5ad 0x140e 0xbbb 0x108b 0xa536 0x13ed 0xb1a 0x1233 0xa4c3 0x13cb 0xacc 0x13da 0xa455 0x13ba 0xa8e 0x1582 0xa3e6 0x13b9 0xa58 0x1729 0xa370 0x137a 0xa24 0x18d1 0xa300 0x135d 0xa1a 0x1a79 0xa292 0x133a 0x9e7 0x1c20 0xa224 0x1324 0x9ef 0x1dc8 0xa1b6 0x131e 0x9e0 0x1f6f 0xa149 0x1309 0x9d7 0x2117 0xa0e3 0x12f3 0x9b4 0x22be 0xa075 0x12de 0x9ad 0x2466 0xa00e 0x12d9 0x9a4 0x260d 0x9fae 0x12d9 0x99c 0x27b5 0x9f55 0x12d9 0x9ae 0x295c 0x9eff 0x12d5 0x99d 0x2b04 0x9ea2 0x12c0 0x9a2 0x2cab 0x9e33 0x12ab 0x9a3 0x2e53 0x9da9 0x1250 0x9b9 0x2ffb 0x9d14 0x11e6 0x9b7 0x31a2 0x9c87 0x1190 0x9b8 0x334a 0x9c0f 0x115c 0x9c4 0x34f1 0x9bab 0x114b 0x9dd 0x3699 0x9b57 0x1160 0x9f3 0x3840 0x9b0a 0x114e 0xa0b 0x39e8 0x9abe 0x112a 0xa3d 0x3b8f 0x9a6d 0x10ff 0xa4f 0x3d37 0x9a15 0x10cd 0xa85 0x3ede 0x99b6 0x108d 0xa90 0x4086 0x9950 0x104d 0xa9d 0x422d 0x98ea 0xff9 0xab5 0x43d5 0x9885 0xfb6 0xac9 0x457c 0x982a 0xf84 0xaf6 0x4724 0x97d6 0xf64 0xb30 0x48cc 0x9783 0xf4f 0xb7b 0x4a73 0x9738 0xf3a 0xbc7 0x4c1b 0x96f4 0xf24 0xc11 0x4dc2 0x96b1 0xf23 0xc6b 0x4f6a 0x967a 0xf33 0xc8a 0x5111 0x9642 0xf3c 0xcb2 0x52b9 0x960a 0xf44 0xccc 0x5460 0x95d7 0xf5a 0xcec 0x5608 0x95a5 0xf6f 0xce1 0x57af 0x957a 0xf84 0xcef 0x5957 0x9550 0xf99 0xcff 0x5afe 0x9526 0xfae 0xd1a 0x5ca6 0x94ff 0xfce 0xd23 0x5e4e 0x94db 0xfeb 0xd23 0x5ff5 0x94b2 0xff1 0xd41 0x619d 0x9490 0x101b 0xd50 0x6344 0x946e 0x1031 0xd5a 0x64ec 0x9452 0x1067 0xd5e 0x6693 0x9434 0x1081 0xd53 0x683b 0x9416 0x109b 0xd75 0x69e2 0x93fe 0x10da 0xd6a 0x6b8a 0x93ed 0x1119 0xd8a 0x6d31 0x93d3 0x1143 0xd82 0x6ed9 0x93c1 0x116e 0xdbc 0x7080 0x93b0 0x11b5 0xdac 0x7228 0x939f 0x11f4 0xdaf 0x73cf 0x938f 0x1226 0xdb1 0x7577 0x937c 0x126b 0xda8 0x771f 0x9363 0x12d5 0xdcb 0x78c6 0x934a 0x1329 0xdba 0x7a6e 0x9331 0x137d 0xddf 0x7c15 0x9317 0x13de 0xdab 0x7dbd 0x92f7 0x1440 0xdc5 0x7f64 0x92ce 0x14a1 0xdac 0x810c 0x92ab 0x1520 0xdac 0x82b3 0x9281 0x159f 0xdb1 0x845b 0x9248 0x161e 0xd98 0x8602 0x920d 0x169d 0xd6e 0x87aa 0x91d1 0x173d 0xd59 0x8951 0x9196 0x17fc 0xd1f 0x8af9 0x9158 0x18bd 0xcf5 0x8ca1 0x910c 0x1991 0xca1 0x8e48 0x90b7 0x1a50 0xc97 0x8ff0 0x907d 0x1b52 0xc68 0x9197 0x9055 0x1c8d 0xc6a 0x933f 0x9037 0x1e05 0xc1c 0x94e6 0x901e 0x1fc2 0xbf3 0x968e 0x9002 0x21c7 0xc1a 0x9835 0x8fd0 0x2435 0xc49 0x99dd 0x8f63 0x2743 0xc3f 0x9b84 0x8e54 0x2a67 0xc48 0x9d2c 0x8c95 0x2e59 0xc4c 0x9ed3 0x8a16 0x3364 0xc45 0xa07b 0x86a1 0x384a 0xb9b 0xa222 0x80db 0x30d4 0x980 0xa3ca 0x795e 0x1e5f 0x38c>;
		battery0_profile_t4_num = <0x64>;
		battery0_profile_t4 = <0x00 0xaa64 0x238c 0x1a8 0xa9b2 0x238c 0x34f 0xa90e 0x2a42 0x4f7 0xa873 0x2d0e 0x69e 0xa7de 0x2cbb 0x846 0xa74e 0x2c40 0x9ed 0xa6c0 0x2b99 0xb95 0xa641 0x2b04 0xd3c 0xa5c2 0x2a84 0xee4 0xa542 0x29d6 0x108b 0xa4c8 0x2917 0x1233 0xa452 0x2868 0x13da 0xa3dd 0x27c9 0x1582 0xa371 0x26f9 0x1729 0xa303 0x2625 0x18d1 0xa295 0x2574 0x1a79 0xa227 0x24b0 0x1c20 0xa1b9 0x2402 0x1dc8 0xa14a 0x238e 0x1f6f 0xa0dd 0x233b 0x2117 0xa077 0x22fc 0x22be 0xa012 0x22d0 0x2466 0x9fb2 0x22a5 0x260d 0x9f55 0x2286 0x27b5 0x9ef2 0x226a 0x295c 0x9e7f 0x2237 0x2b04 0x9df7 0x21e2 0x2cab 0x9d67 0x2163 0x2e53 0x9cd7 0x2107 0x2ffb 0x9c4d 0x20a5 0x31a2 0x9bc9 0x2031 0x334a 0x9b54 0x1fd6 0x34f1 0x9af7 0x1fd0 0x3699 0x9a99 0x1f90 0x3840 0x9a44 0x1f3d 0x39e8 0x99f6 0x1ef8 0x3b8f 0x99a9 0x1ec4 0x3d37 0x995a 0x1ea2 0x3ede 0x9905 0x1e89 0x4086 0x98b0 0x1e60 0x422d 0x985c 0x1e8a 0x43d5 0x980e 0x1eb4 0x457c 0x97bc 0x1ed1 0x4724 0x9770 0x1f04 0x48cc 0x972c 0x1f4d 0x4a73 0x96e8 0x1f77 0x4c1b 0x96a4 0x1fa1 0x4dc2 0x9669 0x1fdf 0x4f6a 0x962d 0x201f 0x5111 0x95f7 0x205e 0x52b9 0x95c5 0x209d 0x5460 0x9594 0x20d8 0x5608 0x956a 0x2102 0x57af 0x9537 0x212d 0x5957 0x950b 0x2157 0x5afe 0x94e6 0x2181 0x5ca6 0x94c0 0x21ac 0x5e4e 0x9498 0x21d6 0x5ff5 0x9477 0x2205 0x619d 0x945e 0x225a 0x6344 0x9444 0x2287 0x64ec 0x942b 0x22d1 0x6693 0x9416 0x231a 0x683b 0x9405 0x236a 0x69e2 0x93f5 0x23d4 0x6b8a 0x93e4 0x243d 0x6d31 0x93d3 0x24a7 0x6ed9 0x93bb 0x2511 0x7080 0x93a7 0x2597 0x7228 0x9396 0x2636 0x73cf 0x9382 0x26d2 0x7577 0x9369 0x2754 0x771f 0x9350 0x27e8 0x78c6 0x9336 0x28a4 0x7a6e 0x931d 0x2953 0x7c15 0x92fe 0x2a08 0x7dbd 0x92dd 0x2ad8 0x7f64 0x92b9 0x2bbc 0x810c 0x928e 0x2c91 0x82b3 0x9264 0x2d7a 0x845b 0x9232 0x2e63 0x8602 0x9205 0x2f76 0x87aa 0x91d3 0x308a 0x8951 0x9195 0x318f 0x8af9 0x9151 0x32a5 0x8ca1 0x910d 0x33cd 0x8e48 0x90d1 0x34e2 0x8ff0 0x909d 0x3605 0x9197 0x906f 0x3747 0x933f 0x904c 0x38ab 0x94e6 0x9030 0x3a28 0x968e 0x900d 0x3ba9 0x9835 0x8fdb 0x3d66 0x99dd 0x8f6d 0x3f22 0x9b84 0x8e85 0x40cb 0x9d2c 0x8cfd 0x42c0 0x9ed3 0x8ac3 0x44fe 0xa07b 0x87a0 0x41b5 0xa222 0x826a 0x34ca 0xa3ca 0x8142 0x31ce>;
		battery2_profile_t0_num = <0x64>;
		battery2_profile_t0_col = <0x03>;
		battery2_profile_t0 = <0x00 0xa9ec 0x384 0x1aa 0xa95b 0x384 0x354 0xa8d1 0x384 0x4fe 0xa84f 0x384 0x6a7 0xa7d3 0x384 0x851 0xa759 0x384 0x9fb 0xa6db 0x387 0xba5 0xa663 0x39c 0xd4f 0xa5ec 0x389 0xef9 0xa575 0x384 0x10a3 0xa4fe 0x384 0x124c 0xa486 0x384 0x13f6 0xa412 0x389 0x15a0 0xa3a5 0x39d 0x174a 0xa32d 0x39d 0x18f4 0xa2be 0x39d 0x1a9e 0xa24f 0x39d 0x1c48 0xa1e0 0x39d 0x1df1 0xa172 0x3a5 0x1f9b 0xa103 0x3b6 0x2145 0xa094 0x3b6 0x22ef 0xa025 0x3b6 0x2499 0x9fbe 0x3b6 0x2643 0x9f58 0x3b6 0x27ed 0x9ef1 0x3c1 0x2996 0x9e8b 0x3cf 0x2b40 0x9e25 0x3cc 0x2cea 0x9dbf 0x3b7 0x2e94 0x9d61 0x3cb 0x303e 0x9d03 0x3e0 0x31e8 0x9ca6 0x3e8 0x3392 0x9c48 0x3e8 0x353b 0x9bed 0x3e8 0x36e5 0x9b98 0x3ea 0x388f 0x9b4c 0x3ff 0x3a39 0x9af7 0x401 0x3be3 0x9aa9 0x420 0x3d8d 0x9a59 0x433 0x3f37 0x9a07 0x43b 0x40e0 0x99b8 0x450 0x428a 0x9963 0x465 0x4434 0x9905 0x465 0x45de 0x988a 0x440 0x4788 0x97ff 0x3ea 0x4932 0x9788 0x3ab 0x4adc 0x9730 0x39d 0x4c85 0x96e5 0x39d 0x4e2f 0x96a1 0x39d 0x4fd9 0x966d 0x39d 0x5183 0x9633 0x38c 0x532d 0x95fd 0x392 0x54d7 0x95ca 0x39d 0x5681 0x9597 0x397 0x582b 0x9565 0x384 0x59d4 0x953a 0x384 0x5b7e 0x9510 0x398 0x5d28 0x94ec 0x3ad 0x5ed2 0x94c5 0x3a9 0x607c 0x949e 0x3a6 0x6226 0x947c 0x3b6 0x63d0 0x945a 0x3b6 0x6579 0x9438 0x3b6 0x6723 0x941e 0x3c9 0x68cd 0x93fe 0x3cf 0x6a77 0x93e1 0x3da 0x6c21 0x93c7 0x3e8 0x6dcb 0x93ad 0x3ec 0x6f75 0x9394 0x401 0x711e 0x9372 0x3ec 0x72c8 0x9341 0x3d6 0x7472 0x92fe 0x3a5 0x761c 0x92b5 0x384 0x77c6 0x9279 0x384 0x7970 0x924e 0x384 0x7b1a 0x9224 0x384 0x7cc3 0x91f9 0x384 0x7e6d 0x91ce 0x384 0x8017 0x91a9 0x391 0x81c1 0x9187 0x39d 0x836b 0x9165 0x39d 0x8515 0x9141 0x39d 0x86bf 0x910e 0x39d 0x8868 0x90cc 0x389 0x8a12 0x9094 0x394 0x8bbc 0x9058 0x39d 0x8d66 0x9012 0x39d 0x8f10 0x8fca 0x399 0x90ba 0x8f98 0x384 0x9264 0x8f8f 0x39a 0x940d 0x8f87 0x3af 0x95b7 0x8f7e 0x3d3 0x9761 0x8f6d 0x3fd 0x990b 0x8f3b 0x41a 0x9ab5 0x8eac 0x410 0x9c5f 0x8d3e 0x3d0 0x9e09 0x8b31 0x3f9 0x9fb2 0x886f 0x445 0xa15c 0x8450 0x4eb 0xa306 0x7cc5 0x1101 0xa4b0 0x7288 0xd93>;
		battery2_profile_t1_num = <0x64>;
		battery2_profile_t1_col = <0x03>;
		battery2_profile_t1 = <0x00 0xaa32 0x4e2 0x1aa 0xa9b2 0x4e2 0x354 0xa92b 0x4e2 0x4fe 0xa8a9 0x4e2 0x6a7 0xa82d 0x4e2 0x851 0xa7b6 0x4e8 0x9fb 0xa73d 0x4f8 0xba5 0xa6be 0x4e3 0xd4f 0xa646 0x4e2 0xef9 0xa5d5 0x4f3 0x10a3 0xa55c 0x4e1 0x124c 0xa4e4 0x4d2 0x13f6 0xa476 0x4e7 0x15a0 0xa409 0x4fa 0x174a 0xa391 0x4e4 0x18f4 0xa322 0x4f5 0x1a9e 0xa2b3 0x4fb 0x1c48 0xa244 0x506 0x1df1 0xa1d6 0x514 0x1f9b 0xa167 0x514 0x2145 0xa0f8 0x514 0x22ef 0xa089 0x514 0x2499 0xa022 0x526 0x2643 0x9fb6 0x52d 0x27ed 0x9f58 0x542 0x2996 0x9f14 0x573 0x2b40 0x9eda 0x5a7 0x2cea 0x9e7d 0x592 0x2e94 0x9ddd 0x568 0x303e 0x9d34 0x55f 0x31e8 0x9c9f 0x56c 0x3392 0x9c26 0x578 0x353b 0x9bc9 0x57e 0x36e5 0x9b88 0x598 0x388f 0x9b5d 0x5d7 0x3a39 0x9b2b 0x5f0 0x3be3 0x9ae5 0x5e5 0x3d8d 0x9a99 0x5f4 0x3f37 0x9a49 0x60e 0x40e0 0x99f4 0x60e 0x428a 0x999f 0x60d 0x4434 0x9938 0x5f8 0x45de 0x98c4 0x5ac 0x4788 0x9846 0x557 0x4932 0x97cf 0x501 0x4adc 0x976c 0x4c9 0x4c85 0x971f 0x4c6 0x4e2f 0x96d3 0x4b0 0x4fd9 0x9697 0x4b0 0x5183 0x965b 0x49f 0x532d 0x9625 0x497 0x54d7 0x95f2 0x497 0x5681 0x95c2 0x49d 0x582b 0x9597 0x4b0 0x59d4 0x956c 0x4b0 0x5b7e 0x9542 0x4b0 0x5d28 0x9517 0x4b0 0x5ed2 0x94f2 0x4bd 0x607c 0x94cc 0x4c0 0x6226 0x94a6 0x4b5 0x63d0 0x948c 0x4c9 0x6579 0x946a 0x4c9 0x6723 0x9448 0x4c9 0x68cd 0x942c 0x4d8 0x6a77 0x9413 0x4ed 0x6c21 0x93f6 0x4f3 0x6dcb 0x93d5 0x4e2 0x6f75 0x93bc 0x4e2 0x711e 0x93a2 0x4e2 0x72c8 0x9389 0x4e2 0x7472 0x936a 0x4d4 0x761c 0x9348 0x4bf 0x77c6 0x9325 0x4a9 0x7970 0x9303 0x497 0x7b1a 0x92e1 0x497 0x7cc3 0x92b7 0x483 0x7e6d 0x9293 0x48f 0x8017 0x9271 0x4a4 0x81c1 0x924f 0x4b0 0x836b 0x922d 0x4b0 0x8515 0x9209 0x4b0 0x86bf 0x91d6 0x4b0 0x8868 0x9194 0x4b0 0x8a12 0x9156 0x4b0 0x8bbc 0x9120 0x4bc 0x8d66 0x90e0 0x4c1 0x8f10 0x908f 0x4b4 0x90ba 0x904b 0x4c9 0x9264 0x9032 0x4b3 0x940d 0x9027 0x4d4 0x95b7 0x9019 0x4f0 0x9761 0x9007 0x510 0x990b 0x8fee 0x542 0x9ab5 0x8fab 0x575 0x9c5f 0x8ede 0x55f 0x9e09 0x8d18 0x574 0x9fb2 0x8ab6 0x5bc 0xa15c 0x875d 0x662 0xa306 0x814f 0xc2f 0xa4b0 0x7b0c 0x22dd>;
		battery2_profile_t2_num = <0x64>;
		battery2_profile_t2_col = <0x03>;
		battery2_profile_t2 = <0x00 0xaa46 0x8fc 0x1aa 0xa9ad 0x8fc 0x354 0xa91a 0x8fc 0x4fe 0xa895 0x90a 0x6a7 0xa815 0x915 0x851 0xa798 0x90f 0x9fb 0xa721 0x8f9 0xba5 0xa6a9 0x8e4 0xd4f 0xa632 0x8ba 0xef9 0xa5bb 0x8a0 0x10a3 0xa544 0x88b 0x124c 0xa4d0 0x87f 0x13f6 0xa462 0x87f 0x15a0 0xa3f5 0x87f 0x174a 0xa386 0x87f 0x18f4 0xa310 0x86c 0x1a9e 0xa2a5 0x875 0x1c48 0xa23a 0x87f 0x1df1 0xa1cc 0x887 0x1f9b 0xa15d 0x898 0x2145 0xa0ee 0x898 0x22ef 0xa07f 0x898 0x2499 0xa018 0x898 0x2643 0x9fbd 0x898 0x27ed 0x9f75 0x8c2 0x2996 0x9f39 0x91e 0x2b40 0x9ef3 0x973 0x2cea 0x9e74 0x948 0x2e94 0x9dba 0x909 0x303e 0x9cfe 0x8da 0x31e8 0x9c63 0x8d7 0x3392 0x9be6 0x8e3 0x353b 0x9b81 0x8e3 0x36e5 0x9b37 0x8ec 0x388f 0x9b04 0x941 0x3a39 0x9ad8 0x982 0x3be3 0x9aa8 0x9a2 0x3d8d 0x9a67 0x993 0x3f37 0x9a1b 0x979 0x40e0 0x99cb 0x970 0x428a 0x996c 0x945 0x4434 0x98fe 0x905 0x45de 0x9888 0x8a0 0x4788 0x9816 0x845 0x4932 0x97b0 0x805 0x4adc 0x9755 0x7db 0x4c85 0x9701 0x7b4 0x4e2f 0x96b5 0x79e 0x4fd9 0x9679 0x79e 0x5183 0x9644 0x79e 0x532d 0x9611 0x79e 0x54d7 0x95de 0x7a8 0x5681 0x95ab 0x7b1 0x582b 0x9579 0x79e 0x59d4 0x954e 0x79e 0x5b7e 0x9524 0x79e 0x5d28 0x9500 0x7bf 0x5ed2 0x94de 0x7d0 0x607c 0x94bc 0x7d0 0x6226 0x949a 0x7d5 0x63d0 0x9478 0x7e9 0x6579 0x9456 0x7e9 0x6723 0x943c 0x7fc 0x68cd 0x9422 0x802 0x6a77 0x9409 0x802 0x6c21 0x93ef 0x802 0x6dcb 0x93d5 0x802 0x6f75 0x93bc 0x802 0x711e 0x93ab 0x802 0x72c8 0x939a 0x814 0x7472 0x9389 0x80d 0x761c 0x9378 0x80c 0x77c6 0x9367 0x822 0x7970 0x9355 0x834 0x7b1a 0x933b 0x834 0x7cc3 0x9319 0x834 0x7e6d 0x92f0 0x834 0x8017 0x92c6 0x834 0x81c1 0x929f 0x83d 0x836b 0x927d 0x858 0x8515 0x9259 0x883 0x86bf 0x9226 0x8ad 0x8868 0x91e4 0x8b1 0x8a12 0x91a6 0x8d1 0x8bbc 0x916a 0x8fb 0x8d66 0x9128 0x926 0x8f10 0x90d9 0x94c 0x90ba 0x9086 0x963 0x9264 0x9064 0x9a3 0x940d 0x9051 0x9f5 0x95b7 0x903a 0xa59 0x9761 0x9021 0xaf0 0x990b 0x8ffe 0xbd5 0x9ab5 0x8fb8 0xcfc 0x9c5f 0x8f15 0xe10 0x9e09 0x8d6b 0xebb 0x9fb2 0x8b11 0x107f 0xa15c 0x87ba 0x13e8 0xa306 0x8218 0x1da1 0xa4b0 0x74b8 0x1275>;
		battery2_profile_t3_num = <0x64>;
		battery2_profile_t3_col = <0x03>;
		battery2_profile_t3 = <0x00 0xaa46 0xfa0 0x1aa 0xa9a4 0xfa0 0x354 0xa902 0x1073 0x4fe 0xa871 0x10be 0x6a7 0xa7e9 0x108a 0x851 0xa766 0x104f 0x9fb 0xa6ef 0x104f 0xba5 0xa677 0x104f 0xd4f 0xa600 0x103b 0xef9 0xa589 0x1036 0x10a3 0xa512 0x101c 0x124c 0xa49a 0xff2 0x13f6 0xa426 0xfcd 0x15a0 0xa3ba 0xfb9 0x174a 0xa354 0xfb9 0x18f4 0xa2e6 0xfa6 0x1a9e 0xa277 0xf91 0x1c48 0xa208 0xf87 0x1df1 0xa19a 0xf77 0x1f9b 0xa12c 0xf59 0x2145 0xa0c6 0xf6e 0x22ef 0xa060 0xf58 0x2499 0xa001 0xf55 0x2643 0x9fb4 0xf8e 0x27ed 0x9f70 0xfe3 0x2996 0x9f21 0x101d 0x2b40 0x9eb2 0x1011 0x2cea 0x9e10 0xfbb 0x2e94 0x9d4e 0xf3d 0x303e 0x9c9e 0xef0 0x31e8 0x9c0e 0xecb 0x3392 0x9b9a 0xebf 0x353b 0x9b3b 0xec5 0x36e5 0x9aef 0xed8 0x388f 0x9aab 0xed8 0x3a39 0x9a6f 0xf00 0x3be3 0x9a34 0xf0a 0x3d8d 0x99ef 0xef2 0x3f37 0x999c 0xec0 0x40e0 0x993f 0xe80 0x428a 0x98e1 0xe40 0x4434 0x987a 0xe00 0x45de 0x981b 0xdc0 0x4788 0x97be 0xd80 0x4932 0x9769 0xd56 0x4adc 0x971c 0xd3a 0x4c85 0x96d1 0xd13 0x4e2f 0x968d 0xcfd 0x4fd9 0x9651 0xce8 0x5183 0x9615 0xce4 0x532d 0x95df 0xce4 0x54d7 0x95b0 0xcee 0x5681 0x9583 0xcfd 0x582b 0x9552 0xd00 0x59d4 0x9530 0xd15 0x5b7e 0x9506 0xd3e 0x5d28 0x94db 0xd48 0x5ed2 0x94b6 0xd61 0x607c 0x9494 0xd83 0x6226 0x9472 0xd98 0x63d0 0x9450 0xdae 0x6579 0x9437 0xdc2 0x6723 0x941e 0xdd8 0x68cd 0x9404 0xdde 0x6a77 0x93ef 0xde9 0x6c21 0x93de 0xdff 0x6dcb 0x93ce 0xe1f 0x6f75 0x93c6 0xe74 0x711e 0x93b5 0xe89 0x72c8 0x93ab 0xec2 0x7472 0x939d 0xef4 0x761c 0x938c 0xf29 0x77c6 0x937b 0xf69 0x7970 0x9367 0xfa6 0x7b1a 0x9345 0xfd0 0x7cc3 0x932b 0x100f 0x7e6d 0x930b 0x1060 0x8017 0x92e4 0x10a8 0x81c1 0x92bd 0x1104 0x836b 0x9296 0x117e 0x8515 0x9263 0x11e9 0x86bf 0x9227 0x1253 0x8868 0x91eb 0x12be 0x8a12 0x91a9 0x1348 0x8bbc 0x9166 0x13e7 0x8d66 0x9123 0x149f 0x8f10 0x90df 0x1578 0x90ba 0x909b 0x1664 0x9264 0x9068 0x178e 0x940d 0x9043 0x1900 0x95b7 0x9021 0x1ab9 0x9761 0x8ff6 0x1ccd 0x990b 0x8fb5 0x1f52 0x9ab5 0x8f49 0x224c 0x9c5f 0x8e8e 0x259f 0x9e09 0x8d13 0x2946 0x9fb2 0x8adb 0x2ebe 0xa15c 0x87aa 0x367b 0xa306 0x8301 0x35df 0xa4b0 0x77f6 0x1adb>;
		battery2_profile_t4_num = <0x64>;
		battery2_profile_t4_col = <0x03>;
		battery2_profile_t4 = <0x00 0xaa3c 0x2152 0x1aa 0xa9b4 0x214e 0x354 0xa8fa 0x235d 0x4fe 0xa847 0x2465 0x6a7 0xa7a5 0x2490 0x851 0xa711 0x2499 0x9fb 0xa689 0x2478 0xba5 0xa60a 0x240e 0xd4f 0xa582 0x2352 0xef9 0xa507 0x22c4 0x10a3 0xa490 0x225e 0x124c 0xa418 0x2209 0x13f6 0xa3a6 0x21b4 0x15a0 0xa33e 0x215f 0x174a 0xa2c7 0x210a 0x18f4 0xa257 0x2102 0x1a9e 0xa1e4 0x20d4 0x1c48 0xa172 0x20ac 0x1df1 0xa104 0x208e 0x1f9b 0xa098 0x206c 0x2145 0xa03b 0x206c 0x22ef 0x9fee 0x2082 0x2499 0x9f9a 0x20bb 0x2643 0x9f34 0x20a5 0x27ed 0x9eb0 0x2050 0x2996 0x9e0f 0x1fc4 0x2b40 0x9d5d 0x1ef5 0x2cea 0x9cb3 0x1e4b 0x2e94 0x9c21 0x1db5 0x303e 0x9b9e 0x1d53 0x31e8 0x9b2e 0x1d26 0x3392 0x9ad0 0x1d1a 0x353b 0x9a7d 0x1d20 0x36e5 0x9a31 0x1d3a 0x388f 0x99ed 0x1d79 0x3a39 0x9999 0x1d6a 0x3be3 0x994a 0x1d85 0x3d8d 0x98f9 0x1d72 0x3f37 0x98a7 0x1d55 0x40e0 0x9859 0x1d60 0x428a 0x9805 0x1d4b 0x4434 0x97b9 0x1d36 0x45de 0x976c 0x1d33 0x4788 0x971f 0x1d24 0x4932 0x96d7 0x1d1a 0x4adc 0x9696 0x1d1a 0x4c85 0x9659 0x1d17 0x4e2f 0x9615 0x1d01 0x4fd9 0x95e1 0x1d16 0x5183 0x95ae 0x1d2b 0x532d 0x957b 0x1d33 0x54d7 0x954c 0x1d47 0x5681 0x9522 0x1d6b 0x582b 0x94f7 0x1d81 0x59d4 0x94cc 0x1d96 0x5b7e 0x94aa 0x1dbf 0x5d28 0x9488 0x1dd9 0x5ed2 0x946b 0x1dfb 0x607c 0x9455 0x1e38 0x6226 0x9442 0x1e7d 0x63d0 0x9429 0x1e96 0x6579 0x9418 0x1ed6 0x6723 0x940e 0x1f29 0x68cd 0x9400 0x1f7e 0x6a77 0x93ef 0x1fde 0x6c21 0x93e1 0x204e 0x6dcb 0x93d7 0x20ce 0x6f75 0x93c6 0x214e 0x711e 0x93b5 0x21ce 0x72c8 0x93a4 0x2271 0x7472 0x938d 0x231b 0x761c 0x9374 0x23bb 0x77c6 0x935a 0x245d 0x7970 0x9341 0x2523 0x7b1a 0x9327 0x260d 0x7cc3 0x9305 0x26f7 0x7e6d 0x92e3 0x27f2 0x8017 0x92bc 0x28e5 0x81c1 0x9291 0x29f4 0x836b 0x9267 0x2b39 0x8515 0x923b 0x2c8e 0x86bf 0x91ff 0x2de3 0x8868 0x91c3 0x2f37 0x8a12 0x918e 0x30cb 0x8bbc 0x9156 0x3269 0x8d66 0x911a 0x3417 0x8f10 0x90e1 0x35f0 0x90ba 0x90ae 0x37d9 0x9264 0x907c 0x39b9 0x940d 0x9049 0x3b7d 0x95b7 0x9016 0x3d3d 0x9761 0x8fde 0x3efc 0x990b 0x8f95 0x40a6 0x9ab5 0x8f27 0x4236 0x9c5f 0x8e8d 0x441f 0x9e09 0x8d4d 0x461e 0x9fb2 0x8b57 0x48b0 0xa15c 0x8870 0x43c1 0xa306 0x83e2 0x38a8 0xa4b0 0x80fc 0x3138>;
		linux,phandle = <0x88>;
		phandle = <0x88>;
	};

	topmisc@10011000 {
		compatible = "mediatek,topmisc";
		reg = <0x00 0x10011000 0x00 0x1000>;
	};

	dvfsrc@10012000 {
		compatible = "mediatek,dvfsrc";
		reg = <0x00 0x10012000 0x00 0x1000 0x00 0x110780 0x00 0x80>;
	};

	mbist_ao@10013000 {
		compatible = "mediatek,mbist_ao";
		reg = <0x00 0x10013000 0x00 0x1000>;
	};

	apcldmain_ao@10014000 {
		compatible = "mediatek,apcldmain_ao";
		reg = <0x00 0x10014000 0x00 0x400>;
	};

	apcldmaout_ao@10014400 {
		compatible = "mediatek,apcldmaout_ao";
		reg = <0x00 0x10014400 0x00 0x400>;
	};

	apcldmamisc_ao@10014800 {
		compatible = "mediatek,apcldmamisc_ao";
		reg = <0x00 0x10014800 0x00 0x400>;
	};

	ddrphy@10015000 {
		compatible = "mediatek,ddrphy";
		reg = <0x00 0x10015000 0x00 0x1000>;
	};

	aes_top0@10016000 {
		compatible = "mediatek,aes_top0";
		reg = <0x00 0x10016000 0x00 0x1000>;
	};

	sys_timer@10017000 {
		compatible = "mediatek,sys_timer";
		reg = <0x00 0x10017000 0x00 0x1000>;
		reg-names = "sys_timer_base";
		interrupts = <0x00 0xc2 0x04>;
	};

	modem_temp_share@10018000 {
		compatible = "mediatek,modem_temp_share";
		reg = <0x00 0x10018000 0x00 0x1000>;
	};

	security_ao@1001a000 {
		compatible = "mediatek,security_ao";
		reg = <0x00 0x1001a000 0x00 0x1000>;
	};

	topckgen_ao@1001b000 {
		compatible = "mediatek,topckgen_ao";
		reg = <0x00 0x1001b000 0x00 0x1000>;
	};

	dramc0@1001d000 {
		compatible = "mediatek,dramc0";
		reg = <0x00 0x1001d000 0x00 0x1000>;
	};

	ddrphy@1001e000 {
		compatible = "mediatek,ddrphy";
		reg = <0x00 0x1001e000 0x00 0x1000>;
	};

	iocfg_0@10002000 {
		compatible = "mediatek,iocfg_0";
		reg = <0x00 0x10002000 0x00 0x200>;
	};

	iocfg_1@10002200 {
		compatible = "mediatek,iocfg_1";
		reg = <0x00 0x10002200 0x00 0x200>;
	};

	iocfg_2@10002400 {
		compatible = "mediatek,iocfg_2";
		reg = <0x00 0x10002400 0x00 0x200>;
	};

	iocfg_3@10002600 {
		compatible = "mediatek,iocfg_3";
		reg = <0x00 0x10002600 0x00 0x200>;
	};

	iocfg_4@10002800 {
		compatible = "mediatek,iocfg_4";
		reg = <0x00 0x10002800 0x00 0x200>;
	};

	iocfg_5@10002a00 {
		compatible = "mediatek,iocfg_5";
		reg = <0x00 0x10002a00 0x00 0x200>;
	};

	mdcldmain_ao@10015000 {
		compatible = "mediatek,mdcldmain_ao";
		reg = <0x00 0x10015000 0x00 0x400>;
	};

	mdcldmaout_ao@10015400 {
		compatible = "mediatek,mdcldmaout_ao";
		reg = <0x00 0x10015400 0x00 0x400>;
	};

	mdcldmamisc_ao@10015800 {
		compatible = "mediatek,mdcldmamisc_ao";
		reg = <0x00 0x10015800 0x00 0x400>;
	};

	sys_cirq@10204000 {
		compatible = "mediatek,sys_cirq";
		reg = <0x00 0x10204000 0x00 0x1000>;
		mediatek,cirq_num = <0xd1>;
		mediatek,spi_start_offset = <0x48>;
		interrupts = <0x00 0x118 0x08>;
	};

	mcucfg@10200000 {
		compatible = "mediatek,mcucfg";
		reg = <0x00 0x10200000 0x00 0x1000>;
		interrupts = <0x00 0x00 0x08>;
	};

	mcucfg_mp0_counter@10200000 {
		compatible = "mediatek,mcucfg_mp0_counter";
		reg = <0x00 0x10200000 0x00 0x4000>;
	};

	m4u@10205000 {
		cell-index = <0x00>;
		compatible = "mediatek,iommu_v0";
		reg = <0x00 0x10205000 0x00 0x1000>;
		mediatek,larbs = <0x22 0x23 0x24 0x25>;
		interrupts = <0x00 0x9e 0x08>;
		#iommu-cells = <0x01>;
		linux,phandle = <0x56>;
		phandle = <0x56>;
	};

	devapc@10207000 {
		compatible = "mediatek,devapc";
		reg = <0x00 0x10207000 0x00 0x1000 0x00 0x1000e000 0x00 0x1000>;
		interrupts = <0x00 0x8e 0x08>;
		clocks = <0x26 0x28>;
		clock-names = "devapc-infra-clock";
	};

	bus_dbg@10208000 {
		compatible = "mediatek,bus_dbg-v2";
		reg = <0x00 0x10208000 0x00 0x1000 0x00 0x10001000 0x00 0x1000>;
		mediatek,bus_dbg_con_offset = <0x2fc>;
		interrupts = <0x00 0x8d 0x08>;
	};

	ap_ccif0@10209000 {
		compatible = "mediatek,ap_ccif0";
		reg = <0x00 0x10209000 0x00 0x1000>;
		interrupts = <0x00 0x94 0x08>;
	};

	md_ccif0@1020a000 {
		compatible = "mediatek,md_ccif0";
		reg = <0x00 0x1020a000 0x00 0x1000>;
	};

	ap_ccif1@1020b000 {
		compatible = "mediatek,ap_ccif1";
		reg = <0x00 0x1020b000 0x00 0x1000>;
		interrupts = <0x00 0x96 0x08>;
	};

	md_ccif1@1020c000 {
		compatible = "mediatek,md_ccif1";
		reg = <0x00 0x1020c000 0x00 0x1000>;
	};

	infra_mbist@1020d000 {
		compatible = "mediatek,infra_mbist";
		reg = <0x00 0x1020d000 0x00 0x1000>;
	};

	infracfg@1020e000 {
		compatible = "mediatek,infracfg";
		reg = <0x00 0x1020e000 0x00 0x1000>;
	};

	trng@1020f000 {
		compatible = "mediatek,trng";
		reg = <0x00 0x1020f000 0x00 0x1000>;
		interrupts = <0x00 0xa1 0x08>;
	};

	dxcc_sec@10210000 {
		compatible = "mediatek,dxcc_sec";
		reg = <0x00 0x10210000 0x00 0x1000>;
		interrupts = <0x00 0xa2 0x04>;
	};

	mcupm_sram2@10211000 {
		compatible = "mediatek,mcupm_sram2";
		reg = <0x00 0x10211000 0x00 0x1000>;
	};

	cq_dma@10212000 {
		compatible = "mediatek,mt-cqdma-v1";
		reg = <0x00 0x10212000 0x00 0x80 0x00 0x10212080 0x00 0x80>;
		interrupts = <0x00 0x71 0x08 0x00 0x72 0x08>;
		nr_channel = <0x02>;
		keep_clock_ao = "yes";
		clocks = <0x26 0x43>;
		clock-names = "cqdma";
	};

	mcupm_sram3@10213000 {
		compatible = "mediatek,mcupm_sram3";
		reg = <0x00 0x10213000 0x00 0x1000>;
	};

	sramrom@10214000 {
		compatible = "mediatek,sramrom";
		reg = <0x00 0x10214000 0x00 0x1000>;
	};

	mcupm_reg@10216000 {
		compatible = "mediatek,mcupm_reg";
		reg = <0x00 0x10216000 0x00 0x1000>;
	};

	mcupm_sram0@10217000 {
		compatible = "mediatek,mcupm_sram0";
		reg = <0x00 0x10217000 0x00 0x1000>;
	};

	mcupm_sram1@10218000 {
		compatible = "mediatek,mcupm_sram1";
		reg = <0x00 0x10218000 0x00 0x1000>;
	};

	emi@10219000 {
		compatible = "mediatek,emi";
		reg = <0x00 0x10219000 0x00 0x1000 0x00 0x10226000 0x00 0x1000 0x00 0x1022d000 0x00 0x1000 0x00 0x10235000 0x00 0x1000>;
		interrupts = <0x00 0x90 0x08>;
	};

	apcldmain@1021b000 {
		compatible = "mediatek,apcldmain";
		reg = <0x00 0x1021b000 0x00 0x00>;
	};

	apcldmaout@1021b400 {
		compatible = "mediatek,apcldmaout";
		reg = <0x00 0x1021b400 0x00 0x00>;
	};

	apcldmamisc@1021b800 {
		compatible = "mediatek,apcldmamisc";
		reg = <0x00 0x1021b800 0x00 0x00>;
		interrupts = <0x00 0xa5 0x04>;
	};

	mdcldmain@1021c000 {
		compatible = "mediatek,mdcldmain";
		reg = <0x00 0x1021c000 0x00 0x400>;
	};

	mdcldmaout@1021c400 {
		compatible = "mediatek,mdcldmaout";
		reg = <0x00 0x1021c400 0x00 0x400>;
	};

	mdcldmamisc@1021c800 {
		compatible = "mediatek,mdcldmamisc";
		reg = <0x00 0x1021c800 0x00 0x1000>;
	};

	mdcldma@10014000 {
		compatible = "mediatek,mdcldma";
		reg = <0x00 0x10014000 0x00 0x1000 0x00 0x1021b000 0x00 0x1000 0x00 0x10209000 0x00 0x1000 0x00 0x1020a000 0x00 0x1000>;
		interrupts = <0x00 0xa5 0x04 0x00 0x94 0x08 0x00 0x95 0x08 0x00 0x105 0x02>;
		mediatek,md_id = <0x00>;
		mediatek,cldma_capability = <0x06>;
		clocks = <0x27 0x00 0x26 0x32 0x26 0x29 0x26 0x2c 0x26 0x23 0x26 0x24 0x26 0x51 0x26 0x52>;
		clock-names = "scp-sys-md1-main\0infra-cldma-bclk\0infra-ccif-ap\0infra-ccif-md\0infra-ccif1-ap\0infra-ccif1-md\0infra-ccif2-ap\0infra-ccif2-md";
		linux,phandle = <0x1c>;
		phandle = <0x1c>;
	};

	dramc_nao@1021d000 {
		compatible = "mediatek,dramc_nao";
		reg = <0x00 0x1021d000 0x00 0x1000>;
	};

	bpi_bsi_slv0@1021e000 {
		compatible = "mediatek,bpi_bsi_slv0";
		reg = <0x00 0x1021e000 0x00 0x1000>;
	};

	bpi_bsi_slv1@1021f000 {
		compatible = "mediatek,bpi_bsi_slv1";
		reg = <0x00 0x1021f000 0x00 0x6000>;
	};

	bpi_bsi_slv2@10225000 {
		compatible = "mediatek,bpi_bsi_slv2";
		reg = <0x00 0x10225000 0x00 0x1000>;
	};

	dvfsp@10227000 {
		compatible = "mediatek,dvfsp";
		reg = <0x00 0x10227000 0x00 0x1000>;
	};

	dvfsp@00110800 {
		compatible = "mediatek,mt6765-dvfsp";
		reg = <0x00 0x110800 0x00 0x1400 0x00 0x110800 0x00 0x1400>;
	};

	eem_fsm@1100b000 {
		compatible = "mediatek,eem_fsm";
		reg = <0x00 0x1100b000 0x00 0x1000>;
		interrupts = <0x00 0x7d 0x08>;
	};

	dramc@1022a000 {
		compatible = "mediatek,dramc";
		reg = <0x00 0x1022a000 0x00 0x2000 0x00 0x10232000 0x00 0x2000 0x00 0x1022c000 0x00 0x1000 0x00 0x10234000 0x00 0x1000 0x00 0x10228000 0x00 0x2000 0x00 0x10230000 0x00 0x2000 0x00 0x1022e000 0x00 0x1000 0x00 0x10236000 0x00 0x1000>;
	};

	gce@10238000 {
		compatible = "mediatek,gce\0syscon";
		reg = <0x00 0x10238000 0x00 0x4000>;
		#clock-cells = <0x01>;
		interrupts = <0x00 0x9a 0x08 0x00 0x9b 0x08>;
		g3d_config_base = <0x13000000 0x00 0xffff0000>;
		mmsys_config_base = <0x14000000 0x01 0xffff0000>;
		disp_dither_base = <0x14010000 0x02 0xffff0000>;
		mm_na_base = <0x14020000 0x03 0xffff0000>;
		imgsys_base = <0x15020000 0x04 0xffff0000>;
		vdec_gcon_base = <0x18800000 0x05 0xffff0000>;
		venc_gcon_base = <0x18810000 0x06 0xffff0000>;
		conn_peri_base = <0x18820000 0x07 0xffff0000>;
		topckgen_base = <0x18830000 0x08 0xffff0000>;
		kp_base = <0x18840000 0x09 0xffff0000>;
		scp_sram_base = <0x10000000 0x0a 0xffff0000>;
		infra_na3_base = <0x10010000 0x0b 0xffff0000>;
		infra_na4_base = <0x10020000 0x0c 0xffff0000>;
		scp_base = <0x10030000 0x0d 0xffff0000>;
		mcucfg_base = <0x10040000 0x0e 0xffff0000>;
		gcpu_base = <0x10050000 0x0f 0xffff0000>;
		usb0_base = <0x10200000 0x10 0xffff0000>;
		usb_sif_base = <0x10280000 0x11 0xffff0000>;
		audio_base = <0x17000000 0x12 0xffff0000>;
		vdec_base = <0x17010000 0x13 0xffff0000>;
		msdc2_base = <0x17020000 0x14 0xffff0000>;
		vdec1_base = <0x17030000 0x15 0xffff0000>;
		msdc3_base = <0x18000000 0x16 0xffff0000>;
		ap_dma_base = <0x18010000 0x17 0xffff0000>;
		gce_base = <0x18020000 0x18 0xffff0000>;
		vdec2_base = <0x18040000 0x19 0xffff0000>;
		vdec3_base = <0x18050000 0x1a 0xffff0000>;
		camsys_base = <0x18080000 0x1b 0xffff0000>;
		camsys1_base = <0x180a0000 0x1c 0xffff0000>;
		camsys2_base = <0x180b0000 0x1d 0xffff0000>;
		pwm_sw_base = <0x1100e000 0x63 0xffff0000>;
		mipitx0_base = <0x11c80000 0x63 0xffff0000>;
		mdp_rdma0_sof = <0x00>;
		mdp_ccorr0_sof = <0x01>;
		mdp_rsz0_sof = <0x02>;
		mdp_rsz1_sof = <0x03>;
		mdp_wdma_sof = <0x04>;
		mdp_wrot0_sof = <0x05>;
		mdp_tdshp0_sof = <0x06>;
		disp_ovl0_sof = <0x07>;
		disp_2l_ovl0_sof = <0x08>;
		disp_rdma0_sof = <0x09>;
		disp_wdma0_sof = <0x0a>;
		disp_color0_sof = <0x0b>;
		disp_ccorr0_sof = <0x0c>;
		disp_aal0_sof = <0x0d>;
		disp_gamma0_sof = <0x0e>;
		disp_dither0_sof = <0x0f>;
		disp_dsi0_sof = <0x10>;
		disp_rsz0_sof = <0x11>;
		img_dl_relay_sof = <0x12>;
		disp_pwm0_sof = <0x13>;
		mdp_rdma0_frame_done = <0x14>;
		mdp_ccorr0_frame_done = <0x15>;
		mdp_rsz0_frame_done = <0x16>;
		mdp_rsz1_frame_done = <0x17>;
		mdp_wrot0_write_frame_done = <0x18>;
		mdp_wdma_frame_done = <0x19>;
		mdp_tdshp0_frame_done = <0x1a>;
		disp_ovl0_frame_done = <0x1b>;
		disp_2l_ovl0_frame_done = <0x1c>;
		disp_rsz0_frame_done = <0x1d>;
		disp_rdma0_frame_done = <0x1e>;
		disp_wdma0_frame_done = <0x1f>;
		disp_color0_frame_done = <0x20>;
		disp_ccorr0_frame_done = <0x21>;
		disp_aal0_frame_done = <0x22>;
		disp_gamma0_frame_done = <0x23>;
		disp_dither0_frame_done = <0x24>;
		disp_dsi0_frame_done = <0x25>;
		stream_done_0 = <0x82>;
		stream_done_1 = <0x83>;
		stream_done_2 = <0x84>;
		stream_done_3 = <0x85>;
		stream_done_4 = <0x86>;
		stream_done_5 = <0x87>;
		stream_done_6 = <0x88>;
		stream_done_7 = <0x89>;
		stream_done_8 = <0x8a>;
		stream_done_9 = <0x8b>;
		buf_underrun_event_0 = <0x8c>;
		dsi0_te_event = <0x8d>;
		dsi0_irq_event = <0x8e>;
		dsi0_done_event = <0x8f>;
		disp_wdma0_rst_done = <0x93>;
		mdp_wdma_rst_done = <0x94>;
		mdp_wrot0_rst_done = <0x95>;
		mdp_rdma0_rst_done = <0x97>;
		disp_ovl0_frame_rst_done_pusle = <0x98>;
		dip_cq_thread0_frame_done = <0x101>;
		dip_cq_thread1_frame_done = <0x102>;
		dip_cq_thread2_frame_done = <0x103>;
		dip_cq_thread3_frame_done = <0x104>;
		dip_cq_thread4_frame_done = <0x105>;
		dip_cq_thread5_frame_done = <0x106>;
		dip_cq_thread6_frame_done = <0x107>;
		dip_cq_thread7_frame_done = <0x108>;
		dip_cq_thread8_frame_done = <0x109>;
		dip_cq_thread9_frame_done = <0x10a>;
		dip_cq_thread10_frame_done = <0x10b>;
		dip_cq_thread11_frame_done = <0x10c>;
		dip_cq_thread12_frame_done = <0x10d>;
		dip_cq_thread13_frame_done = <0x10e>;
		dip_cq_thread14_frame_done = <0x10f>;
		dip_cq_thread15_frame_done = <0x110>;
		dip_cq_thread16_frame_done = <0x111>;
		dip_cq_thread17_frame_done = <0x112>;
		dip_cq_thread18_frame_done = <0x113>;
		dve_frame_done = <0x114>;
		wmf_frame_done = <0x115>;
		rsc_frame_done = <0x116>;
		venc_done = <0x121>;
		jpgenc_done = <0x122>;
		jpgdec_done = <0x123>;
		venc_mb_done = <0x124>;
		venc_128byte_cnt_done = <0x125>;
		max_prefetch_cnt = <0x01>;
		prefetch_size = <0x60>;
		sram_size_cpr_64 = <0x40>;
		mmsys_config = <0x28>;
		mdp_rdma0 = <0x29>;
		mdp_rsz0 = <0x2a>;
		mdp_rsz1 = <0x2b>;
		mdp_wdma0 = <0x2c>;
		mdp_wrot0 = <0x2d>;
		mdp_tdshp0 = <0x2e>;
		mdp_color0 = <0x2f>;
		mdp_ccorr0 = <0x30>;
		mm_mutex = <0x31>;
		sram_share_cnt = <0x01>;
		sram_share_engine = <0x0a>;
		sram_share_event = <0x2c6>;
		clocks = <0x26 0x09 0x26 0x18>;
		clock-names = "GCE\0GCE_TIMER";
		mediatek,mailbox-gce = <0x32>;
		thread_count = <0x10>;
		secure_thread = <0x08 0x0a>;
		mboxes = <0x32 0x00 0x00 0x04 0x32 0x01 0x00 0x04 0x32 0x02 0x00 0x05 0x32 0x03 0x00 0x04 0x32 0x04 0x00 0x04 0x32 0x05 0x00 0x04 0x32 0x06 0x00 0x03 0x32 0x07 0xffffffff 0x02 0x32 0x08 0x00 0x01 0x32 0x09 0x00 0x01 0x32 0x0a 0x00 0x01 0x32 0x0b 0x00 0x01 0x32 0x0c 0x00 0x01 0x32 0x0d 0x00 0x01 0x32 0x0e 0x00 0x01 0x32 0x0f 0x00 0x01>;
		linux,phandle = <0x89>;
		phandle = <0x89>;
	};

	gce_mbox@10238000 {
		compatible = "mediatek,mailbox-gce";
		reg = <0x00 0x10238000 0x00 0x4000>;
		interrupts = <0x00 0x9a 0x08 0x00 0x9b 0x08>;
		#mbox-cells = <0x03>;
		#gce-event-cells = <0x01>;
		#gce-subsys-cells = <0x02>;
		clocks = <0x26 0x09 0x26 0x18>;
		clock-names = "gce\0GCE_TIMER";
		linux,phandle = <0x32>;
		phandle = <0x32>;
	};

	gce_mbox_svp@10238000 {
		compatible = "mediatek,mailbox-gce-svp";
		reg = <0x00 0x10238000 0x00 0x4000>;
		interrupts = <0x00 0x9a 0x08 0x00 0x9b 0x08>;
		#mbox-cells = <0x03>;
		clocks = <0x26 0x09 0x26 0x18>;
		clock-names = "gce\0GCE_TIMER";
		linux,phandle = <0x8a>;
		phandle = <0x8a>;
	};

	ap_ccif2@1023c000 {
		compatible = "mediatek,ap_ccif2";
		reg = <0x00 0x1023c000 0x00 0x1000>;
		interrupts = <0x00 0x8f 0x08>;
	};

	md_ccif2@1023d000 {
		compatible = "mediatek,md_ccif2";
		reg = <0x00 0x1023d000 0x00 0x1000>;
	};

	ap_ccif3@1023e000 {
		compatible = "mediatek,ap_ccif3";
		reg = <0x00 0x1023e000 0x00 0x1000>;
		interrupts = <0x00 0x92 0x08>;
	};

	md_ccif3@1023f000 {
		compatible = "mediatek,md_ccif3";
		reg = <0x00 0x1023f000 0x00 0x1000>;
	};

	sspm@10440000 {
		compatible = "mediatek,sspm";
		reg = <0x00 0x10440000 0x00 0x10000 0x00 0x10450000 0x00 0x100 0x00 0x10451000 0x00 0x08 0x00 0x10460000 0x00 0x100 0x00 0x10461000 0x00 0x08 0x00 0x10470000 0x00 0x100 0x00 0x10471000 0x00 0x08 0x00 0x10480000 0x00 0x100 0x00 0x10481000 0x00 0x08 0x00 0x10490000 0x00 0x100 0x00 0x10491000 0x00 0x08>;
		reg-names = "cfgreg\0mbox0_base\0mbox0_ctrl\0mbox1_base\0mbox1_ctrl\0mbox2_base\0mbox2_ctrl\0mbox3_base\0mbox3_ctrl\0mbox4_base\0mbox4_ctrl";
		interrupts = <0x00 0xca 0x04 0x00 0xcd 0x04 0x00 0xce 0x04 0x00 0xcf 0x04 0x00 0xd0 0x04 0x00 0xd1 0x04>;
		interrupt-names = "ipc\0mbox0\0mbox1\0mbox2\0mbox3\0mbox4";
	};

	gic500@0c000000 {
		compatible = "mediatek,gic500";
		reg = <0x00 0xc000000 0x00 0x1000>;
	};

	gic_cpu@0c400000 {
		compatible = "mediatek,gic_cpu";
		reg = <0x00 0xc400000 0x00 0x40000>;
	};

	dfd@10200b00 {
		compatible = "mediatek,dfd";
		reg = <0x00 0x10200b00 0x00 0x10000>;
		mediatek,enabled = <0x01>;
		mediatek,chain_length = <0xc350>;
		mediatek,rg_dfd_timeout = <0xa0>;
	};

	dbg_cti@0d020000 {
		compatible = "mediatek,dbg_cti";
		reg = <0x00 0xd020000 0x00 0x10000>;
	};

	dbg_etr@0d030000 {
		compatible = "mediatek,dbg_etr";
		reg = <0x00 0xd030000 0x00 0x10000>;
	};

	dbg_funnel@0d040000 {
		compatible = "mediatek,dbg_funnel";
		reg = <0x00 0xd040000 0x00 0x10000>;
	};

	dbg_dem@0d0a0000 {
		compatible = "mediatek,dbg_dem";
		reg = <0x00 0xd0a0000 0x00 0x10000>;
		interrupts = <0x00 0x8c 0x08>;
	};

	dbg_mdsys1@0d0c0000 {
		compatible = "mediatek,dbg_mdsys1";
		reg = <0x00 0xd0c0000 0x00 0x40000>;
	};

	dbg_apmcu_mp0@0d400000 {
		compatible = "mediatek,dbg_apmcu_mp0";
		reg = <0x00 0xd400000 0x00 0x1000>;
	};

	dbg_apmcu_mp0@0d410000 {
		compatible = "mediatek,dbg_apmcu_mp0";
		reg = <0x00 0xd410000 0x00 0x1000>;
	};

	dbg_apmcu_mp0@0d420000 {
		compatible = "mediatek,dbg_apmcu_mp0";
		reg = <0x00 0xd420000 0x00 0x1000>;
	};

	dbg_apmcu_mp0@0d430000 {
		compatible = "mediatek,dbg_apmcu_mp0";
		reg = <0x00 0xd430000 0x00 0x1000>;
	};

	dbg_apmcu_mp0@0d440000 {
		compatible = "mediatek,dbg_apmcu_mp0";
		reg = <0x00 0xd440000 0x00 0x1000>;
	};

	dbg_apmcu_mp0@0d510000 {
		compatible = "mediatek,dbg_apmcu_mp0";
		reg = <0x00 0xd510000 0x00 0x1000>;
	};

	dbg_apmcu_mp0@0d520000 {
		compatible = "mediatek,dbg_apmcu_mp0";
		reg = <0x00 0xd520000 0x00 0x1000>;
	};

	dbg_apmcu_mp0@0d530000 {
		compatible = "mediatek,dbg_apmcu_mp0";
		reg = <0x00 0xd530000 0x00 0x1000>;
	};

	dbg_apmcu_mp0@0d540000 {
		compatible = "mediatek,dbg_apmcu_mp0";
		reg = <0x00 0xd540000 0x00 0x1000>;
	};

	dbg_apmcu_mp0@0d610000 {
		compatible = "mediatek,dbg_apmcu_mp0";
		reg = <0x00 0xd610000 0x00 0x1000>;
	};

	dbg_apmcu_mp0@0d620000 {
		compatible = "mediatek,dbg_apmcu_mp0";
		reg = <0x00 0xd620000 0x00 0x1000>;
	};

	dbg_apmcu_mp0@0d630000 {
		compatible = "mediatek,dbg_apmcu_mp0";
		reg = <0x00 0xd630000 0x00 0x1000>;
	};

	dbg_apmcu_mp0@0d640000 {
		compatible = "mediatek,dbg_apmcu_mp0";
		reg = <0x00 0xd640000 0x00 0x1000>;
	};

	dbg_apmcu_mp0@0d710000 {
		compatible = "mediatek,dbg_apmcu_mp0";
		reg = <0x00 0xd710000 0x00 0x1000>;
	};

	dbg_apmcu_mp0@0d720000 {
		compatible = "mediatek,dbg_apmcu_mp0";
		reg = <0x00 0xd720000 0x00 0x1000>;
	};

	dbg_apmcu_mp0@0d730000 {
		compatible = "mediatek,dbg_apmcu_mp0";
		reg = <0x00 0xd730000 0x00 0x1000>;
	};

	dbg_apmcu_mp0@0d740000 {
		compatible = "mediatek,dbg_apmcu_mp0";
		reg = <0x00 0xd740000 0x00 0x1000>;
	};

	dbg_apmcu_mp1@0d800000 {
		compatible = "mediatek,dbg_apmcu_mp1";
		reg = <0x00 0xd800000 0x00 0x1000>;
	};

	dbg_apmcu_mp1@0d810000 {
		compatible = "mediatek,dbg_apmcu_mp1";
		reg = <0x00 0xd810000 0x00 0x1000>;
	};

	dbg_apmcu_mp1@0d820000 {
		compatible = "mediatek,dbg_apmcu_mp1";
		reg = <0x00 0xd820000 0x00 0x1000>;
	};

	dbg_apmcu_mp1@0d830000 {
		compatible = "mediatek,dbg_apmcu_mp1";
		reg = <0x00 0xd830000 0x00 0x1000>;
	};

	dbg_apmcu_mp1@0d840000 {
		compatible = "mediatek,dbg_apmcu_mp1";
		reg = <0x00 0xd840000 0x00 0x1000>;
	};

	dbg_apmcu_mp1@0d910000 {
		compatible = "mediatek,dbg_apmcu_mp1";
		reg = <0x00 0xd910000 0x00 0x1000>;
	};

	dbg_apmcu_mp1@0d920000 {
		compatible = "mediatek,dbg_apmcu_mp1";
		reg = <0x00 0xd920000 0x00 0x1000>;
	};

	dbg_apmcu_mp1@0d930000 {
		compatible = "mediatek,dbg_apmcu_mp1";
		reg = <0x00 0xd930000 0x00 0x1000>;
	};

	dbg_apmcu_mp1@0d940000 {
		compatible = "mediatek,dbg_apmcu_mp1";
		reg = <0x00 0xd940000 0x00 0x1000>;
	};

	dbg_apmcu_mp1@0da10000 {
		compatible = "mediatek,dbg_apmcu_mp1";
		reg = <0x00 0xda10000 0x00 0x1000>;
	};

	dbg_apmcu_mp1@0da20000 {
		compatible = "mediatek,dbg_apmcu_mp1";
		reg = <0x00 0xda20000 0x00 0x1000>;
	};

	dbg_apmcu_mp1@0da30000 {
		compatible = "mediatek,dbg_apmcu_mp1";
		reg = <0x00 0xda30000 0x00 0x1000>;
	};

	dbg_apmcu_mp1@0da40000 {
		compatible = "mediatek,dbg_apmcu_mp1";
		reg = <0x00 0xda40000 0x00 0x1000>;
	};

	dbg_apmcu_mp1@0db10000 {
		compatible = "mediatek,dbg_apmcu_mp1";
		reg = <0x00 0xdb10000 0x00 0x1000>;
	};

	dbg_apmcu_mp1@0db20000 {
		compatible = "mediatek,dbg_apmcu_mp1";
		reg = <0x00 0xdb20000 0x00 0x1000>;
	};

	dbg_apmcu_mp1@0db30000 {
		compatible = "mediatek,dbg_apmcu_mp1";
		reg = <0x00 0xdb30000 0x00 0x1000>;
	};

	dbg_apmcu_mp1@0db40000 {
		compatible = "mediatek,dbg_apmcu_mp1";
		reg = <0x00 0xdb40000 0x00 0x1000>;
	};

	ap_dma@11000000 {
		compatible = "mediatek,ap_dma";
		reg = <0x00 0x11000000 0x00 0x1000>;
		interrupts = <0x00 0x61 0x08>;
	};

	auxadc@11001000 {
		compatible = "mediatek,auxadc";
		reg = <0x00 0x11001000 0x00 0x10000>;
		interrupts = <0x00 0x4c 0x02>;
		clocks = <0x26 0x21>;
		clock-names = "auxadc-main";
		linux,phandle = <0x8b>;
		phandle = <0x8b>;
	};

	dma-controller@11000580 {
		compatible = "mediatek,mt6577-uart-dma";
		reg = <0x00 0x11000680 0x00 0x80 0x00 0x11000700 0x00 0x80 0x00 0x11000780 0x00 0x80 0x00 0x11000800 0x00 0x80>;
		interrupts = <0x00 0x6d 0x08 0x00 0x6e 0x08 0x00 0x6f 0x08 0x00 0x74 0x08>;
		clocks = <0x26 0x26>;
		clock-names = "apdma";
		#dma-cells = <0x01>;
		linux,phandle = <0x33>;
		phandle = <0x33>;
	};

	serial@11020000 {
		compatible = "mediatek,mt6758-uart\0mediatek,mt6577-uart";
		reg = <0x00 0x11002000 0x00 0x1000>;
		interrupts = <0x00 0x5b 0x08>;
		clocks = <0x1f 0x26 0x16>;
		clock-names = "baud\0bus";
		dmas = <0x33 0x00 0x33 0x01>;
		dma-names = "tx\0rx";
		linux,phandle = <0x8c>;
		phandle = <0x8c>;
	};

	serial@11030000 {
		compatible = "mediatek,mt6758-uart\0mediatek,mt6577-uart";
		reg = <0x00 0x11003000 0x00 0x1000>;
		interrupts = <0x00 0x5c 0x08>;
		clocks = <0x1f 0x26 0x17>;
		clock-names = "baud\0bus";
		linux,phandle = <0x8d>;
		phandle = <0x8d>;
	};

	i2c_common {
		compatible = "mediatek,i2c_common";
		dma_support = [02];
		idvfs = [01];
		set_dt_div = [01];
		check_max_freq = [01];
		ver = [02];
		set_ltiming = [01];
		ext_time_config = [18 01];
		cnt_constraint = [01];
		linux,phandle = <0x8e>;
		phandle = <0x8e>;
	};

	i2c0@11007000 {
		compatible = "mediatek,i2c";
		id = <0x00>;
		reg = <0x00 0x11007000 0x00 0x1000 0x00 0x11000080 0x00 0x80>;
		interrupts = <0x00 0x54 0x08>;
		clocks = <0x26 0x0b 0x26 0x26>;
		clock-names = "main\0dma";
		clock-div = <0x05>;
		scl-gpio-id = <0x53>;
		sda-gpio-id = <0x52>;
		gpio_start = <0x10002a00>;
		mem_len = <0x200>;
		eh_cfg = <0x20>;
		pu_cfg = <0x50>;
		rsel_cfg = <0x70>;
		aed = <0x1a>;
		mediatek,hs_only;
		linux,phandle = <0x8f>;
		phandle = <0x8f>;
	};

	i2c1@11008000 {
		compatible = "mediatek,i2c";
		id = <0x01>;
		reg = <0x00 0x11008000 0x00 0x1000 0x00 0x11000100 0x00 0x80>;
		interrupts = <0x00 0x55 0x08>;
		clocks = <0x26 0x0b 0x26 0x26>;
		clock-names = "main\0dma";
		clock-div = <0x05>;
		scl-gpio-id = <0x54>;
		sda-gpio-id = <0x51>;
		gpio_start = <0x10002a00>;
		mem_len = <0x200>;
		eh_cfg = <0x20>;
		pu_cfg = <0x50>;
		rsel_cfg = <0x70>;
		aed = <0x1a>;
		mediatek,hs_only;
		linux,phandle = <0x90>;
		phandle = <0x90>;
	};

	i2c2@11009000 {
		compatible = "mediatek,i2c";
		id = <0x02>;
		reg = <0x00 0x11009000 0x00 0x1000 0x00 0x11000180 0x00 0x180>;
		interrupts = <0x00 0x56 0x08>;
		clocks = <0x26 0x0b 0x26 0x26>;
		clock-names = "main\0dma";
		clock-div = <0x05>;
		scl-gpio-id = <0x67>;
		sda-gpio-id = <0x68>;
		gpio_start = <0x10002800>;
		mem_len = <0x200>;
		eh_cfg = <0x20>;
		pu_cfg = <0x60>;
		rsel_cfg = <0xa0>;
		aed = <0x1a>;
		ch_offset_default = <0x100>;
		ch_offset_ccu = <0x200>;
		mediatek,hs_only;
		linux,phandle = <0x91>;
		phandle = <0x91>;
	};

	i2c3@1100f000 {
		compatible = "mediatek,i2c";
		id = <0x03>;
		reg = <0x00 0x1100f000 0x00 0x1000 0x00 0x11000300 0x00 0x100>;
		interrupts = <0x00 0x57 0x08>;
		clocks = <0x26 0x0b 0x26 0x26>;
		clock-names = "main\0dma";
		clock-div = <0x05>;
		scl-gpio-id = <0x32>;
		sda-gpio-id = <0x33>;
		gpio_start = <0x10002600>;
		mem_len = <0x200>;
		eh_cfg = <0x20>;
		pu_cfg = <0x90>;
		rsel_cfg = <0xb0>;
		aed = <0x1a>;
		ch_offset_default = <0x100>;
		mediatek,hs_only;
		#address-cells = <0x01>;
		#size-cells = <0x00>;
		linux,phandle = <0x92>;
		phandle = <0x92>;

		pn553@28 {
			compatible = "mediatek,pn553nfc";
			reg = <0x28>;
			status = "okay";
		};
	};

	i2c4@11011000 {
		compatible = "mediatek,i2c";
		id = <0x04>;
		reg = <0x00 0x11011000 0x00 0x1000 0x00 0x11000400 0x00 0x180>;
		interrupts = <0x00 0x58 0x08>;
		clocks = <0x26 0x0b 0x26 0x26>;
		clock-names = "main\0dma";
		clock-div = <0x05>;
		scl-gpio-id = <0x69>;
		sda-gpio-id = <0x6a>;
		gpio_start = <0x10002800>;
		mem_len = <0x200>;
		eh_cfg = <0x20>;
		pu_cfg = <0x60>;
		rsel_cfg = <0xa0>;
		aed = <0x1a>;
		ch_offset_default = <0x100>;
		ch_offset_ccu = <0x200>;
		mediatek,hs_only;
		linux,phandle = <0x93>;
		phandle = <0x93>;
	};

	i2c5@11016000 {
		compatible = "mediatek,i2c";
		id = <0x05>;
		reg = <0x00 0x11016000 0x00 0x1000 0x00 0x11000580 0x00 0x80>;
		interrupts = <0x00 0x82 0x08>;
		clocks = <0x26 0x0b 0x26 0x26>;
		clock-names = "main\0dma";
		clock-div = <0x05>;
		scl-gpio-id = <0x30>;
		sda-gpio-id = <0x31>;
		gpio_start = <0x10002600>;
		mem_len = <0x200>;
		eh_cfg = <0x20>;
		pu_cfg = <0x90>;
		rsel_cfg = <0xb0>;
		aed = <0x1a>;
		mediatek,hs_only;
		#address-cells = <0x01>;
		#size-cells = <0x00>;
		clock-frequency = <0x61a80>;
		mediatek,use-open-drain;
		linux,phandle = <0x94>;
		phandle = <0x94>;

		sia81xx_i2c@L {
			compatible = "si,sia81xx-i2c";
			reg = <0x28>;
			si,sia81xx-dev = <0x34>;
			linux,phandle = <0x95>;
			phandle = <0x95>;
		};
	};

	i2c6@1100d000 {
		compatible = "mediatek,i2c";
		id = <0x06>;
		reg = <0x00 0x1100d000 0x00 0x1000 0x00 0x11000600 0x00 0x80>;
		interrupts = <0x00 0x83 0x08>;
		clocks = <0x26 0x0b 0x26 0x26>;
		clock-names = "main\0dma";
		clock-div = <0x05>;
		scl-gpio-id = <0xa1>;
		sda-gpio-id = <0xa2>;
		gpio_start = <0x10002c00>;
		mem_len = <0x200>;
		eh_cfg = <0x20>;
		pu_cfg = <0x50>;
		rsel_cfg = <0x70>;
		aed = <0x1a>;
		ch_offset_default = <0x100>;
		ch_offset_ccu = <0x200>;
		mediatek,hs_only;
		linux,phandle = <0x96>;
		phandle = <0x96>;
	};

	pwm@11006000 {
		compatible = "mediatek,pwm";
		reg = <0x00 0x11006000 0x00 0x10000>;
		interrupts = <0x00 0x4d 0x08>;
		clocks = <0x26 0x10 0x26 0x11 0x26 0x12 0x26 0x13 0x26 0x14 0x26 0x30 0x26 0x0f 0x26 0x15>;
		clock-names = "PWM1-main\0PWM2-main\0PWM3-main\0PWM4-main\0PWM5-main\0PWM6-main\0PWM-HCLK-main\0PWM-main";
		linux,phandle = <0x97>;
		phandle = <0x97>;
	};

	spi@1100a000 {
		compatible = "mediatek,mt6765-spi";
		mediatek,pad-select = <0x00>;
		reg = <0x00 0x1100a000 0x00 0x1000>;
		interrupts = <0x00 0x76 0x08>;
		clocks = <0x1e 0x0b 0x1e 0x6b 0x26 0x1b>;
		clock-names = "parent-clk\0sel-clk\0spi-clk";
		linux,phandle = <0x98>;
		phandle = <0x98>;
	};

	therm_ctrl@1100b000 {
		compatible = "mediatek,therm_ctrl";
		reg = <0x00 0x1100b000 0x00 0x1000>;
		interrupts = <0x00 0x4e 0x08>;
		clocks = <0x26 0x0a>;
		clock-names = "therm-main";
	};

	btif@1100c000 {
		compatible = "mediatek,btif";
		reg = <0x00 0x1100c000 0x00 0x1000 0x00 0x11000880 0x00 0x80 0x00 0x11000900 0x00 0x80>;
		interrupts = <0x00 0x70 0x08 0x00 0x84 0x08 0x00 0x85 0x08>;
		clocks = <0x26 0x1a 0x26 0x26>;
		clock-names = "btifc\0apdmac";
	};

	consys@18002000 {
		compatible = "mediatek,mt6765-consys";
		#address-cells = <0x02>;
		#size-cells = <0x02>;
		reg = <0x00 0x18002000 0x00 0x1000 0x00 0x10007000 0x00 0x100 0x00 0x10001000 0x00 0x1000 0x00 0x10006000 0x00 0x1000 0x00 0x18007000 0x00 0x1000 0x00 0x180b1000 0x00 0x1000 0x00 0x180a3000 0x00 0x1000 0x00 0x180a5000 0x00 0x800 0x00 0x180c1000 0x00 0x1000 0x00 0x18004000 0x00 0x1000 0x00 0x00 0x00 0x00 0x00 0x00 0x00 0x00 0x00 0x1020e000 0x00 0x1000>;
		interrupts = <0x00 0x10b 0x08 0x00 0x10d 0x08 0x00 0x10e 0x01>;
		clocks = <0x27 0x01>;
		clock-names = "conn";
		linux,phandle = <0x1b>;
		phandle = <0x1b>;
	};

	wifi@18000000 {
		compatible = "mediatek,wifi";
		reg = <0x00 0x18000000 0x00 0x100000>;
		interrupts = <0x00 0x10c 0x08>;
	};

	disp_pwm@1100e000 {
		compatible = "mediatek,disp_pwm";
		reg = <0x00 0x1100e000 0x00 0x1000>;
	};

	spi@11010000 {
		compatible = "mediatek,mt6765-spi";
		mediatek,pad-select = <0x00>;
		reg = <0x00 0x11010000 0x00 0x1000>;
		interrupts = <0x00 0x7a 0x08>;
		clocks = <0x1e 0x0b 0x1e 0x6b 0x26 0x34>;
		clock-names = "parent-clk\0sel-clk\0spi-clk";
		linux,phandle = <0x99>;
		phandle = <0x99>;
	};

	spi@11012000 {
		compatible = "mediatek,mt6765-spi";
		mediatek,pad-select = <0x00>;
		reg = <0x00 0x11012000 0x00 0x1000>;
		interrupts = <0x00 0x80 0x08>;
		clocks = <0x1e 0x0b 0x1e 0x6b 0x26 0x37>;
		clock-names = "parent-clk\0sel-clk\0spi-clk";
		linux,phandle = <0x9a>;
		phandle = <0x9a>;
	};

	spi@11013000 {
		compatible = "mediatek,mt6765-spi";
		mediatek,pad-select = <0x00>;
		reg = <0x00 0x11013000 0x00 0x1000>;
		interrupts = <0x00 0x81 0x08>;
		clocks = <0x1e 0x0b 0x1e 0x6b 0x26 0x38>;
		clock-names = "parent-clk\0sel-clk\0spi-clk";
		linux,phandle = <0x9b>;
		phandle = <0x9b>;
	};

	spi@11014000 {
		compatible = "mediatek,mt6765-spi";
		mediatek,pad-select = <0x00>;
		reg = <0x00 0x11014000 0x00 0x1000>;
		interrupts = <0x00 0x5f 0x08>;
		clocks = <0x1e 0x0b 0x1e 0x6b 0x26 0x41>;
		clock-names = "parent-clk\0sel-clk\0spi-clk";
		linux,phandle = <0x9c>;
		phandle = <0x9c>;
	};

	spi@11015000 {
		compatible = "mediatek,mt6765-spi";
		mediatek,pad-select = <0x00>;
		reg = <0x00 0x11015000 0x00 0x1000>;
		interrupts = <0x00 0x60 0x08>;
		clocks = <0x1e 0x0b 0x1e 0x6b 0x26 0x42>;
		clock-names = "parent-clk\0sel-clk\0spi-clk";
		linux,phandle = <0x9d>;
		phandle = <0x9d>;
	};

	imp_iic@11017000 {
		compatible = "mediatek,imp_iic";
		reg = <0x00 0x11017000 0x00 0x1000>;
	};

	nfi@11018000 {
		compatible = "mediatek,nfi";
		reg = <0x00 0x11018000 0x00 0x1000>;
	};

	nfiecc@11019000 {
		compatible = "mediatek,nfiecc";
		reg = <0x00 0x11019000 0x00 0x1000>;
	};

	usb0@11200000 {
		compatible = "mediatek,mt6765-usb20";
		reg = <0x00 0x11200000 0x00 0x10000 0x00 0x11cc0000 0x00 0x10000>;
		interrupts = <0x00 0x49 0x08>;
		mode = <0x02>;
		multipoint = <0x01>;
		num_eps = <0x10>;
		clocks = <0x26 0x08 0x1e 0x76 0x1e 0x20>;
		clock-names = "usb0\0usb0_clk_top_sel\0usb0_clk_univpll3_d4";
	};

	usb_sif@11210000 {
		compatible = "mediatek,usb_sif";
		reg = <0x00 0x11210000 0x00 0x10000>;
	};

	msdc@11230000 {
		compatible = "mediatek,msdc";
		reg = <0x00 0x11230000 0x00 0x10000>;
		interrupts = <0x00 0x4f 0x08>;
		index = [00];
		clk_src = [01];
		bus-width = <0x08>;
		max-frequency = <0xbebc200>;
		cap-mmc-highspeed;
		mmc-ddr-1_8v;
		mmc-hs200-1_8v;
		mmc-hs400-1_8v;
		no-sd;
		no-sdio;
		non-removable;
		pinctl = <0x35>;
		pinctl_hs400 = <0x36>;
		pinctl_hs200 = <0x37>;
		register_setting = <0x38>;
		host_function = [00];
		bootable;
		status = "okay";
		vmmc-supply = <0x39>;
		clocks = <0x26 0x4c 0x26 0x1c 0x26 0x44>;
		clock-names = "msdc0-clock\0msdc0-hclock\0msdc0-aes-clock";
		linux,phandle = <0x9e>;
		phandle = <0x9e>;
	};

	msdc@11240000 {
		compatible = "mediatek,msdc";
		reg = <0x00 0x11240000 0x00 0x10000>;
		interrupts = <0x00 0x50 0x08>;
		index = [01];
		clk_src = [02];
		bus-width = <0x04>;
		max-frequency = <0xbebc200>;
		cap-sd-highspeed;
		sd-uhs-sdr12;
		sd-uhs-sdr25;
		sd-uhs-sdr50;
		sd-uhs-sdr104;
		sd-uhs-ddr50;
		no-mmc;
		no-sdio;
		pinctl = <0x3a>;
		pinctl_sdr104 = <0x3b>;
		pinctl_sdr50 = <0x3c>;
		pinctl_ddr50 = <0x3d>;
		register_setting = <0x3e>;
		host_function = [01];
		cd_level = [01];
		cd-gpios = <0x3f 0x01 0x00>;
		status = "okay";
		vmmc-supply = <0x40>;
		vqmmc-supply = <0x41>;
		clocks = <0x26 0x4d 0x26 0x1d>;
		clock-names = "msdc1-clock\0msdc1-hclock";
		linux,phandle = <0x9f>;
		phandle = <0x9f>;
	};

	msdc@11250000 {
		compatible = "mediatek,msdc2";
		reg = <0x00 0x11250000 0x00 0x10000>;
		status = "disable";
		linux,phandle = <0xa0>;
		phandle = <0xa0>;
	};

	msdc@11260000 {
		compatible = "mediatek,msdc3";
		reg = <0x00 0x11250000 0x00 0x10000>;
		status = "disable";
		linux,phandle = <0xa1>;
		phandle = <0xa1>;
	};

	msdc1_ins@0 {
		compatible = "mediatek,mt6765-sdcard-ins";
		linux,phandle = <0xa2>;
		phandle = <0xa2>;
	};

	msdc0_top@11cd0000 {
		compatible = "mediatek,msdc0_top";
		reg = <0x00 0x11cd0000 0x00 0x1000>;
	};

	msdc1_top@11c90000 {
		compatible = "mediatek,msdc1_top";
		reg = <0x00 0x11c90000 0x00 0x1000>;
	};

	usb1p_sif@11210000 {
		compatible = "mediatek,usb1p_sif";
		reg = <0x00 0x11210000 0x00 0x10000>;
	};

	audio@11220000 {
		compatible = "mediatek,audio\0syscon";
		reg = <0x00 0x11220000 0x00 0x1000>;
		#clock-cells = <0x01>;
		mediatek,btcvsd_snd = <0x42>;
		si,sia81xx-max-num = <0x01>;
		si,sia81xx-aux-devs = <0x34>;
		si,sia81xx-aux-devs-prefix = "SpkrLeft";
		linux,phandle = <0x43>;
		phandle = <0x43>;
	};

	mt_soc_dl1_pcm@11220000 {
		compatible = "mediatek,mt_soc_pcm_dl1";
		reg = <0x00 0x11220000 0x00 0x1000>;
		interrupts = <0x00 0x99 0x08>;
		clocks = <0x43 0x00 0x43 0x04 0x43 0x05 0x43 0x03 0x43 0x01 0x43 0x02 0x43 0x06 0x26 0x2b 0x26 0x33 0x1e 0x6f 0x1e 0x70 0x1e 0x03 0x1e 0x71 0x1e 0x29 0x1e 0x72 0x1e 0x2c 0x44 0x08 0x1f>;
		clock-names = "aud_afe_clk\0aud_dac_clk\0aud_dac_predis_clk\0aud_adc_clk\0aud_apll22m_clk\0aud_apll1_tuner_clk\0aud_tml_clk\0aud_infra_clk\0mtkaif_26m_clk\0top_mux_audio\0top_mux_audio_int\0top_sys_pll1_d4\0top_mux_aud_1\0top_apll1_ck\0top_mux_aud_eng1\0top_apll1_d8\0apmixed_apll1\0top_clk26m_clk";
		linux,phandle = <0xa3>;
		phandle = <0xa3>;
	};

	audio_sram@11221000 {
		compatible = "mediatek,audio_sram";
		reg = <0x00 0x11221000 0x00 0x9000>;
	};

	mtk-btcvsd-snd@18050000 {
		compatible = "mediatek,mtk-btcvsd-snd";
		reg = <0x00 0x18050000 0x00 0x1000 0x00 0x18080000 0x00 0x10000>;
		interrupts = <0x00 0x10a 0x08>;
		mediatek,infracfg = <0x26>;
		mediatek,offset = <0xf00 0x800 0x140 0x144 0x148>;
		linux,phandle = <0x42>;
		phandle = <0x42>;
	};

	mipi_rx_ana_csi0a@11c10000 {
		compatible = "mediatek,mipi_rx_ana_csi0a\0syscon";
		reg = <0x00 0x11c10000 0x00 0x1000>;
		#clock-cells = <0x01>;
		linux,phandle = <0x50>;
		phandle = <0x50>;
	};

	mipi_rx_ana_csi0b@11c11000 {
		compatible = "mediatek,mipi_rx_ana_csi0b\0syscon";
		reg = <0x00 0x11c11000 0x00 0x1000>;
		#clock-cells = <0x01>;
		linux,phandle = <0x51>;
		phandle = <0x51>;
	};

	mipi_rx_ana_csi1a@11c12000 {
		compatible = "mediatek,mipi_rx_ana_csi1a\0syscon";
		reg = <0x00 0x11c12000 0x00 0x1000>;
		#clock-cells = <0x01>;
		linux,phandle = <0x52>;
		phandle = <0x52>;
	};

	mipi_rx_ana_csi1b@11c13000 {
		compatible = "mediatek,mipi_rx_ana_csi1b\0syscon";
		reg = <0x00 0x11c13000 0x00 0x1000>;
		#clock-cells = <0x01>;
		linux,phandle = <0x53>;
		phandle = <0x53>;
	};

	mipi_rx_ana_csi2a@11c14000 {
		compatible = "mediatek,mipi_rx_ana_csi2a\0syscon";
		reg = <0x00 0x11c14000 0x00 0x1000>;
		#clock-cells = <0x01>;
		linux,phandle = <0x54>;
		phandle = <0x54>;
	};

	mipi_rx_ana_csi2b@11c15000 {
		compatible = "mediatek,mipi_rx_ana_csi2b\0syscon";
		reg = <0x00 0x11c15000 0x00 0x1000>;
		#clock-cells = <0x01>;
		linux,phandle = <0x55>;
		phandle = <0x55>;
	};

	efusec@11c50000 {
		compatible = "mediatek,efusec";
		reg = <0x00 0x11c50000 0x00 0x10000>;
	};

	mipi_tx0@11c80000 {
		compatible = "mediatek,mipi_tx0";
		reg = <0x00 0x11c80000 0x00 0x10000>;
	};

	msdc1_pad_macro@11c90000 {
		compatible = "mediatek,msdc1_pad_macro";
		reg = <0x00 0x11c90000 0x00 0x10000>;
	};

	msdc0_pad_macro@11cd0000 {
		compatible = "mediatek,msdc0_pad_macro";
		reg = <0x00 0x11cd0000 0x00 0x10000>;
	};

	mfg_doma@13000000 {
		compatible = "mediatek,doma";
		reg = <0x00 0x13000000 0x00 0x80000>;
		interrupts = <0x00 0x103 0x08>;
		interrupt-names = "RGX";
		clock-frequency = <0x21f98280>;
	};

	mfg_cfg@13ffe000 {
		compatible = "mediatek,mfgcfg\0syscon";
		reg = <0x00 0x13ffe000 0x00 0x1000>;
		#clock-cells = <0x01>;
		linux,phandle = <0xa4>;
		phandle = <0xa4>;
	};

	gpufreq {
		compatible = "mediatek,mt6765-gpufreq";
		clocks = <0x1e 0x64 0x1e 0x26 0x1f 0x27 0x08 0x27 0x04 0x27 0x07>;
		clock-names = "clk_mux\0clk_main_parent\0clk_sub_parent\0mtcmos_mfg_async\0mtcmos_mfg\0mtcmos_mfg_core0";
	};

	mmsys_config@14000000 {
		compatible = "mediatek,mmsys_config\0syscon";
		reg = <0x00 0x14000000 0x00 0x1000>;
		interrupts = <0x00 0xe3 0x08>;
		#clock-cells = <0x01>;
		clocks = <0x28 0x17 0x28 0x1a 0x28 0x1b>;
		clock-names = "CAM_MDP\0IMG_DL_RELAY\0IMG_DL_ASYNC_TOP";
		pwr-regmap = <0x45>;
		linux,phandle = <0x28>;
		phandle = <0x28>;
	};

	nfc553 {
		compatible = "mediatek,nfc-gpios";
		gpio-ven = <0x62>;
		gpio-eint = <0x61>;
		gpio-irq = <0x61>;
		pinctrl-names = "nfcdefault\0ven_high\0ven_low\0dwn_high\0dwn_low\0eint_as_int\0clk_req";
		pinctrl-0 = <0x46>;
		pinctrl-1 = <0x47>;
		pinctrl-2 = <0x48>;
		pinctrl-3 = <0x49>;
		pinctrl-4 = <0x4a>;
		pinctrl-5 = <0x4b>;
		pinctrl-6 = <0x4c>;
		status = "okay";
		linux,phandle = <0xa5>;
		phandle = <0xa5>;
	};

	irq_nfc {
		compatible = "mediatek,irq_nfc-eint";
		linux,phandle = <0xa6>;
		phandle = <0xa6>;
	};

	disp_mutex0@14001000 {
		compatible = "mediatek,disp_mutex0";
		reg = <0x00 0x14001000 0x00 0x1000>;
		interrupts = <0x00 0xd2 0x08>;
		linux,phandle = <0x31>;
		phandle = <0x31>;
	};

	smi_common@14002000 {
		compatible = "mediatek,smi_common";
		reg = <0x00 0x14002000 0x00 0x1000>;
		nr_larbs = <0x04>;
		larbs = <0x22 0x23 0x24 0x25>;
		mmsys_config = <0x28>;
		clocks = <0x27 0x03 0x28 0x15 0x28 0x16 0x28 0x13 0x1e 0x62 0x1e 0x21 0x1e 0x17 0x1e 0x22>;
		clock-names = "mtcmos-mm\0smi-common-gals-comm0\0smi-common-gals-comm1\0smi-common\0mmdvfs_clk_mm_sel_ck\0mmdvfs_clk_mmpll_ck\0mmdvfs_clk_univpll1_d2_ck\0mmdvfs_clk_mmpll_d2_ck";
	};

	mmdvfs_pmqos {
		compatible = "mediatek,mmdvfs_pmqos";
		mm_step0 = <0x1c9 0x01 0x00 0x01>;
		mm_step1 = <0x138 0x01 0x00 0x02>;
		mm_step2 = <0xe4 0x01 0x00 0x03>;
		vopp_steps = <0x00 0x01 0x03>;
		disp_freq = "mm_step0\0mm_step1\0mm_step2";
		mdp_freq = "mm_step0\0mm_step1\0mm_step2";
		cam_freq = "mm_step0\0mm_step1\0mm_step2";
		img_freq = "mm_step0\0mm_step1\0mm_step2";
		vdec_freq = "mm_step0\0mm_step1\0mm_step2";
		venc_freq = "mm_step0\0mm_step1\0mm_step2";
		clocks = <0x1e 0x62 0x1e 0x21 0x1e 0x17 0x1e 0x22>;
		clock-names = "mmdvfs_clk_mm_sel_ck\0mmdvfs_clk_mmpll_ck\0mmdvfs_clk_univpll1_d2_ck\0mmdvfs_clk_mmpll_d2_ck";
	};

	imgsys@15020000 {
		compatible = "mediatek,imgsys\0syscon";
		reg = <0x00 0x15020000 0x00 0x1000>;
		#clock-cells = <0x01>;
		clocks = <0x27 0x03 0x27 0x05 0x27 0x09 0x4d 0x01 0x4e 0x02 0x4e 0x03 0x4e 0x04 0x4e 0x05 0x4e 0x06 0x4e 0x07>;
		clock-names = "ISP_SCP_SYS_DIS\0ISP_SCP_SYS_ISP\0ISP_SCP_SYS_CAM\0ISP_CLK_IMG_DIP\0ISP_CLK_CAM\0ISP_CLK_CAMTG\0ISP_CLK_CAM_SENINF\0ISP_CLK_CAMSV0\0ISP_CLK_CAMSV1\0ISP_CLK_CAMSV2";
		pwr-regmap = <0x45>;
		linux,phandle = <0x4d>;
		phandle = <0x4d>;
	};

	dip1@15022000 {
		compatible = "mediatek,dip1";
		reg = <0x00 0x15022000 0x00 0x3000>;
		interrupts = <0x00 0xff 0x08>;
	};

	dpe@15028000 {
		compatible = "mediatek,dpe";
		reg = <0x00 0x15028000 0x00 0x1000>;
		interrupts = <0x00 0x100 0x08>;
		clocks = <0x4d 0x03>;
		clock-names = "DPE_CG_IMG_DPE";
	};

	smi_larb0@14003000 {
		cell-index = <0x00>;
		compatible = "mediatek,smi_larb0\0mediatek,smi_larb";
		reg = <0x00 0x14003000 0x00 0x1000>;
		clocks = <0x27 0x03 0x28 0x14>;
		clock-names = "mtcmos-mm\0mm-larb0";
		linux,phandle = <0x22>;
		phandle = <0x22>;
	};

	mdp_rdma0@14004000 {
		compatible = "mediatek,mdp_rdma0";
		reg = <0x00 0x14004000 0x00 0x1000>;
		interrupts = <0x00 0xd3 0x08>;
		clocks = <0x28 0x00>;
		clock-names = "MDP_RDMA0";
		linux,phandle = <0x29>;
		phandle = <0x29>;
	};

	mdp_ccorr0@14005000 {
		compatible = "mediatek,mdp_ccorr0";
		reg = <0x00 0x14005000 0x00 0x1000>;
		interrupts = <0x00 0xe2 0x08>;
		clocks = <0x28 0x01>;
		clock-names = "MDP_CCORR";
		linux,phandle = <0x30>;
		phandle = <0x30>;
	};

	mdp_rsz0@14006000 {
		compatible = "mediatek,mdp_rsz0";
		reg = <0x00 0x14006000 0x00 0x1000>;
		interrupts = <0x00 0xd4 0x08>;
		clocks = <0x28 0x02>;
		clock-names = "MDP_RSZ0";
		linux,phandle = <0x2a>;
		phandle = <0x2a>;
	};

	mdp_rsz1@14007000 {
		compatible = "mediatek,mdp_rsz1";
		reg = <0x00 0x14007000 0x00 0x1000>;
		interrupts = <0x00 0xd5 0x08>;
		clocks = <0x28 0x03>;
		clock-names = "MDP_RSZ1";
		linux,phandle = <0x2b>;
		phandle = <0x2b>;
	};

	mdp_wdma0@14008000 {
		compatible = "mediatek,mdp_wdma0";
		reg = <0x00 0x14008000 0x00 0x1000>;
		interrupts = <0x00 0xd8 0x08>;
		clocks = <0x28 0x06>;
		clock-names = "MDP_WDMA";
		linux,phandle = <0x2c>;
		phandle = <0x2c>;
	};

	mdp_wrot0@14009000 {
		compatible = "mediatek,mdp_wrot0";
		reg = <0x00 0x14009000 0x00 0x1000>;
		interrupts = <0x00 0xd7 0x08>;
		clocks = <0x28 0x05>;
		clock-names = "MDP_WROT0";
		linux,phandle = <0x2d>;
		phandle = <0x2d>;
	};

	mdp_tdshp0@1400a000 {
		compatible = "mediatek,mdp_tdshp0";
		reg = <0x00 0x1400a000 0x00 0x1000>;
		clocks = <0x28 0x04>;
		clock-names = "MDP_TDSHP";
		linux,phandle = <0x2e>;
		phandle = <0x2e>;
	};

	disp_ovl0@1400b000 {
		compatible = "mediatek,disp_ovl0";
		reg = <0x00 0x1400b000 0x00 0x1000>;
		interrupts = <0x00 0xd9 0x08>;
	};

	disp_ovl0_2l@1400c000 {
		compatible = "mediatek,disp_ovl0_2l";
		reg = <0x00 0x1400c000 0x00 0x1000>;
		interrupts = <0x00 0xe5 0x08>;
	};

	disp_rdma0@1400d000 {
		compatible = "mediatek,disp_rdma0";
		reg = <0x00 0x1400d000 0x00 0x1000>;
		interrupts = <0x00 0xda 0x08>;
	};

	disp_wdma0@1400e000 {
		compatible = "mediatek,disp_wdma0";
		reg = <0x00 0x1400e000 0x00 0x1000>;
		interrupts = <0x00 0xdb 0x08>;
	};

	disp_color0@1400f000 {
		compatible = "mediatek,disp_color0";
		reg = <0x00 0x1400f000 0x00 0x1000>;
		interrupts = <0x00 0xdc 0x08>;
		clocks = <0x28 0x0c>;
		clock-names = "MDP_COLOR";
		linux,phandle = <0x2f>;
		phandle = <0x2f>;
	};

	disp_ccorr0@14010000 {
		compatible = "mediatek,disp_ccorr0";
		reg = <0x00 0x14010000 0x00 0x1000>;
		interrupts = <0x00 0xdd 0x08>;
	};

	disp_aal0@14011000 {
		compatible = "mediatek,disp_aal0";
		reg = <0x00 0x14011000 0x00 0x1000>;
		interrupts = <0x00 0xde 0x08>;
	};

	disp_gamma0@14012000 {
		compatible = "mediatek,disp_gamma0";
		reg = <0x00 0x14012000 0x00 0x1000>;
		interrupts = <0x00 0xdf 0x08>;
	};

	disp_dither0@14013000 {
		compatible = "mediatek,disp_dither0";
		reg = <0x00 0x14013000 0x00 0x1000>;
		interrupts = <0x00 0xe0 0x08>;
	};

	dsi0@14014000 {
		compatible = "mediatek,dsi0";
		reg = <0x00 0x14014000 0x00 0x1000>;
		interrupts = <0x00 0xe1 0x08>;
	};

	disp_rsz0@14015000 {
		compatible = "mediatek,disp_rsz0";
		reg = <0x00 0x14015000 0x00 0x1000>;
		interrupts = <0x00 0x114 0x08>;
	};

	mtkfb@0 {
		compatible = "mediatek,mtkfb";
		linux,phandle = <0xa7>;
		phandle = <0xa7>;
	};

	dispsys {
		compatible = "mediatek,dispsys";
		mediatek,larb = <0x22>;
		clocks = <0x27 0x03 0x28 0x13 0x28 0x14 0x28 0x15 0x28 0x16 0x28 0x07 0x28 0x08 0x28 0x0a 0x28 0x0b 0x28 0x0c 0x28 0x0d 0x28 0x0e 0x28 0x0f 0x28 0x10 0x28 0x11 0x28 0x1c 0x28 0x1d 0x28 0x09 0x44 0x15 0x1e 0x73 0x26 0x31 0x1f 0x1e 0x1b 0x1e 0x2e 0x1e 0x30>;
		clock-names = "MMSYS_MTCMOS\0MMSYS_SMI_COMMON\0MMSYS_SMI_LARB0\0MMSYS_GALS_COMM0\0MMSYS_GALS_COMM1\0MMSYS_DISP_OVL0\0MMSYS_DISP_OVL0_2L\0MMSYS_DISP_RDMA0\0MMSYS_DISP_WDMA0\0MMSYS_DISP_COLOR0\0MMSYS_DISP_CCORR0\0MMSYS_DISP_AAL0\0MMSYS_DISP_GAMMA0\0MMSYS_DISP_DITHER0\0MMSYS_DSI0_MM_CK\0MMSYS_DSI0_IF_CK\0MMSYS_26M\0MMSYS_DISP_RSZ0\0APMIXED_MIPI_26M\0TOP_MUX_DISP_PWM\0DISP_PWM\0TOP_26M\0TOP_UNIVPLL2_D4\0TOP_ULPOSC1_D2\0TOP_ULPOSC1_D8";
	};

	dsi_te {
		compatible = "mediatek, DSI_TE-eint";
		status = "disabled";
		linux,phandle = <0xa8>;
		phandle = <0xa8>;
	};

	smi_larb2@15021000 {
		cell-index = <0x02>;
		compatible = "mediatek,smi_larb2\0mediatek,smi_larb";
		reg = <0x00 0x15021000 0x00 0x1000>;
		clocks = <0x27 0x05 0x28 0x18 0x4d 0x00>;
		clock-names = "mtcmos-isp\0gals-img2mm\0img-larb2";
		linux,phandle = <0x24>;
		phandle = <0x24>;
	};

	fdvt@1502b000 {
		compatible = "mediatek,fdvt";
		reg = <0x00 0x1502b000 0x00 0x1000>;
		interrupts = <0x00 0x102 0x08>;
		clocks = <0x4d 0x02>;
		clock-names = "FD_CLK_IMG_FDVT";
	};

	venc_gcon@17000000 {
		compatible = "mediatek,venc_gcon\0syscon";
		reg = <0x00 0x17000000 0x00 0x10000>;
		clocks = <0x27 0x03 0x27 0x0a 0x28 0x15 0x28 0x16 0x28 0x13 0x4f 0x03 0x4f 0x01>;
		clock-names = "MT_SCP_SYS_DIS\0MT_SCP_SYS_VCODEC\0MT_CG_MM_SMI_COMM0\0MT_CG_MM_SMI_COMM1\0MT_CG_MM_SMI_COMMON\0MT_CG_VDEC\0MT_CG_VENC";
		#clock-cells = <0x01>;
		pwr-regmap = <0x45>;
		linux,phandle = <0x4f>;
		phandle = <0x4f>;
	};

	smi_larb1@17010000 {
		cell-index = <0x01>;
		compatible = "mediatek,smi_larb1\0mediatek,smi_larb";
		reg = <0x00 0x17010000 0x00 0x1000>;
		clocks = <0x27 0x0a 0x4f 0x01>;
		clock-names = "mtcmos-vcodec\0venc-larb1";
		linux,phandle = <0x23>;
		phandle = <0x23>;
	};

	venc@17020000 {
		compatible = "mediatek,venc";
		reg = <0x00 0x17020000 0x00 0x10000>;
		interrupts = <0x00 0xe6 0x08>;
	};

	venc_jpg@17030000 {
		compatible = "mediatek,venc_jpg";
		reg = <0x00 0x17030000 0x00 0x10000>;
		interrupts = <0x00 0xe8 0x08>;
		clocks = <0x4f 0x02>;
		clock-names = "MT_CG_VENC_JPGENC";
	};

	vdec@17040000 {
		compatible = "mediatek,vdec";
		reg = <0x00 0x17040000 0x00 0x10000>;
		interrupts = <0x00 0xe9 0x08>;
	};

	mbist@17050000 {
		compatible = "mediatek,mbist";
		reg = <0x00 0x17050000 0x00 0x10000>;
	};

	camsys@1a000000 {
		compatible = "mediatek,camsys\0syscon";
		reg = <0x00 0x1a000000 0x00 0x1000>;
		#clock-cells = <0x01>;
		pwr-regmap = <0x45>;
		linux,phandle = <0x4e>;
		phandle = <0x4e>;
	};

	smi_larb3@1a002000 {
		cell-index = <0x03>;
		compatible = "mediatek,smi_larb3\0mediatek,smi_larb";
		reg = <0x00 0x1a002000 0x00 0x1000>;
		clocks = <0x27 0x09 0x28 0x19 0x4e 0x00>;
		clock-names = "mtcmos-cam\0gals-cam2mm\0cam-larb3";
		linux,phandle = <0x25>;
		phandle = <0x25>;
	};

	cam1@1a003000 {
		compatible = "mediatek,cam1";
		reg = <0x00 0x1a003000 0x00 0x1000>;
		interrupts = <0x00 0xeb 0x08>;
	};

	cam2@1a004000 {
		compatible = "mediatek,cam2";
		reg = <0x00 0x1a004000 0x00 0x1000>;
		interrupts = <0x00 0xec 0x08>;
	};

	cam3@1a005000 {
		compatible = "mediatek,cam3";
		reg = <0x00 0x1a005000 0x00 0x1000>;
		interrupts = <0x00 0xed 0x08>;
	};

	cam_set@1a00b000 {
		compatible = "mediatek,cam_set";
		reg = <0x00 0x1a00b000 0x00 0x1000>;
	};

	cama_set@1a00c000 {
		compatible = "mediatek,cama_set";
		reg = <0x00 0x1a00c000 0x00 0x1000>;
	};

	camb_set@1a00d000 {
		compatible = "mediatek,camb_set";
		reg = <0x00 0x1a00d000 0x00 0x1000>;
	};

	cam_inner@1a013000 {
		compatible = "mediatek,cam_inner";
		reg = <0x00 0x1a013000 0x00 0x1000>;
	};

	cama_inner@1a014000 {
		compatible = "mediatek,cama_inner";
		reg = <0x00 0x1a014000 0x00 0x1000>;
	};

	camb_inner@1a015000 {
		compatible = "mediatek,camb_inner";
		reg = <0x00 0x1a015000 0x00 0x1000>;
	};

	cam_clear@1a01b000 {
		compatible = "mediatek,cam_clear";
		reg = <0x00 0x1a01b000 0x00 0x1000>;
	};

	cama_clear@1a01c000 {
		compatible = "mediatek,cama_clear";
		reg = <0x00 0x1a01c000 0x00 0x1000>;
	};

	camb_clear@1a01d000 {
		compatible = "mediatek,camb_clear";
		reg = <0x00 0x1a01d000 0x00 0x1000>;
	};

	cama_ext@1a024000 {
		compatible = "mediatek,cama_ext";
		reg = <0x00 0x1a024000 0x00 0x1000>;
	};

	camb_ext@1a025000 {
		compatible = "mediatek,camb_ext";
		reg = <0x00 0x1a025000 0x00 0x1000>;
	};

	seninf1@1a040000 {
		compatible = "mediatek,seninf1";
		reg = <0x00 0x1a040000 0x00 0x1000>;
	};

	seninf2@1a041000 {
		compatible = "mediatek,seninf2";
		reg = <0x00 0x1a041000 0x00 0x1000>;
	};

	seninf3@1a042000 {
		compatible = "mediatek,seninf3";
		reg = <0x00 0x1a042000 0x00 0x1000>;
	};

	seninf4@1a043000 {
		compatible = "mediatek,seninf4";
		reg = <0x00 0x1a043000 0x00 0x1000>;
	};

	kd_camera_hw1@1a040000 {
		compatible = "mediatek,camera_hw";
		reg = <0x00 0x1a040000 0x00 0x1000>;
		clocks = <0x1e 0x66 0x1e 0x67 0x1e 0x68 0x1e 0x69 0x1e 0x14 0x1e 0x13 0x1e 0x1d 0x1e 0x11 0x1e 0x1c 0x1e 0x12 0x1f 0x4e 0x04 0x44 0x0e 0x44 0x12 0x50 0x00 0x51 0x00 0x52 0x00 0x53 0x00 0x54 0x00 0x55 0x00 0x1e 0x7d 0x1e 0x1a 0x27 0x09>;
		clock-names = "CLK_TOP_CAMTG_SEL\0CLK_TOP_CAMTG1_SEL\0CLK_TOP_CAMTG2_SEL\0CLK_TOP_CAMTG3_SEL\0CLK_MCLK_6M\0CLK_MCLK_12M\0CLK_MCLK_13M\0CLK_MCLK_48M\0CLK_MCLK_52M\0CLK_MCLK_24M\0CLK_MCLK_26M\0CLK_CAM_SENINF_CG\0CLK_MIPI_C0_26M_CG\0CLK_MIPI_C1_26M_CG\0CLK_MIPI_ANA_0A_CG\0CLK_MIPI_ANA_0B_CG\0CLK_MIPI_ANA_1A_CG\0CLK_MIPI_ANA_1B_CG\0CLK_MIPI_ANA_2A_CG\0CLK_MIPI_ANA_2B_CG\0CLK_TOP_CAMTM_SEL_CG\0CLK_TOP_CAMTM_208_CG\0CLK_SCP_SYS_CAM";
		linux,phandle = <0xa9>;
		phandle = <0xa9>;
	};

	camsv1@1a050000 {
		compatible = "mediatek,camsv1";
		reg = <0x00 0x1a050000 0x00 0x1000>;
		interrupts = <0x00 0xf3 0x08>;
	};

	camsv2@1a051000 {
		compatible = "mediatek,camsv2";
		reg = <0x00 0x1a051000 0x00 0x1000>;
		interrupts = <0x00 0xf4 0x08>;
	};

	camsv3@1a052000 {
		compatible = "mediatek,camsv3";
		reg = <0x00 0x1a052000 0x00 0x1000>;
		interrupts = <0x00 0xf1 0x08>;
	};

	camsv4@1a053000 {
		compatible = "mediatek,camsv4";
		reg = <0x00 0x1a053000 0x00 0x1000>;
		interrupts = <0x00 0xf2 0x08>;
	};

	flashlight_core {
		compatible = "mediatek,flashlight_core";
		linux,phandle = <0xaa>;
		phandle = <0xaa>;
	};

	flashlights_yogurt {
		compatible = "mediatek,flashlights_yogurt";
		decouple = <0x01>;
		linux,phandle = <0xab>;
		phandle = <0xab>;

		channel@1 {
			type = <0x00>;
			ct = <0x00>;
			part = <0x00>;
		};
	};

	gps {
		compatible = "mediatek,gps";
	};

	ccu@1a0b0000 {
		compatible = "mediatek,ccu";
		reg = <0x00 0x1a0b1000 0x00 0x1000>;
		interrupts = <0x00 0xf6 0x08>;
		clocks = <0x4e 0x08>;
		clock-names = "CCU_CLK_CAM_CCU";
	};

	mt_charger {
		compatible = "mediatek,mt-charger";
		linux,phandle = <0xac>;
		phandle = <0xac>;
	};

	lk_charger {
		compatible = "mediatek,lk_charger";
		enable_anime;
		enable_pe_plus;
		enable_pd20_reset;
		power_path_support;
		max_charger_voltage = <0x632ea0>;
		fast_charge_voltage = <0x2dc6c0>;
		usb_charger_current = <0x7a120>;
		ac_charger_current = <0x1f47d0>;
		ac_charger_input_current = <0x30d400>;
		non_std_ac_charger_current = <0x7a120>;
		charging_host_charger_current = <0x16e360>;
		ta_ac_charger_current = <0x2dc6c0>;
		pd_charger_current = <0x7a120>;
		temp_t4_threshold = <0x32>;
		temp_t3_threshold = <0x2d>;
		temp_t1_threshold = <0x00>;
		linux,phandle = <0xad>;
		phandle = <0xad>;
	};

	charger {
		compatible = "mediatek,charger";
		algorithm_name = "SwitchCharging";
		enable_pe_plus;
		enable_pe_2;
		enable_pe_3;
		enable_pe_4;
		enable_type_c;
		power_path_support;
		enable_dynamic_mivr;
		disable_pd_dual;
		battery_cv = <0x426030>;
		max_charger_voltage = <0x632ea0>;
		min_charger_voltage = <0x4630c0>;
		min_charger_voltage_1 = <0x432380>;
		min_charger_voltage_2 = <0x401640>;
		max_dmivr_charger_current = <0x155cc0>;
		usb_charger_current_suspend = <0x00>;
		usb_charger_current_unconfigured = <0x11170>;
		usb_charger_current_configured = <0x7a120>;
		usb_charger_current = <0x7a120>;
		ac_charger_current = <0x1f47d0>;
		ac_charger_input_current = <0x30d400>;
		non_std_ac_charger_current = <0x7a120>;
		charging_host_charger_current = <0x16e360>;
		apple_1_0a_charger_current = <0x9eb10>;
		apple_2_1a_charger_current = <0xc3500>;
		ta_ac_charger_current = <0x2dc6c0>;
		jeita_temp_above_t4_cv = <0x40b280>;
		jeita_temp_t3_to_t4_cv = <0x40b280>;
		jeita_temp_t2_to_t3_cv = <0x423920>;
		jeita_temp_t1_to_t2_cv = <0x40b280>;
		jeita_temp_t0_to_t1_cv = <0x3da540>;
		jeita_temp_below_t0_cv = <0x3da540>;
		temp_t4_thres = <0x32>;
		temp_t4_thres_minus_x_degree = <0x2f>;
		temp_t3_thres = <0x2d>;
		temp_t3_thres_minus_x_degree = <0x27>;
		temp_t2_thres = <0x0a>;
		temp_t2_thres_plus_x_degree = <0x10>;
		temp_t1_thres = <0x00>;
		temp_t1_thres_plus_x_degree = <0x06>;
		temp_t0_thres = <0x00>;
		temp_t0_thres_plus_x_degree = <0x00>;
		temp_neg_10_thres = <0x00>;
		enable_min_charge_temp;
		min_charge_temp = <0x00>;
		min_charge_temp_plus_x_degree = <0x06>;
		max_charge_temp = <0x32>;
		max_charge_temp_minus_x_degree = <0x2f>;
		ta_12v_support;
		ta_9v_support;
		pe_ichg_level_threshold = <0xf4240>;
		ta_ac_12v_input_current = <0x30d400>;
		ta_ac_9v_input_current = <0x30d400>;
		ta_ac_7v_input_current = <0x30d400>;
		pe20_ichg_level_threshold = <0xf4240>;
		ta_start_battery_soc = <0x00>;
		ta_stop_battery_soc = <0x55>;
		high_temp_to_leave_pe40 = <0x2e>;
		high_temp_to_enter_pe40 = <0x27>;
		low_temp_to_leave_pe40 = <0x0a>;
		low_temp_to_enter_pe40 = <0x10>;
		pe40_single_charger_input_current = <0x2dc6c0>;
		pe40_single_charger_current = <0x2dc6c0>;
		pe40_dual_charger_input_current = <0x2dc6c0>;
		pe40_dual_charger_chg1_current = <0x1e8480>;
		pe40_dual_charger_chg2_current = <0x1e8480>;
		pe40_stop_battery_soc = <0x50>;
		pe40_r_cable_1a_lower = <0x229>;
		pe40_r_cable_2a_lower = <0x19f>;
		pe40_r_cable_3a_lower = <0x113>;
		chg1_ta_ac_charger_current = <0x16e360>;
		chg2_ta_ac_charger_current = <0x16e360>;
		slave_mivr_diff = <0x186a0>;
		dual_polling_ieoc = <0x6ddd0>;
		cable_imp_threshold = <0x2bb>;
		vbat_cable_imp_threshold = <0x3b8260>;
		bif_threshold1 = <0x40d990>;
		bif_threshold2 = <0x419ce0>;
		bif_cv_under_threshold2 = <0x43e6d0>;
		pd_vbus_low_bound = <0x4c4b40>;
		pd_vbus_upper_bound = <0x4c4b40>;
		pd_ichg_level_threshold = <0xf4240>;
		pd_stop_battery_soc = <0x50>;
		ibus_err = <0x0e>;
		vsys_watt = <0x4c4b40>;
		linux,phandle = <0xae>;
		phandle = <0xae>;
	};

	pd_adapter {
		compatible = "mediatek,pd_adapter";
		adapter_name = "pd_adapter";
		linux,phandle = <0xaf>;
		phandle = <0xaf>;
	};

	rt9465_slave_chr {
		compatible = "richtek,rt9465";
		status = "disabled";
		linux,phandle = <0xb0>;
		phandle = <0xb0>;
	};

	rt-pd-manager {
		compatible = "mediatek,rt-pd-manager";
	};

	mt6370_pmu_eint {
		linux,phandle = <0xb1>;
		phandle = <0xb1>;
	};

	mt6370_pd_eint {
		linux,phandle = <0xb2>;
		phandle = <0xb2>;
	};

	irtx_pwm {
		compatible = "mediatek,irtx-pwm";
		pwm_ch = <0x00>;
		pwm_data_invert = <0x00>;
		linux,phandle = <0xb3>;
		phandle = <0xb3>;
	};

	odm {
		compatible = "simple-bus";
		linux,phandle = <0xb4>;
		phandle = <0xb4>;
	};

	memory-ssmr-features {
		compatible = "mediatek,memory-ssmr-features";
		svp-size = <0x00 0x10000000>;
		iris-recognition-size = <0x00 0x10000000>;
		2d_fr-size = <0x00 0x8000000>;
		tui-size = <0x00 0x4000000>;
		wfd-size = <0x00 0x4000000>;
		prot-sharedmem-size = <0x00 0x8000000>;
		ta-elf-size = <0x00 0x1000000>;
		ta-stack-heap-size = <0x00 0x6000000>;
		sdsp-tee-sharedmem-size = <0x00 0x1000000>;
		sdsp-firmware-size = <0x00 0x1000000>;
		linux,phandle = <0xb5>;
		phandle = <0xb5>;
	};

	audio_snd_card {
		compatible = "mediatek,audio_snd_card";
	};

	mt_soc_deep_buffer_dl_pcm {
		compatible = "mediatek,mt_soc_pcm_deep_buffer_dl";
	};

	mt_soc_ul1_pcm {
		compatible = "mediatek,mt_soc_pcm_capture";
	};

	mt_soc_voice_md1 {
		compatible = "mediatek,mt_soc_pcm_voice_md1";
	};

	mt_soc_uldlloopback_pcm {
		compatible = "mediatek,mt_soc_pcm_uldlloopback";
	};

	mt_soc_i2s0_pcm {
		compatible = "mediatek,mt_soc_pcm_dl1_i2s0";
	};

	mt_soc_mrgrx_pcm {
		compatible = "mediatek,mt_soc_pcm_mrgrx";
	};

	mt_soc_mrgrx_awb_pcm {
		compatible = "mediatek,mt_soc_pcm_mrgrx_awb";
	};

	mt_soc_fm_i2s_pcm {
		compatible = "mediatek,mt_soc_pcm_fm_i2s";
	};

	mt_soc_fm_i2s_awb_pcm {
		compatible = "mediatek,mt_soc_pcm_fm_i2s_awb";
	};

	mt_soc_i2s0dl1_pcm {
		compatible = "mediatek,mt_soc_pcm_dl1_i2s0dl1";
	};

	mt_soc_dl1_awb_pcm {
		compatible = "mediatek,mt_soc_pcm_dl1_awb";
	};

	mt_soc_voice_md1_bt {
		compatible = "mediatek,mt_soc_pcm_voice_md1_bt";
	};

	mt_soc_voip_bt_out {
		compatible = "mediatek,mt_soc_pcm_dl1_bt";
	};

	mt_soc_voip_bt_in {
		compatible = "mediatek,mt_soc_pcm_bt_dai";
	};

	mt_soc_tdmrx_pcm {
		compatible = "mediatek,mt_soc_tdm_capture";
	};

	mt_soc_fm_mrgtx_pcm {
		compatible = "mediatek,mt_soc_pcm_fmtx";
	};

	mt_soc_ul2_pcm {
		compatible = "mediatek,mt_soc_pcm_capture2";
	};

	mt_soc_i2s0_awb_pcm {
		compatible = "mediatek,mt_soc_pcm_i2s0_awb";
	};

	mt_soc_voice_md2 {
		compatible = "mediatek,mt_soc_pcm_voice_md2";
	};

	mt_soc_pcm_dl1_scp_spk {
		compatible = "mediatek,mt_soc_pcm_dl1_scp_spk";
	};

	mt_soc_pcm_voice_scp {
		compatible = "mediatek,mt_soc_pcm_voice_scp";
	};

	mt_soc_routing_pcm {
		compatible = "mediatek,mt_soc_pcm_routing";
	};

	mt_soc_voice_md2_bt {
		compatible = "mediatek,mt_soc_pcm_voice_md2_bt";
	};

	mt_soc_hp_impedance_pcm {
		compatible = "mediatek,mt_soc_pcm_hp_impedance";
	};

	mt_soc_codec_name {
		compatible = "mediatek,mt_soc_codec_63xx";
		use_hp_depop_flow = <0x00>;
		use_ul_260k = <0x00>;
	};

	mt_soc_dummy_pcm {
		compatible = "mediatek,mt_soc_pcm_dummy";
	};

	mt_soc_codec_dummy_name {
		compatible = "mediatek,mt_soc_codec_dummy";
	};

	mt_soc_routing_dai_name {
		compatible = "mediatek,mt_soc_dai_routing";
	};

	mt_soc_dai_name {
		compatible = "mediatek,mt_soc_dai_stub";
	};

	mt_soc_dl2_pcm {
		compatible = "mediatek,mt_soc_pcm_dl2";
	};

	mt_soc_anc_pcm {
		compatible = "mediatek,mt_soc_pcm_anc";
	};

	mt_soc_pcm_voice_ultra {
		compatible = "mediatek,mt_soc_pcm_voice_ultra";
	};

	mt_soc_pcm_voice_usb {
		compatible = "mediatek,mt_soc_pcm_voice_usb";
	};

	mt_soc_pcm_voice_usb_echoref {
		compatible = "mediatek,mt_soc_pcm_voice_usb_echoref";
	};

	pmic_clock_buffer_ctrl {
		compatible = "mediatek,pmic_clock_buffer";
		mediatek,clkbuf-quantity = <0x07>;
		mediatek,clkbuf-config = <0x02 0x01 0x01 0x02 0x00 0x00 0x00>;
		mediatek,clkbuf-driving-current = <0x01 0x01 0x01 0x01 0x01 0x01 0x01>;
		linux,phandle = <0xb6>;
		phandle = <0xb6>;
	};

	i2c7 {
		linux,phandle = <0xb7>;
		phandle = <0xb7>;
	};

	i2c8 {
		linux,phandle = <0xb8>;
		phandle = <0xb8>;
	};

	i2c9 {
		linux,phandle = <0xb9>;
		phandle = <0xb9>;
	};

	smart_pa {
		linux,phandle = <0xba>;
		phandle = <0xba>;
	};

	md1_sim1_hot_plug_eint {
		linux,phandle = <0xbb>;
		phandle = <0xbb>;
	};

	md1_sim2_hot_plug_eint {
		linux,phandle = <0xbc>;
		phandle = <0xbc>;
	};

	pseudo_m4u {
		compatible = "mediatek,mt-pseudo_m4u";
		iommus = <0x56 0x02>;
	};

	pseudo_m4u-larb0 {
		compatible = "mediatek,mt-pseudo_m4u-port";
		mediatek,larbid = <0x00>;
		iommus = <0x56 0x00 0x56 0x01 0x56 0x02 0x56 0x03 0x56 0x04 0x56 0x05 0x56 0x06 0x56 0x07>;
	};

	pseudo_m4u-larb1 {
		compatible = "mediatek,mt-pseudo_m4u-port";
		mediatek,larbid = <0x01>;
		iommus = <0x56 0x20 0x56 0x21>;
	};

	pseudo_m4u-larb2 {
		compatible = "mediatek,mt-pseudo_m4u-port";
		mediatek,larbid = <0x02>;
		iommus = <0x56 0x40 0x56 0x41>;
	};

	pseudo_m4u-larb3 {
		compatible = "mediatek,mt-pseudo_m4u-port";
		mediatek,larbid = <0x03>;
		iommus = <0x56 0x60 0x56 0x61>;
	};

	eas {
		eff_turn_point = <0x1d3>;
		tiny = <0x32>;
	};

	radio_md_cfg {
		compatible = "mediatek,radio_md_cfg";
		linux,phandle = <0xbd>;
		phandle = <0xbd>;
	};

	dynamic_options {
		compatible = "mediatek,dynamic_options";
		linux,phandle = <0xbe>;
		phandle = <0xbe>;
	};

	mt6370_pmu_dts {
		interrupt-controller;
		#interrupt-cells = <0x01>;
		mt6370,intr_gpio_num = <0x03>;
		mt6370,intr_gpio = <0x3f 0x03 0x00>;
		linux,phandle = <0xbf>;
		phandle = <0xbf>;

		core {
			compatible = "mediatek,mt6370_pmu_core";
			interrupt-names = "otp\0vdda_ovp\0vdda_uv";
			i2cstmr_rst_tmr = <0x00>;
			mrstb_en;
			mrstb_tmr = <0x03>;
			int_wdt = <0x00>;
			int_deg = <0x00>;
		};

		charger {
			compatible = "mediatek,mt6370_pmu_charger";
			interrupt-names = "chg_mivr\0chg_aiclmeasi\0attachi\0ovpctrl_uvp_d_evt\0chg_wdtmri\0chg_vbusov\0chg_tmri\0chg_treg";
			charger_name = "primary_chg";
			load_switch_name = "primary_load_switch";
			ichg = <0x1e8480>;
			aicr = <0x7a120>;
			mivr = <0x432380>;
			cv = <0x426030>;
			ieoc = <0x249f0>;
			safety_timer = <0x0c>;
			dc_wdt = <0x3d0900>;
			ircmp_resistor = <0x61a8>;
			ircmp_vclamp = <0x7d00>;
			enable_te;
			enable_wdt;
		};

		mt6370_pmu_fled1 {
			compatible = "mediatek,mt6370_pmu_fled1";
			interrupt-names = "fled_lvf\0fled2_short\0fled1_short";
			fled_enable = <0x01>;
			torch_cur = <0x493e0>;
			strobe_cur = <0x124f80>;
			strobe_timeout = <0x960>;
		};

		mt6370_pmu_fled2 {
			compatible = "mediatek,mt6370_pmu_fled2";
			fled_enable = <0x01>;
			torch_cur = <0x30d40>;
			strobe_cur = <0xf4240>;
			strobe_timeout = <0x4b0>;
		};

		ldo {
			compatible = "mediatek,mt6370_pmu_ldo";
			interrupt-names = "ldo_oc";
			ldo_oms = <0x01>;
			ldo_vrc_lt = <0x01>;

			mt6370_ldo {
				regulator-name = "irtx_ldo";
				regulator-min-microvolt = <0x186a00>;
				regulator-max-microvolt = <0x3d0900>;
			};
		};

		rgbled {
			compatible = "mediatek,mt6370_pmu_rgbled";
			interrupt-names = "isink4_short\0isink3_short\0isink2_short\0isink1_short\0isink4_open\0isink3_open\0isink2_open\0isink1_open";
			mt,led_name = "mt6370_pmu_led1\0mt6370_pmu_led2\0mt6370_pmu_led3\0mt6370_pmu_led4";
			mt,led_default_trigger = "cc_mode\0cc_mode\0cc_mode\0none";
		};

		bled {
			compatible = "mediatek,mt6370_pmu_bled";
			interrupt-names = "bled_ocp";
			mt,bled_name = "mt6370_pmu_bled";
			mt,chan_en = <0x0f>;
			mt,map_linear;
			mt,bl_ovp_level = <0x03>;
			mt,bl_ocp_level = <0x02>;
			mt,use_pwm;
			mt,pwm_fsample = <0x02>;
			mt,pwm_deglitch = <0x01>;
			mt,pwm_hys_en = <0x01>;
			mt,pwm_hys = <0x00>;
			mt,pwm_avg_cycle = <0x00>;
			mt,bled_ramptime = <0x03>;
			mt,bled_flash_ramp = <0x01>;
			mt,max_bled_brightness = <0x200>;
		};

		dsv {
			compatible = "mediatek,mt6370_pmu_dsv";
			interrupt-names = "dsv_vneg_ocp\0dsv_vpos_ocp\0dsv_bst_ocp\0dsv_vneg_scp\0dsv_vpos_scp";
			db_ext_en = <0x00>;
			db_periodic_fix = <0x00>;
			db_single_pin = <0x00>;
			db_freq_pm = <0x00>;
			db_periodic_mode = <0x00>;
			db_startup = <0x00>;
			db_vneg_20ms = <0x01>;
			db_vneg_disc = <0x00>;
			db_vpos_20ms = <0x01>;
			db_vpos_disc = <0x01>;
			db_delay = <0x03>;
			db_vbst = <0x1644>;
			db_vpos_slew = <0x01>;
			db_vneg_slew = <0x01>;

			mt6370_dsvp {
				regulator-name = "dsv_pos";
				regulator-min-microvolt = <0x3d0900>;
				regulator-max-microvolt = <0x5b8d80>;
			};

			mt6370_dsvn {
				regulator-name = "dsv_neg";
				regulator-min-microvolt = <0x3d0900>;
				regulator-max-microvolt = <0x5b8d80>;
			};
		};
	};

	type_c_port0 {
		tcpc-dual,supported_modes = <0x00>;
		mt-tcpc,name = "type_c_port0";
		mt-tcpc,role_def = <0x04>;
		mt-tcpc,rp_level = <0x00>;
		mt-tcpc,vconn_supply = <0x01>;
		mt6370pd,intr_gpio = <0x3f 0x18 0x00>;
		mt6370pd,intr_gpio_num = <0x18>;
		linux,phandle = <0xc0>;
		phandle = <0xc0>;

		pd-data {
			pd,vid = <0x29cf>;
			pd,pid = <0x5081>;
			pd,source-cap-ext = <0x171129cf 0x00 0x102 0x00 0x00 0x2000000>;
			pd,mfrs = "RichtekTCPC";
			pd,charging_policy = <0x21>;
			pd,source-pdo-size = <0x01>;
			pd,source-pdo-data = <0x19032>;
			pd,sink-pdo-size = <0x02>;
			pd,sink-pdo-data = <0x190c8 0xc0761e3c>;
			pd,id-vdo-size = <0x03>;
			pd,id-vdo-data = <0xd10029cf 0x00 0x10000>;
			bat,nr = <0x01>;
			pd,country_nr = <0x00>;

			bat-info0 {
				bat,vid = <0x29cf>;
				bat,pid = <0x1711>;
				bat,mfrs = "bat1";
				bat,design_cap = <0xbb8>;
			};
		};

		dpm_caps {
			local_dr_power;
			local_dr_data;
			local_usb_comm;
			local_no_suspend;
			local_vconn_supply;
			attemp_enter_dp_mode;
			attemp_discover_cable;
			attemp_discover_id;
			pr_check = <0x00>;
			pr_check_gp_source;
			dr_check = <0x00>;
		};
	};

	sia81xx@L {
		compatible = "si,sia81xx";
		si,sia81xx_type = "sia8109";
		si,sia81xx_reset = <0x3f 0x9f 0x00>;
		si,sia81xx_owi = <0x3f 0x9f 0x00>;
		pinctrl-names = "sia81xx_gpio";
		pinctrl-0 = <0x57>;
		si,sia81xx_disable_pin = <0x00>;
		timer_task_hdl = <0x00>;
		channel_num = <0x00>;
		owi_mode = <0x06>;
		en_x_filter = <0x00>;
		en_dynamic_updata_vdd = <0x00>;
		dynamic_updata_vdd_port = <0x08>;
		linux,phandle = <0x34>;
		phandle = <0x34>;
	};

	__symbols__ {
		chosen = "/chosen";
		cpu0 = "/cpus/cpu@000";
		cpu1 = "/cpus/cpu@001";
		cpu2 = "/cpus/cpu@002";
		cpu3 = "/cpus/cpu@003";
		cpu4 = "/cpus/cpu@100";
		cpu5 = "/cpus/cpu@101";
		cpu6 = "/cpus/cpu@102";
		cpu7 = "/cpus/cpu@103";
		STANDBY = "/cpus/idle-states/standby";
		MCDI_CPU = "/cpus/idle-states/mcdi-cpu";
		MCDI_CLUSTER = "/cpus/idle-states/mcdi-cluster";
		SODI = "/cpus/idle-states/sodi";
		SODI3 = "/cpus/idle-states/sodi3";
		DPIDLE = "/cpus/idle-states/dpidle";
		SUSPEND = "/cpus/idle-states/suspend";
		reserved_memory = "/reserved-memory";
		cpu_dbgapb = "/cpu_dbgapb@0d410000";
		gic = "/interrupt-controller@0c000000";
		sysirq = "/intpol-controller@10200a80";
		infracfg_ao = "/infracfg_ao@10001000";
		scpsys = "/scpsys@10001000";
		topckgen = "/topckgen@10000000";
		syscfg_pctl_1 = "/syscfg_pctl_1@0x10002000";
		syscfg_pctl_2 = "/syscfg_pctl_2@0x10002200";
		syscfg_pctl_3 = "/syscfg_pctl_3@0x10002400";
		syscfg_pctl_4 = "/syscfg_pctl_4@0x10002600";
		syscfg_pctl_5 = "/syscfg_pctl_5@0x10002800";
		syscfg_pctl_6 = "/syscfg_pctl_6@0x10002a00";
		syscfg_pctl_7 = "/syscfg_pctl_7@0x10002c00";
		pericfg = "/pericfg@10003000";
		gpio_usage_mapping = "/gpio";
		gpio = "/gpio@10005000";
		syscfg_pctl_0 = "/syscfg_pctl_0@10005000";
		pio = "/pinctrl@1000b000";
		iddig_high = "/pinctrl@1000b000/iddig_high";
		iddig_low = "/pinctrl@1000b000/iddig_low";
		msdc0_pins_default = "/pinctrl@1000b000/msdc0@default";
		msdc0_pins_hs400 = "/pinctrl@1000b000/msdc0@hs400";
		msdc0_pins_hs200 = "/pinctrl@1000b000/msdc0@hs200";
		msdc0_register_setting_default = "/pinctrl@1000b000/msdc0@register_default";
		msdc1_pins_default = "/pinctrl@1000b000/msdc1@default";
		msdc1_pins_sdr104 = "/pinctrl@1000b000/msdc1@sdr104";
		msdc1_pins_sdr50 = "/pinctrl@1000b000/msdc1@sdr50";
		msdc1_pins_ddr50 = "/pinctrl@1000b000/msdc1@ddr50";
		msdc1_register_setting_default = "/pinctrl@1000b000/msdc1@register_default";
		msdc3_pins_default = "/pinctrl@1000b000/msdc3@default";
		msdc3_register_setting_default = "/pinctrl@1000b000/msdc3@register_default";
		nfc_ven_high = "/pinctrl@1000b000/nfc_ven_high";
		nfc_ven_low = "/pinctrl@1000b000/nfc_ven_low";
		nfc_dwn_high = "/pinctrl@1000b000/nfc_dwn_high";
		nfc_dwn_low = "/pinctrl@1000b000/nfc_dwn_low";
		nfc_eint_as_int = "/pinctrl@1000b000/nfc_eint_as_int";
		nfc_clk_req = "/pinctrl@1000b000/nfc_clk_req";
		nfc_default = "/pinctrl@1000b000/nfc_default";
		sia81xx_gpio_L = "/pinctrl@1000b000/sia81xx_gpio_L";
		sleep = "/sleep@10006000";
		clk26m = "/clocks/clk26m";
		clk32k = "/clocks/clk32k";
		apmixed = "/apmixed@1000c000";
		main_pmic = "/mt-pmic";
		pmic_auxadc = "/mt-pmic/mt635x-auxadc";
		mt_pmic_vs1_buck_reg = "/mt-pmic/buck_regulators/buck_vs1";
		mt_pmic_vmodem_buck_reg = "/mt-pmic/buck_regulators/buck_vmodem";
		mt_pmic_vcore_buck_reg = "/mt-pmic/buck_regulators/buck_vcore";
		mt_pmic_vproc_buck_reg = "/mt-pmic/buck_regulators/buck_vproc";
		mt_pmic_vpa_buck_reg = "/mt-pmic/buck_regulators/buck_vpa";
		mt_pmic_vfe28_ldo_reg = "/mt-pmic/ldo_regulators/ldo_vfe28";
		mt_pmic_vxo22_ldo_reg = "/mt-pmic/ldo_regulators/ldo_vxo22";
		mt_pmic_vrf18_ldo_reg = "/mt-pmic/ldo_regulators/ldo_vrf18";
		mt_pmic_vrf12_ldo_reg = "/mt-pmic/ldo_regulators/ldo_vrf12";
		mt_pmic_vefuse_ldo_reg = "/mt-pmic/ldo_regulators/ldo_vefuse";
		mt_pmic_vcn33_bt_ldo_reg = "/mt-pmic/ldo_regulators/ldo_vcn33_bt";
		mt_pmic_vcn33_wifi_ldo_reg = "/mt-pmic/ldo_regulators/ldo_vcn33_wifi";
		mt_pmic_vcn28_ldo_reg = "/mt-pmic/ldo_regulators/ldo_vcn28";
		mt_pmic_vcn18_ldo_reg = "/mt-pmic/ldo_regulators/ldo_vcn18";
		mt_pmic_vcama_ldo_reg = "/mt-pmic/ldo_regulators/ldo_vcama";
		mt_pmic_vcamd_ldo_reg = "/mt-pmic/ldo_regulators/ldo_vcamd";
		mt_pmic_vcamio_ldo_reg = "/mt-pmic/ldo_regulators/ldo_vcamio";
		mt_pmic_vldo28_ldo_reg = "/mt-pmic/ldo_regulators/ldo_vldo28";
		mt_pmic_vsram_others_ldo_reg = "/mt-pmic/ldo_regulators/ldo_vsram_others";
		mt_pmic_vsram_proc_ldo_reg = "/mt-pmic/ldo_regulators/ldo_vsram_proc";
		mt_pmic_vaux18_ldo_reg = "/mt-pmic/ldo_regulators/ldo_vaux18";
		mt_pmic_vaud28_ldo_reg = "/mt-pmic/ldo_regulators/ldo_vaud28";
		mt_pmic_vio28_ldo_reg = "/mt-pmic/ldo_regulators/ldo_vio28";
		mt_pmic_vio18_ldo_reg = "/mt-pmic/ldo_regulators/ldo_vio18";
		mt_pmic_vdram_ldo_reg = "/mt-pmic/ldo_regulators/ldo_vdram";
		mt_pmic_vmc_ldo_reg = "/mt-pmic/ldo_regulators/ldo_vmc";
		mt_pmic_vmch_ldo_reg = "/mt-pmic/ldo_regulators/ldo_vmch";
		mt_pmic_vemc_ldo_reg = "/mt-pmic/ldo_regulators/ldo_vemc";
		mt_pmic_vsim1_ldo_reg = "/mt-pmic/ldo_regulators/ldo_vsim1";
		mt_pmic_vsim2_ldo_reg = "/mt-pmic/ldo_regulators/ldo_vsim2";
		mt_pmic_vibr_ldo_reg = "/mt-pmic/ldo_regulators/ldo_vibr";
		mt_pmic_vusb33_ldo_reg = "/mt-pmic/ldo_regulators/ldo_vusb33";
		keypad = "/kp@10010000";
		otg_iddig = "/otg_iddig";
		mrdump_ext_rst = "/mrdump_ext_rst";
		touch = "/touch";
		accdet = "/accdet";
		silead_fp = "/silead_fp";
		fpsensor_finger = "/fpsensor_finger";
		fpc_interrupt = "/fpc_interrupt";
		oppo_fp_common = "/oppo_fp_common";
		oppo_secure_common = "/oppo_secure_common";
		bat_gm30 = "/battery";
		iommu = "/m4u@10205000";
		mdcldma = "/mdcldma@10014000";
		gce = "/gce@10238000";
		gce_mbox = "/gce_mbox@10238000";
		gce_mbox_svp = "/gce_mbox_svp@10238000";
		auxadc = "/auxadc@11001000";
		apdma = "/dma-controller@11000580";
		uart0 = "/serial@11020000";
		uart1 = "/serial@11030000";
		i2c_common = "/i2c_common";
		i2c0 = "/i2c0@11007000";
		i2c1 = "/i2c1@11008000";
		i2c2 = "/i2c2@11009000";
		i2c3 = "/i2c3@1100f000";
		i2c4 = "/i2c4@11011000";
		i2c5 = "/i2c5@11016000";
		sia81xx_i2c_L = "/i2c5@11016000/sia81xx_i2c@L";
		i2c6 = "/i2c6@1100d000";
		pwm = "/pwm@11006000";
		spi0 = "/spi@1100a000";
		consys = "/consys@18002000";
		spi1 = "/spi@11010000";
		spi2 = "/spi@11012000";
		spi3 = "/spi@11013000";
		spi4 = "/spi@11014000";
		spi5 = "/spi@11015000";
		msdc0 = "/msdc@11230000";
		msdc1 = "/msdc@11240000";
		msdc2 = "/msdc@11250000";
		msdc3 = "/msdc@11260000";
		msdc1_ins = "/msdc1_ins@0";
		audio = "/audio@11220000";
		audgpio = "/mt_soc_dl1_pcm@11220000";
		btcvsd_snd = "/mtk-btcvsd-snd@18050000";
		mipi_rx_ana_csi0a = "/mipi_rx_ana_csi0a@11c10000";
		mipi_rx_ana_csi0b = "/mipi_rx_ana_csi0b@11c11000";
		mipi_rx_ana_csi1a = "/mipi_rx_ana_csi1a@11c12000";
		mipi_rx_ana_csi1b = "/mipi_rx_ana_csi1b@11c13000";
		mipi_rx_ana_csi2a = "/mipi_rx_ana_csi2a@11c14000";
		mipi_rx_ana_csi2b = "/mipi_rx_ana_csi2b@11c15000";
		mfg_cfg = "/mfg_cfg@13ffe000";
		mmsys_config = "/mmsys_config@14000000";
		nfc553 = "/nfc553";
		irq_nfc = "/irq_nfc";
		disp_mutex0 = "/disp_mutex0@14001000";
		imgsys = "/imgsys@15020000";
		smi_larb0 = "/smi_larb0@14003000";
		mdp_rdma0 = "/mdp_rdma0@14004000";
		mdp_ccorr = "/mdp_ccorr0@14005000";
		mdp_rsz0 = "/mdp_rsz0@14006000";
		mdp_rsz1 = "/mdp_rsz1@14007000";
		mdp_wdma0 = "/mdp_wdma0@14008000";
		mdp_wrot0 = "/mdp_wrot0@14009000";
		mdp_tdshp0 = "/mdp_tdshp0@1400a000";
		disp_color0 = "/disp_color0@1400f000";
		mtkfb = "/mtkfb@0";
		dsi_te = "/dsi_te";
		smi_larb2 = "/smi_larb2@15021000";
		venc_gcon = "/venc_gcon@17000000";
		smi_larb1 = "/smi_larb1@17010000";
		camsys = "/camsys@1a000000";
		smi_larb3 = "/smi_larb3@1a002000";
		kd_camera_hw1 = "/kd_camera_hw1@1a040000";
		flashlight_core = "/flashlight_core";
		flashlights_yogurt = "/flashlights_yogurt";
		mt_charger = "/mt_charger";
		lk_charger = "/lk_charger";
		charger = "/charger";
		pd_adapter = "/pd_adapter";
		rt9465_slave_chr = "/rt9465_slave_chr";
		subpmic_pmu_eint = "/mt6370_pmu_eint";
		tcpc_pd = "/mt6370_pd_eint";
		irtx_pwm = "/irtx_pwm";
		odm = "/odm";
		memory_ssmr_features = "/memory-ssmr-features";
		pmic_clock_buffer_ctrl = "/pmic_clock_buffer_ctrl";
		i2c7 = "/i2c7";
		i2c8 = "/i2c8";
		i2c9 = "/i2c9";
		smart_pa = "/smart_pa";
		md1_sim1_hot_plug_eint = "/md1_sim1_hot_plug_eint";
		md1_sim2_hot_plug_eint = "/md1_sim2_hot_plug_eint";
		radio_md_cfg = "/radio_md_cfg";
		dynamic_options = "/dynamic_options";
		mt6370_pmu = "/mt6370_pmu_dts";
		mt6370_typec = "/type_c_port0";
		sia81xx_L = "/sia81xx@L";
	};
};
